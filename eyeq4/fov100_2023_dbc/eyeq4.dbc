VERSION ""

NS_ :

BS_:

BU_: IFV410 External ASDM

BO_ 3221225472 VECTOR__INDEPENDENT_SIG_MSG: 0 Vector__XXX
 SG_ FCWCIPSLatTimer : 0|7@1+ (1,0) [0|100] "Counts" Vector__XXX
 SG_ FCWAllowFCWCaution : 0|1@1+ (1,0) [0|1] "Boolean" Vector__XXX
 SG_ FCWMovPower : 0|5@1+ (1,-10) [-10|21] "dB" Vector__XXX
 SG_ CIBStaOffsetTrackRange : 0|10@1+ (0.25,0) [0|255.75] "Meters" Vector__XXX
 SG_ CIBMovOffsetTrackRange : 0|10@1+ (0.25,0) [0|255.75] "Meters" Vector__XXX
 SG_ InTunnelFlag_bool : 0|1@1+ (1,0) [0|0] "" Vector__XXX
 SG_ LowSpeed_ClutterON : 0|1@1+ (1,0) [0|0] "" Vector__XXX
 SG_ CIB_LowBrakeDeploy : 0|1@1+ (1,0) [0|1] "Enum" Vector__XXX
 SG_ CIB_HighBrakeDeploy : 0|1@1+ (1,0) [0|1] "Enum" Vector__XXX
 SG_ CIB_PCSEntryGatePassed : 0|1@1+ (1,0) [0|1] "Enum" Vector__XXX
 SG_ CIB_ProcessEachTrack : 0|1@1+ (1,0) [0|1] "Enum" Vector__XXX
 SG_ CIB_PCSAlgoEntered : 0|1@1+ (1,0) [0|1] "Enum" Vector__XXX
 SG_ CIB_StationaryObjectDelay_On : 0|1@1+ (1,0) [0|1] "Enum" Vector__XXX
 SG_ CIB_Inhibit_Steering_OR : 0|1@1+ (1,0) [0|1] "Enum" Vector__XXX
 SG_ CIB_OverrideTimer_On : 0|1@1+ (1,0) [0|1] "Enum" Vector__XXX
 SG_ IMUSecondaryPlausibilityFault : 0|1@1+ (1,0) [0|0] "" Vector__XXX
 SG_ IMUPrimaryPlausibilityFault : 0|1@1+ (1,0) [0|0] "" Vector__XXX
 SG_ WSSPlausibilityFault : 0|1@1+ (1,0) [0|0] "" Vector__XXX
 SG_ SASPlausibilityFault : 0|1@1+ (1,0) [0|0] "" Vector__XXX
 SG_ FWC_Power_Mode_State : 0|3@1+ (1,0) [0|2] "" Vector__XXX
 SG_ FWC_InitTimeout : 0|1@1+ (1,0) [0|1] "" Vector__XXX
 SG_ FWC_Diagnostic_Shutdown : 0|1@1+ (1,0) [0|1] "" Vector__XXX
 SG_ FWC_Thermal_Shutdown : 0|1@1+ (1,0) [0|1] "" Vector__XXX
 SG_ FWC_Init_Retry_Counter : 0|8@1+ (1,0) [0|255] "" Vector__XXX
 SG_ FWC_Init_wait_ms : 0|16@1+ (1,0) [0|65535] "usec" Vector__XXX
 SG_ FWC_Reset_Request : 0|1@1+ (1,0) [0|1] "" Vector__XXX
 SG_ FWC_I2C_Rolling_Count_Err : 0|1@1+ (1,0) [0|1] "" Vector__XXX
 SG_ FWC_I2C_Lost_Comm : 0|1@1+ (1,0) [0|1] "" Vector__XXX
 SG_ EYEQ_MES_50_VMP_SANITY_FAILED_B2 : 0|1@1+ (1,0) [0|1] "" Vector__XXX
 SG_ EYEQ_MES_50_VMP_SANITY_FAIL_0000 : 0|1@1+ (1,0) [0|1] "" Vector__XXX
 SG_ CIB_Time_To_Turn : 0|11@1+ (0.015625,0) [0|31.984375] "Sec" Vector__XXX
 SG_ CIB_Time_To_Brake : 0|11@1+ (0.015625,0) [0|31.984375] "Sec" Vector__XXX
 SG_ FWC_Camera_Wrong_Assembly_Fault_ : 0|1@1+ (1,0) [0|1] "" Vector__XXX
 SG_ Unreasonable_Radar_Data_Bc_7 : 0|1@1+ (1,0) [0|1] "" Vector__XXX
 SG_ Host_ENET_Message_CRC_Err_B8_0 : 0|1@1+ (1,0) [0|1] "" Vector__XXX
 SG_ FWC_CAMPWR_LDO_Fail_B1_5 : 0|1@1+ (1,0) [0|1] "" Vector__XXX
 SG_ FWC_Camera_Wrong_Assembly_F_0000 : 0|1@1+ (1,0) [0|1] "" Vector__XXX
 SG_ Unreasonable_Radar_Data_Bc_7 : 0|1@1+ (1,0) [0|1] "" Vector__XXX
 SG_ Host_ENET_Message_CRC_Err_B8_0 : 0|1@1+ (1,0) [0|1] "" Vector__XXX
 SG_ FWC_CAMPWR_LDO_Fail_B1_5 : 0|1@1+ (1,0) [0|1] "" Vector__XXX
 SG_ EYEQ_GEN_32_NO_MSG_ARRIVED_ERR_B : 0|1@1+ (1,0) [0|1] "" Vector__XXX
 SG_ FWC_ImagerFuseID_Mismatch_Fault_ : 0|1@1+ (1,0) [0|1] "" Vector__XXX
 SG_ Host_Application_CRC_Fault_B8_5 : 0|1@1+ (1,0) [0|1] "" Vector__XXX
 SG_ Host_On_Board_Thermistor_Out_Of_ : 0|1@1+ (1,0) [0|1] "" Vector__XXX
 SG_ Host_On_Board_Thermistor_Over_Te : 0|1@1+ (1,0) [0|1] "" Vector__XXX
 SG_ EYEQ_GEN_32_NO_MSG_ARRIVED__0000 : 0|1@1+ (1,0) [0|1] "" Vector__XXX
 SG_ FWC_ImagerFuseID_Mismatch_F_0000 : 0|1@1+ (1,0) [0|1] "" Vector__XXX
 SG_ Host_Application_CRC_Fault_B8_5 : 0|1@1+ (1,0) [0|1] "" Vector__XXX
 SG_ Host_On_Board_Thermistor_Ou_0000 : 0|1@1+ (1,0) [0|1] "" Vector__XXX
 SG_ Host_On_Board_Thermistor_Ov_0000 : 0|1@1+ (1,0) [0|1] "" Vector__XXX
 SG_ Host_ThermSts : 0|2@1+ (1,-2) [-2|1] "" Vector__XXX
 SG_ LKA_SW_Status : 0|1@1+ (1,0) [0|1] "" Vector__XXX
 SG_ LKA_LED_Status : 0|1@1+ (1,0) [0|1] "" Vector__XXX
 SG_ CibPed_LatRate : 0|12@1+ (0.01,-20) [-20|20] "m/s" Vector__XXX
 SG_ CibPed_LongBicyclist : 0|1@1+ (1,0) [0|1] "" Vector__XXX
 SG_ CibPed_Oncoming : 0|1@1+ (1,0) [0|1] "" Vector__XXX
 SG_ CibPed_DetSensor : 0|2@1+ (1,0) [0|3] "" Vector__XXX
 SG_ CibPed_Obj_Class : 0|4@1+ (1,0) [0|15] "" Vector__XXX
 SG_ CibPed_Match_Conf : 0|3@1+ (1,0) [0|5] "" Vector__XXX
 SG_ CibPedYPos : 0|12@1+ (0.25,0) [0|200] "m" Vector__XXX
 SG_ CibPedXPos : 0|12@1+ (0.25,0) [0|180] "m" Vector__XXX
 SG_ CibPedRangeRate : 0|12@1+ (0.125,-64) [-64|63.875] "m/s" Vector__XXX
 SG_ CibPed_TrackID : 0|7@1+ (1,0) [0|96] "" Vector__XXX
 SG_ CibPed_Lat_est : 0|10@1+ (0.25,-100) [-100|100] "m" Vector__XXX
 SG_ CibPedVisID : 0|4@1+ (1,0) [0|15] "" Vector__XXX
 SG_ CibPedTTC : 0|11@1+ (0.015625,0) [0|31.984375] "Sec" Vector__XXX
 SG_ FCWPed_Angle : 0|10@1+ (0.1,-51.2) [-51.2|51.1] "deg" Vector__XXX
 SG_ FCWPed_Obj_Class : 0|4@1+ (1,0) [0|15] "" Vector__XXX
 SG_ FCWPed_Latrate : 0|10@1+ (0.125,-20) [-20|20] "m/s" Vector__XXX
 SG_ FCWPed_XOHP : 0|10@1+ (0.25,-50) [-50|50] "m" Vector__XXX
 SG_ FCWPed_XOLC : 0|10@1+ (0.25,-50) [-50|50] "m" Vector__XXX
 SG_ FCWPed_Match_Conf : 0|3@1+ (1,0) [0|5] "" Vector__XXX
 SG_ FCWPed_TrackID : 0|7@1+ (1,0) [0|96] "" Vector__XXX
 SG_ FCWPed_VisID : 0|4@1+ (1,0) [0|15] "" Vector__XXX
 SG_ FCWPed_RangeRate : 0|10@1+ (0.125,-64) [-64|63.875] "m/s" Vector__XXX
 SG_ FCWPed_Range : 0|12@1+ (0.25,0) [0|255.75] "m" Vector__XXX
 SG_ FCWPed_TTC : 0|11@1+ (0.015625,0) [0|31.984375] "Sec" Vector__XXX
 SG_ CibPed_FID : 0|8@1+ (1,0) [0|10] "" Vector__XXX
 SG_ FCWPed_FID : 0|8@1+ (1,0) [0|10] "" Vector__XXX
 SG_ Ped_In_ROI : 0|1@1+ (1,0) [0|1] "" Vector__XXX
 SG_ FCWCIPS_RangeRate : 0|10@1+ (0.125,-64) [-64|63.875] "mps" Vector__XXX
 SG_ StatWarnRange : 0|10@1+ (0.25,0) [0|255.75] "Meters" Vector__XXX
 SG_ FCWCIPS_Range : 0|10@1+ (0.25,0) [0|255.75] "Meters" Vector__XXX
 SG_ StatComponent : 0|8@1+ (1,0) [0|255] "Bit Mapped" Vector__XXX
 SG_ FCWCIPS_TrackID : 0|8@1+ (1,0) [0|96] "Counts" Vector__XXX
 SG_ FCWCIPV_Angle : 0|10@1+ (0.1,-51.2) [-51.2|51.1] "deg" Vector__XXX
 SG_ FCA_Warning_State : 0|8@1+ (1,0) [0|32] "Enumerated" Vector__XXX
 SG_ FCWCIPS_Angle : 0|10@1+ (0.1,-51.2) [-51.2|51.1] "deg" Vector__XXX
 SG_ ReactionTime : 0|8@1+ (0.0625,0) [0|10] "Sec" Vector__XXX
 SG_ HostAccel : 0|8@1+ (0.0625,-8) [-8|7.9375] "mpss" Vector__XXX
 SG_ Caution_FCW_FDI : 0|8@1+ (0.5,0) [0|100] "Percent" Vector__XXX
 SG_ FCA_State : 0|1@1+ (1,0) [0|1] "Boolean" Vector__XXX
 SG_ ChimeSuppress : 0|1@1+ (1,0) [0|1] "Boolean" Vector__XXX
 SG_ FCA_Target_ID : 0|7@1+ (1,0) [0|96] "Counts" Vector__XXX
 SG_ LeadAccel : 0|8@1+ (0.0625,-8) [-8|7.9375] "mpss" Vector__XXX
 SG_ LeadSpeed : 0|10@1+ (0.0625,0) [0|63.9375] "m/sec" Vector__XXX
 SG_ FCWCIPV_RangeRate : 0|10@1+ (0.125,-64) [-64|63.875] "mps" Vector__XXX
 SG_ FCWCIPV_Range : 0|10@1+ (0.25,0) [0|255.75] "Meters" Vector__XXX
 SG_ MovWarnRange : 0|10@1+ (0.25,0) [0|255.75] "Meters" Vector__XXX
 SG_ MovComponent : 0|8@1+ (1,0) [0|255] "Bit Mapped" Vector__XXX
 SG_ FCWCIPV_TrackID : 0|7@1+ (1,0) [0|96] "Counts" Vector__XXX
 SG_ Inhibit_FCA_4_Flags : 0|32@1+ (1,0) [0|4294967295] "Bit Mapped" Vector__XXX
 SG_ Inhibit_FCA_5_Flags : 0|32@1+ (1,0) [0|4294967295] "Bit Mapped" Vector__XXX
 SG_ Inhibit_FCA_2_Flags : 0|32@1+ (1,0) [0|4294967295] "Bit Mapped" Vector__XXX
 SG_ Inhibit_FCA_3_Flags : 0|32@1+ (1,0) [0|4294967295] "Bit Mapped" Vector__XXX
 SG_ Inhibit_FCA_0_Flags : 0|32@1+ (1,0) [0|4294967295] "Bit Mapped" Vector__XXX
 SG_ Inhibit_FCA_1_Flags : 0|32@1+ (1,0) [0|4294967295] "Bit Mapped" Vector__XXX
 SG_ FCW_Ref_TTC : 0|16@1+ (1,0) [0|8190] "" Vector__XXX
 SG_ Inhibit_FDI_4_Flags : 0|32@1+ (1,0) [0|4294967295] "Bit Mapped" Vector__XXX
 SG_ Inhibit_FDI_5_Flags : 0|32@1+ (1,0) [0|4294967295] "Bit Mapped" Vector__XXX
 SG_ Inhibit_FDI_2_Flags : 0|32@1+ (1,0) [0|4294967295] "Bit Mapped" Vector__XXX
 SG_ Inhibit_FDI_3_Flags : 0|32@1+ (1,0) [0|4294967295] "Bit Mapped" Vector__XXX
 SG_ Inhibit_FDI_0_Flags : 0|32@1+ (1,0) [0|4294967295] "Bit Mapped" Vector__XXX
 SG_ Inhibit_FDI_1_Flags : 0|32@1+ (1,0) [0|4294967295] "Bit Mapped" Vector__XXX
 SG_ CIP_TTC : 0|11@1+ (0.015625,0) [0|31.984375] "Sec" Vector__XXX
 SG_ NeededDecel : 0|8@1+ (0.0625,-10) [-10|5.9375] "" Vector__XXX
 SG_ BrkPedRateUnfilt : 0|32@1+ (0.1,0) [0|429496729.5] "" Vector__XXX
 SG_ DrvAppdBrkPrsRateUnfilt : 0|32@1+ (0.1,0) [0|429496729.5] "" Vector__XXX
 SG_ Min_DecelRequest : 0|8@1+ (0.0625,-10) [-10|5.9375] "mpss" Vector__XXX
 SG_ BrakePressureActive : 0|1@1+ (1,0) [0|1] "" Vector__XXX
 SG_ BrakePedalActive : 0|1@1+ (1,0) [0|1] "" Vector__XXX
 SG_ CMbBCIPS_Amplitude : 0|5@1+ (1,-10) [-10|21] "dB" Vector__XXX
 SG_ CMbBCIPS_Angle : 0|10@1+ (0.1,-51.2) [-51.2|51.1] "deg" Vector__XXX
 SG_ CMbBCIPS_TrackID : 0|8@1+ (1,0) [0|96] "Counts" Vector__XXX
 SG_ CMbBCIPS_RangeRate : 0|10@1+ (0.125,-64) [-64|63.875] "mps" Vector__XXX
 SG_ CMbBCIPS_RangeAccel : 0|10@1+ (0.05,-25.6) [-25.6|25.55] "m/s/s" Vector__XXX
 SG_ CMbBCIPS_Range : 0|10@1+ (0.25,0) [0|255.75] "Meters" Vector__XXX
 SG_ CMbBCIPV_Amplitude : 0|5@1+ (1,-10) [-10|21] "dB" Vector__XXX
 SG_ CMbBCIPV_Angle : 0|10@1+ (0.1,-51.2) [-51.2|51.1] "deg" Vector__XXX
 SG_ CMbBCIPV_TrackID : 0|8@1+ (1,0) [0|96] "Counts" Vector__XXX
 SG_ CMbBCIPV_RangeRate : 0|10@1+ (0.125,-64) [-64|63.875] "mps" Vector__XXX
 SG_ CMbBCIPV_RangeAccel : 0|10@1+ (0.05,-25.6) [-25.6|25.55] "m/s/s" Vector__XXX
 SG_ CMbBCIPV_Range : 0|10@1+ (0.25,0) [0|255.75] "Meters" Vector__XXX
 SG_ Inhibit_CIB_4_Flags : 0|32@1+ (1,0) [0|4294967295] "Bit Mapped" Vector__XXX
 SG_ Inhibit_CIB_5_Flags : 0|32@1+ (1,0) [0|4294967295] "Bit Mapped" Vector__XXX
 SG_ Inhibit_CIB_2_Flags : 0|32@1+ (1,0) [0|4294967295] "Bit Mapped" Vector__XXX
 SG_ Inhibit_CIB_3_Flags : 0|32@1+ (1,0) [0|4294967295] "Bit Mapped" Vector__XXX
 SG_ Inhibit_CIB_0_Flags : 0|32@1+ (1,0) [0|4294967295] "Bit Mapped" Vector__XXX
 SG_ Inhibit_CIB_1_Flags : 0|32@1+ (1,0) [0|4294967295] "Bit Mapped" Vector__XXX
 SG_ PCS_BrakeRequestLevel : 0|8@1+ (1,0) [0|5] "Enum" Vector__XXX
 SG_ Diag_TOI_Discrimination : 0|1@1+ (1,0) [0|1] "Enum" Vector__XXX
 SG_ Diag_ProcessCIPObject : 0|1@1+ (1,0) [0|1] "Enum" Vector__XXX
 SG_ Diag_NewTrackDataCounter : 0|32@1+ (1,0) [0|4294967295] "" Vector__XXX
 SG_ CIP_ID : 0|8@1+ (1,0) [0|96] "" Vector__XXX
 SG_ Time_To_Turn : 0|11@1+ (0.015625,0) [0|31.984375] "Sec" Vector__XXX
 SG_ Time_To_Brake : 0|11@1+ (0.015625,0) [0|31.984375] "Sec" Vector__XXX
 SG_ SteeringAngleRateFlag : 0|1@1+ (1,0) [0|1] "Counts" Vector__XXX
 SG_ CIB_Host_Long_Accel_mpss : 0|8@1+ (0.0625,-8) [-8|7.9375] "mpss" Vector__XXX
 SG_ CIB_Alert_request_CIB : 0|1@1+ (1,0) [0|1] "" Vector__XXX
 SG_ ReleaseBrakeCommand : 0|1@1+ (1,0) [0|1] "" Vector__XXX
 SG_ SteeringOR : 0|1@1+ (1,0) [0|1] "Enum" Vector__XXX
 SG_ HighBrakeTimer : 0|16@1+ (1,0) [0|65535] "" Vector__XXX
 SG_ GasPedalOR : 0|1@1+ (1,0) [0|1] "Enum" Vector__XXX
 SG_ AEB_shutdown_11_Temperature_is_o : 0|1@1+ (1,0) [0|1] "" Vector__XXX
 SG_ AEB_shutdown_10_video_error_in_l : 0|1@1+ (1,0) [0|1] "" Vector__XXX
 SG_ EyeQ_Cal_Complete_And_Compatible : 0|1@1+ (1,0) [0|1] "" Vector__XXX
 SG_ Host_Cal_Complete_And_Compatible : 0|1@1+ (1,0) [0|1] "" Vector__XXX
 SG_ TR_AURIX_FIRSTTIMEPOWERUP_Bb_2 : 0|1@1+ (1,0) [0|1] "" Vector__XXX
 SG_ SWP4_CRC_Error_B20_2 : 0|1@1+ (1,0) [0|1] "" Vector__XXX
 SG_ SWP2_CRC_Error_B20_1 : 0|1@1+ (1,0) [0|1] "" Vector__XXX
 SG_ SWP1_CRC_Error_B20_0 : 0|1@1+ (1,0) [0|1] "" Vector__XXX
 SG_ MCU5_RollingCounter_B39_7 : 0|1@1+ (1,0) [0|1] "" Vector__XXX
 SG_ MCU5_CheckSum_B3d_7 : 0|1@1+ (1,0) [0|1] "" Vector__XXX
 SG_ MCU_FD1_ActRotSpd_Invalid_B33_0 : 0|1@1+ (1,0) [0|1] "" Vector__XXX
 SG_ Aurix_OTA_Flash_Fail_Bb_3 : 0|1@1+ (1,0) [0|1] "" Vector__XXX
 SG_ AlignmentAdjustInCorrect_B1b_6 : 0|1@1+ (1,0) [0|1] "" Vector__XXX
 SG_ AEB_shutdown_12_PLL_error_Be_5 : 0|1@1+ (1,0) [0|1] "" Vector__XXX
 SG_ AEB_shutdown_11_Temperature_0000 : 0|1@1+ (1,0) [0|1] "" Vector__XXX
 SG_ AEB_shutdown_10_video_error_0000 : 0|1@1+ (1,0) [0|1] "" Vector__XXX
 SG_ EyeQ_Cal_Complete_And_Compa_0000 : 0|1@1+ (1,0) [0|1] "" Vector__XXX
 SG_ Host_Cal_Complete_And_Compa_0000 : 0|1@1+ (1,0) [0|1] "" Vector__XXX
 SG_ TR_AURIX_FIRSTTIMEPOWERUP_Bb_2 : 0|1@1+ (1,0) [0|1] "" Vector__XXX
 SG_ SWP4_CRC_Error_B20_2 : 0|1@1+ (1,0) [0|1] "" Vector__XXX
 SG_ SWP2_CRC_Error_B20_1 : 0|1@1+ (1,0) [0|1] "" Vector__XXX
 SG_ SWP1_CRC_Error_B20_0 : 0|1@1+ (1,0) [0|1] "" Vector__XXX
 SG_ MCU5_RollingCounter_B39_7 : 0|1@1+ (1,0) [0|1] "" Vector__XXX
 SG_ MCU5_CheckSum_B3d_7 : 0|1@1+ (1,0) [0|1] "" Vector__XXX
 SG_ MCU_FD1_ActRotSpd_Invalid_B33_0 : 0|1@1+ (1,0) [0|1] "" Vector__XXX
 SG_ Aurix_OTA_Flash_Fail_Bb_3 : 0|1@1+ (1,0) [0|1] "" Vector__XXX
 SG_ AlignmentAdjustInCorrect_B1b_6 : 0|1@1+ (1,0) [0|1] "" Vector__XXX
 SG_ AEB_shutdown_12_PLL_error_Be_5 : 0|1@1+ (1,0) [0|1] "" Vector__XXX
 SG_ AEB_shutdown_11_Temperature_0001 : 0|1@1+ (1,0) [0|1] "" Vector__XXX
 SG_ AEB_shutdown_10_video_error_0001 : 0|1@1+ (1,0) [0|1] "" Vector__XXX
 SG_ EyeQ_Cal_Complete_And_Compa_0001 : 0|1@1+ (1,0) [0|1] "" Vector__XXX
 SG_ Host_Cal_Complete_And_Compa_0001 : 0|1@1+ (1,0) [0|1] "" Vector__XXX
 SG_ TR_AURIX_FIRSTTIMEPOWERUP_Bb_2 : 0|1@1+ (1,0) [0|1] "" Vector__XXX
 SG_ SWP4_CRC_Error_B20_2 : 0|1@1+ (1,0) [0|1] "" Vector__XXX
 SG_ SWP2_CRC_Error_B20_1 : 0|1@1+ (1,0) [0|1] "" Vector__XXX
 SG_ SWP1_CRC_Error_B20_0 : 0|1@1+ (1,0) [0|1] "" Vector__XXX
 SG_ MCU5_RollingCounter_B39_7 : 0|1@1+ (1,0) [0|1] "" Vector__XXX
 SG_ MCU5_CheckSum_B3d_7 : 0|1@1+ (1,0) [0|1] "" Vector__XXX
 SG_ MCU_FD1_ActRotSpd_Invalid_B33_0 : 0|1@1+ (1,0) [0|1] "" Vector__XXX
 SG_ Aurix_OTA_Flash_Fail_Bb_3 : 0|1@1+ (1,0) [0|1] "" Vector__XXX
 SG_ AlignmentAdjustInCorrect_B1b_6 : 0|1@1+ (1,0) [0|1] "" Vector__XXX
 SG_ AEB_shutdown_12_PLL_error_Be_5 : 0|1@1+ (1,0) [0|1] "" Vector__XXX
 SG_ AEB_shutdown_11_Temperature_0002 : 0|1@1+ (1,0) [0|1] "" Vector__XXX
 SG_ AEB_shutdown_10_video_error_0002 : 0|1@1+ (1,0) [0|1] "" Vector__XXX
 SG_ EyeQ_Cal_Complete_And_Compa_0002 : 0|1@1+ (1,0) [0|1] "" Vector__XXX
 SG_ Host_Cal_Complete_And_Compa_0002 : 0|1@1+ (1,0) [0|1] "" Vector__XXX
 SG_ TR_AURIX_FIRSTTIMEPOWERUP_Bb_2 : 0|1@1+ (1,0) [0|1] "" Vector__XXX
 SG_ SWP4_CRC_Error_B20_2 : 0|1@1+ (1,0) [0|1] "" Vector__XXX
 SG_ SWP2_CRC_Error_B20_1 : 0|1@1+ (1,0) [0|1] "" Vector__XXX
 SG_ SWP1_CRC_Error_B20_0 : 0|1@1+ (1,0) [0|1] "" Vector__XXX
 SG_ MCU5_RollingCounter_B39_7 : 0|1@1+ (1,0) [0|1] "" Vector__XXX
 SG_ MCU5_CheckSum_B3d_7 : 0|1@1+ (1,0) [0|1] "" Vector__XXX
 SG_ MCU_FD1_ActRotSpd_Invalid_B33_0 : 0|1@1+ (1,0) [0|1] "" Vector__XXX
 SG_ Aurix_OTA_Flash_Fail_Bb_3 : 0|1@1+ (1,0) [0|1] "" Vector__XXX
 SG_ AlignmentAdjustInCorrect_B1b_6 : 0|1@1+ (1,0) [0|1] "" Vector__XXX
 SG_ AEB_shutdown_12_PLL_error_Be_5 : 0|1@1+ (1,0) [0|1] "" Vector__XXX
 SG_ LCCState : 0|8@1+ (1,0) [0|255] "" Vector__XXX
 SG_ DiagInf_Req : 0|64@1+ (1,0) [0|1.84467440737096E+019] "" Vector__XXX
 SG_ DiagInf_Resp : 0|64@1+ (1,0) [0|1.84467440737096E+019] "" Vector__XXX
 SG_ EYEQ_SPI_Image_Index : 0|16@1+ (1,0) [0|65535] "" Vector__XXX
 SG_ SW_Reset_CoreID : 0|32@1+ (1,0) [0|4294967295] "" Vector__XXX
 SG_ BasicDiag_Fault_9 : 0|1@1+ (1,0) [0|1] "" Vector__XXX
 SG_ BasicDiag_Fault_8 : 0|1@1+ (1,0) [0|1] "" Vector__XXX
 SG_ BasicDiag_Fault_7 : 0|1@1+ (1,0) [0|1] "" Vector__XXX
 SG_ BasicDiag_Fault_6 : 0|1@1+ (1,0) [0|1] "" Vector__XXX
 SG_ BasicDiag_Fault_5 : 0|1@1+ (1,0) [0|1] "" Vector__XXX
 SG_ BasicDiag_Fault_4 : 0|1@1+ (1,0) [0|1] "" Vector__XXX
 SG_ BasicDiag_Fault_3 : 0|1@1+ (1,0) [0|1] "" Vector__XXX
 SG_ BasicDiag_Fault_2 : 0|1@1+ (1,0) [0|1] "" Vector__XXX
 SG_ BasicDiag_Fault_16 : 0|1@1+ (1,0) [0|1] "" Vector__XXX
 SG_ BasicDiag_Fault_15 : 0|1@1+ (1,0) [0|1] "" Vector__XXX
 SG_ BasicDiag_Fault_14 : 0|1@1+ (1,0) [0|1] "" Vector__XXX
 SG_ BasicDiag_Fault_13 : 0|1@1+ (1,0) [0|1] "" Vector__XXX
 SG_ BasicDiag_Fault_12 : 0|1@1+ (1,0) [0|1] "" Vector__XXX
 SG_ BasicDiag_Fault_11 : 0|1@1+ (1,0) [0|1] "" Vector__XXX
 SG_ BasicDiag_Fault_10 : 0|1@1+ (1,0) [0|1] "" Vector__XXX
 SG_ BasicDiag_Fault_1 : 0|1@1+ (1,0) [0|1] "" Vector__XXX
 SG_ Asil_Yaw_Vse_Plaus_Nok : 0|1@1+ (1,0) [0|1] "" Vector__XXX
 SG_ Asil_Spd_Vse_Plaus_Nok : 0|1@1+ (1,0) [0|1] "" Vector__XXX
 SG_ Asil_Spd_Source_Plaus_Nok_case2 : 0|1@1+ (1,0) [0|1] "" Vector__XXX
 SG_ Asil_Spd_Source_Plaus_Nok_case1 : 0|1@1+ (1,0) [0|1] "" Vector__XXX
 SG_ Asil_Spd_Source_Plaus_Nok : 0|1@1+ (1,0) [0|1] "" Vector__XXX
 SG_ reverse_status : 0|1@1+ (1,0) [0|1] "" Vector__XXX
 SG_ B_OK_CASE2_Speed_source_plausibl : 0|1@1+ (1,0) [0|1] "" Vector__XXX
 SG_ B_OK_CASE1_Speed_source_plausibl : 0|1@1+ (1,0) [0|1] "" Vector__XXX
 SG_ B_NOK_YAWRATE : 0|1@1+ (1,0) [0|1] "" Vector__XXX
 SG_ B_NOK_Speed_vse_plausiblity : 0|1@1+ (1,0) [0|1] "" Vector__XXX
 SG_ eyeqSPIMsg10RxCtr : 0|16@1+ (1,0) [0|65535] "" Vector__XXX
 SG_ dynamicCalParams_imageIndex : 0|16@1+ (1,0) [0|65535] "" Vector__XXX
 SG_ EyeQ_Reset_Reason : 0|8@1+ (1,0) [0|255] "" Vector__XXX
 SG_ comp_yaw_rate_filtered : 0|10@1+ (0.0064,-1.75) [-1.75|1.75] "rad/sec" Vector__XXX
 SG_ VehYaw_WActl : 0|15@1+ (0.0002,-2) [-2|2] "rad/sec" Vector__XXX
 SG_ LROSYawRate_Est : 0|15@1+ (0.0002,-2) [-2|2] "rad/sec" Vector__XXX

BO_ 1798 Veh_Estimation_Compensation: 32 IFV410
 SG_ steering_angle_qf : 216|3@1+ (1,0) [0|3] "" Vector__XXX
 SG_ steering_angle : 200|15@1+ (0.1,0) [0|780] "" Vector__XXX
 SG_ raw_steering_angle_deg : 184|15@1+ (0.1,0) [0|780] "" Vector__XXX
 SG_ filt_veh_speed_over_ground : 48|14@1+ (0.03125,0) [0|511.96875] "" Vector__XXX
 SG_ timestamp_ms_output : 16|16@1+ (0.0064,0) [0|419.424] "ms" Vector__XXX
 SG_ yaw_rate_bias_qf : 181|3@1+ (1,0) [0|3] ""  External
 SG_ raw_yaw_rate_rps : 96|10@1+ (0.0064,-1.75) [-1.75|1.75] "rad/sec"  External
 SG_ Yaw_Rate_Raw : 72|10@1+ (0.0064,-1.75) [-1.75|1.75] "rad/sec"  External
 SG_ Yaw_Rate_Raw_QF : 88|3@1+ (1,0) [0|3] ""  External
 SG_ Yaw_Rate_Reference : 120|10@1+ (0.0064,-1.75) [-1.75|1.75] "rad/sec"  External
 SG_ Yaw_Rate_Refernce_QF : 112|3@1+ (1,0) [0|3] ""  External
 SG_ Host_Vehicle_Speed : 32|14@1+ (0.01,0) [0|100] "m/sec"  External
 SG_ Host_Vehicle_Speed_QF : 64|3@1+ (1,0) [0|3] ""  External
 SG_ F_Vehicle_Stationary : 47|1@1+ (1,0) [0|1] ""  External
 SG_ Curr_run_time_input : 0|16@1+ (0.0064,0) [0|419.424] "msec"  External
 SG_ Yaw_Rate_Compensated_Unfiltered : 160|10@1+ (0.0064,-1.75) [-1.75|1.75] "rad/sec"  External
 SG_ Yaw_Rate_Compensated_Filtered : 144|10@1+ (0.0064,-1.75) [-1.75|1.75] "rad/sec"  External
 SG_ Yaw_Rate_Raw_Bias : 176|4@1+ (0.0064,-0.06) [-0.06|0.06] "rad/sec"  External
 SG_ Yaw_Rate_Compensated_QF : 136|3@1+ (1,0) [0|3] ""  External

BO_ 1832 VIS_OBS_MSG_13_15: 64 IFV410
 SG_ VIS_OBS_ID_13 : 0|4@1+ (1,0) [0|15] "N/A"  External
 SG_ VIS_OBS_classification_13 : 4|3@1+ (1,0) [0|7] "N/A"  External
 SG_ VIS_OBS_age_13 : 7|32@1+ (1,0) [0|4294967295] "N/A"  External
 SG_ VIS_OBS_brakeLight_Indicator_13 : 39|1@1+ (1,0) [0|1] "N/A"  External
 SG_ VIS_OBS_turnRight_Indicator_13 : 40|1@1+ (1,0) [0|1] "N/A"  External
 SG_ VIS_OBS_turnLeft_Indicator_13 : 41|1@1+ (1,0) [0|1] "N/A"  External
 SG_ VIS_OBS_ttc_const_vel_13 : 42|3@1+ (1,0) [0|7] "s"  External
 SG_ VIS_OBS_laneAssignment_13 : 45|3@1+ (1,-2) [-2|3] "N/A"  External
 SG_ VIS_OBS_motionStatus_13 : 48|3@1+ (1,0) [0|4] "N/A"  External
 SG_ VIS_OBS_motionCategory_13 : 51|4@1+ (1,0) [0|12] "N/A"  External
 SG_ VIS_OBS_motionOrientation_13 : 55|4@1+ (1,0) [0|8] "N/A"  External
 SG_ VIS_OBS_width_13 : 59|9@1+ (0.01,0) [0.4|2.95] "m"  External
 SG_ VIS_OBS_height_13 : 68|9@1+ (0.01,0) [0|4.2] "m"  External
 SG_ VIS_OBS_heading_13 : 77|12@1+ (0.0025,-3.14) [-3.14|3.14] "radians"  External
 SG_ VIS_OBS_latDistance_13 : 89|12@1+ (0.125,-100) [-100|100] "m"  External
 SG_ VIS_OBS_longDistance_13 : 101|12@1+ (0.125,-200) [-200|250] "m"  External
 SG_ VIS_OBS_LatVelocity_13 : 113|13@1+ (0.025,-50) [-50|50] "m/s"  External
 SG_ VIS_OBS_LongVelocity_13 : 126|13@1+ (0.025,-65) [-65|65] "m/s"  External
 SG_ VIS_OBS_LatAcc_13 : 139|12@1+ (0.01,-11) [-11|8] "m/s^2"  External
 SG_ VIS_OBS_LongAcc_13 : 151|12@1+ (0.01,-13) [-13|13] "m/s^2"  External
 SG_ VIS_OBS_RC_counter_31A : 504|8@1+ (1,0) [0|255] "N/A"  External
 SG_ VIS_OBS_messsage_counter_31A : 500|4@1+ (1,0) [0|15] "N/A"  External
 SG_ VIS_OBS_CIPV_Lost_13 : 166|2@1+ (1,0) [0|2] "N/A"  External
 SG_ VIS_OBS_ID_14 : 168|4@1+ (1,0) [0|15] "N/A"  External
 SG_ VIS_OBS_classification_14 : 172|3@1+ (1,0) [0|7] "N/A"  External
 SG_ VIS_OBS_age_14 : 175|32@1+ (1,0) [0|4294967295] "N/A"  External
 SG_ VIS_OBS_brakeLight_Indicator_14 : 207|1@1+ (1,0) [0|1] "N/A"  External
 SG_ VIS_OBS_turnRight_Indicator_14 : 208|1@1+ (1,0) [0|1] "N/A"  External
 SG_ VIS_OBS_turnLeft_Indicator_14 : 209|1@1+ (1,0) [0|1] "N/A"  External
 SG_ VIS_OBS_ttc_const_vel_14 : 210|3@1+ (1,0) [0|7] "s"  External
 SG_ VIS_OBS_laneAssignment_14 : 213|3@1+ (1,-2) [-2|3] "N/A"  External
 SG_ VIS_OBS_motionStatus_14 : 216|3@1+ (1,0) [0|4] "N/A"  External
 SG_ VIS_OBS_motionCategory_14 : 219|4@1+ (1,0) [0|12] "N/A"  External
 SG_ VIS_OBS_motionOrientation_14 : 223|4@1+ (1,0) [0|8] "N/A"  External
 SG_ VIS_OBS_width_14 : 227|9@1+ (0.01,0) [0.4|2.95] "m"  External
 SG_ VIS_OBS_height_14 : 236|9@1+ (0.01,0) [0|4.2] "m"  External
 SG_ VIS_OBS_heading_14 : 245|12@1+ (0.0025,-3.14) [-3.14|3.14] "radians"  External
 SG_ VIS_OBS_latDistance_14 : 257|12@1+ (0.125,-100) [-100|100] "m"  External
 SG_ VIS_OBS_longDistance_14 : 269|12@1+ (0.125,-200) [-200|250] "m"  External
 SG_ VIS_OBS_LatVelocity_14 : 281|13@1+ (0.025,-50) [-50|50] "m/s"  External
 SG_ VIS_OBS_LongVelocity_14 : 294|13@1+ (0.025,-65) [-65|65] "m/s"  External
 SG_ VIS_OBS_LatAcc_14 : 307|12@1+ (0.01,-11) [-11|8] "m/s^2"  External
 SG_ VIS_OBS_LongAcc_14 : 319|12@1+ (0.01,-13) [-13|13] "m/s^2"  External
 SG_ VIS_OBS_ID_15 : 336|4@1+ (1,0) [0|15] "N/A"  External
 SG_ VIS_OBS_classification_15 : 340|3@1+ (1,0) [0|7] "N/A"  External
 SG_ VIS_OBS_age_15 : 343|32@1+ (1,0) [0|4294967295] "N/A"  External
 SG_ VIS_OBS_brakeLight_Indicator_15 : 375|1@1+ (1,0) [0|1] "N/A"  External
 SG_ VIS_OBS_turnRight_Indicator_15 : 376|1@1+ (1,0) [0|1] "N/A"  External
 SG_ VIS_OBS_turnLeft_Indicator_15 : 377|1@1+ (1,0) [0|1] "N/A"  External
 SG_ VIS_OBS_ttc_const_vel_15 : 378|3@1+ (1,0) [0|7] "s"  External
 SG_ VIS_OBS_laneAssignment_15 : 381|3@1+ (1,-2) [-2|3] "N/A"  External
 SG_ VIS_OBS_motionStatus_15 : 384|3@1+ (1,0) [0|4] "N/A"  External
 SG_ VIS_OBS_motionCategory_15 : 387|4@1+ (1,0) [0|12] "N/A"  External
 SG_ VIS_OBS_motionOrientation_15 : 391|4@1+ (1,0) [0|8] "N/A"  External
 SG_ VIS_OBS_width_15 : 395|9@1+ (0.01,0) [0.4|2.95] "m"  External
 SG_ VIS_OBS_height_15 : 404|9@1+ (0.01,0) [0|4.2] "m"  External
 SG_ VIS_OBS_heading_15 : 413|12@1+ (0.0025,-3.14) [-3.14|3.14] "radians"  External
 SG_ VIS_OBS_latDistance_15 : 425|12@1+ (0.125,-100) [-100|100] "m"  External
 SG_ VIS_OBS_longDistance_15 : 437|12@1+ (0.125,-200) [-200|250] "m"  External
 SG_ VIS_OBS_LatVelocity_15 : 449|13@1+ (0.025,-50) [-50|50] "m/s"  External
 SG_ VIS_OBS_LongVelocity_15 : 462|13@1+ (0.025,-65) [-65|65] "m/s"  External
 SG_ VIS_OBS_LatAcc_15 : 475|12@1+ (0.01,-11) [-11|8] "m/s^2"  External
 SG_ VIS_OBS_LongAcc_15 : 487|12@1+ (0.01,-13) [-13|13] "m/s^2"  External
 SG_ VIS_OBS_CIPV_Lost_14 : 334|2@1+ (1,0) [0|2] "N/A"  External
 SG_ VIS_OBS_CIPV_Lost_15 : 332|2@1+ (1,0) [0|2] "N/A"  External

BO_ 1831 VIS_OBS_MSG_10_12: 64 IFV410
 SG_ VIS_OBS_ID_10 : 0|4@1+ (1,0) [0|15] "N/A"  External
 SG_ VIS_OBS_classification_10 : 4|3@1+ (1,0) [0|7] "N/A"  External
 SG_ VIS_OBS_age_10 : 7|32@1+ (1,0) [0|4294967295] "N/A"  External
 SG_ VIS_OBS_brakeLight_Indicator_10 : 39|1@1+ (1,0) [0|1] "N/A"  External
 SG_ VIS_OBS_turnRight_Indicator_10 : 40|1@1+ (1,0) [0|1] "N/A"  External
 SG_ VIS_OBS_turnLeft_Indicator_10 : 41|1@1+ (1,0) [0|1] "N/A"  External
 SG_ VIS_OBS_ttc_const_vel_10 : 42|3@1+ (1,0) [0|7] "s"  External
 SG_ VIS_OBS_laneAssignment_10 : 45|3@1+ (1,-2) [-2|3] "N/A"  External
 SG_ VIS_OBS_motionStatus_10 : 48|3@1+ (1,0) [0|4] "N/A"  External
 SG_ VIS_OBS_motionCategory_10 : 51|4@1+ (1,0) [0|12] "N/A"  External
 SG_ VIS_OBS_motionOrientation_10 : 55|4@1+ (1,0) [0|8] "N/A"  External
 SG_ VIS_OBS_width_10 : 59|9@1+ (0.01,0) [0.4|2.95] "m"  External
 SG_ VIS_OBS_height_10 : 68|9@1+ (0.01,0) [0|4.2] "m"  External
 SG_ VIS_OBS_heading_10 : 77|12@1+ (0.0025,-3.14) [-3.14|3.14] "radians"  External
 SG_ VIS_OBS_latDistance_10 : 89|12@1+ (0.125,-100) [-100|100] "m"  External
 SG_ VIS_OBS_longDistance_10 : 101|12@1+ (0.125,-200) [-200|250] "m"  External
 SG_ VIS_OBS_LatVelocity_10 : 113|13@1+ (0.025,-50) [-50|50] "m/s"  External
 SG_ VIS_OBS_LongVelocity_10 : 126|13@1+ (0.025,-65) [-65|65] "m/s"  External
 SG_ VIS_OBS_LatAcc_10 : 139|12@1+ (0.01,-11) [-11|8] "m/s^2"  External
 SG_ VIS_OBS_LongAcc_10 : 151|12@1+ (0.01,-13) [-13|13] "m/s^2"  External
 SG_ VIS_OBS_RC_counter_319 : 504|8@1+ (1,0) [0|255] "N/A"  External
 SG_ VIS_OBS_messsage_counter_319 : 500|4@1+ (1,0) [0|15] "N/A"  External
 SG_ VIS_OBS_CIPV_Lost_10 : 166|2@1+ (1,0) [0|2] "N/A"  External
 SG_ VIS_OBS_ID_11 : 168|4@1+ (1,0) [0|15] "N/A"  External
 SG_ VIS_OBS_classification_11 : 172|3@1+ (1,0) [0|7] "N/A"  External
 SG_ VIS_OBS_age_11 : 175|32@1+ (1,0) [0|4294967295] "N/A"  External
 SG_ VIS_OBS_brakeLight_Indicator_11 : 207|1@1+ (1,0) [0|1] "N/A"  External
 SG_ VIS_OBS_turnRight_Indicator_11 : 208|1@1+ (1,0) [0|1] "N/A"  External
 SG_ VIS_OBS_turnLeft_Indicator_11 : 209|1@1+ (1,0) [0|1] "N/A"  External
 SG_ VIS_OBS_ttc_const_vel_11 : 210|3@1+ (1,0) [0|7] "s"  External
 SG_ VIS_OBS_laneAssignment_11 : 213|3@1+ (1,-2) [-2|3] "N/A"  External
 SG_ VIS_OBS_motionStatus_11 : 216|3@1+ (1,0) [0|4] "N/A"  External
 SG_ VIS_OBS_motionCategory_11 : 219|4@1+ (1,0) [0|12] "N/A"  External
 SG_ VIS_OBS_motionOrientation_11 : 223|4@1+ (1,0) [0|8] "N/A"  External
 SG_ VIS_OBS_width_11 : 227|9@1+ (0.01,0) [0.4|2.95] "m"  External
 SG_ VIS_OBS_height_11 : 236|9@1+ (0.01,0) [0|4.2] "m"  External
 SG_ VIS_OBS_heading_11 : 245|12@1+ (0.0025,-3.14) [-3.14|3.14] "radians"  External
 SG_ VIS_OBS_latDistance_11 : 257|12@1+ (0.125,-100) [-100|100] "m"  External
 SG_ VIS_OBS_longDistance_11 : 269|12@1+ (0.125,-200) [-200|250] "m"  External
 SG_ VIS_OBS_LatVelocity_11 : 281|13@1+ (0.025,-50) [-50|50] "m/s"  External
 SG_ VIS_OBS_LongVelocity_11 : 294|13@1+ (0.025,-65) [-65|65] "m/s"  External
 SG_ VIS_OBS_LatAcc_11 : 307|12@1+ (0.01,-11) [-11|8] "m/s^2"  External
 SG_ VIS_OBS_LongAcc_11 : 319|12@1+ (0.01,-13) [-13|13] "m/s^2"  External
 SG_ VIS_OBS_ID_12 : 336|4@1+ (1,0) [0|15] "N/A"  External
 SG_ VIS_OBS_classification_12 : 340|3@1+ (1,0) [0|7] "N/A"  External
 SG_ VIS_OBS_age_12 : 343|32@1+ (1,0) [0|4294967295] "N/A"  External
 SG_ VIS_OBS_brakeLight_Indicator_12 : 375|1@1+ (1,0) [0|1] "N/A"  External
 SG_ VIS_OBS_turnRight_Indicator_12 : 376|1@1+ (1,0) [0|1] "N/A"  External
 SG_ VIS_OBS_turnLeft_Indicator_12 : 377|1@1+ (1,0) [0|1] "N/A"  External
 SG_ VIS_OBS_ttc_const_vel_12 : 378|3@1+ (1,0) [0|7] "s"  External
 SG_ VIS_OBS_laneAssignment_12 : 381|3@1+ (1,-2) [-2|3] "N/A"  External
 SG_ VIS_OBS_motionStatus_12 : 384|3@1+ (1,0) [0|4] "N/A"  External
 SG_ VIS_OBS_motionCategory_12 : 387|4@1+ (1,0) [0|12] "N/A"  External
 SG_ VIS_OBS_motionOrientation_12 : 391|4@1+ (1,0) [0|8] "N/A"  External
 SG_ VIS_OBS_width_12 : 395|9@1+ (0.01,0) [0.4|2.95] "m"  External
 SG_ VIS_OBS_height_12 : 404|9@1+ (0.01,0) [0|4.2] "m"  External
 SG_ VIS_OBS_heading_12 : 413|12@1+ (0.0025,-3.14) [-3.14|3.14] "radians"  External
 SG_ VIS_OBS_latDistance_12 : 425|12@1+ (0.125,-100) [-100|100] "m"  External
 SG_ VIS_OBS_longDistance_12 : 437|12@1+ (0.125,-200) [-200|250] "m"  External
 SG_ VIS_OBS_LatVelocity_12 : 449|13@1+ (0.025,-50) [-50|50] "m/s"  External
 SG_ VIS_OBS_LongVelocity_12 : 462|13@1+ (0.025,-65) [-65|65] "m/s"  External
 SG_ VIS_OBS_LatAcc_12 : 475|12@1+ (0.01,-11) [-11|8] "m/s^2"  External
 SG_ VIS_OBS_LongAcc_12 : 487|12@1+ (0.01,-13) [-13|13] "m/s^2"  External
 SG_ VIS_OBS_CIPV_Lost_11 : 334|2@1+ (1,0) [0|2] "N/A"  External
 SG_ VIS_OBS_CIPV_Lost_12 : 332|2@1+ (1,0) [0|2] "N/A"  External

BO_ 1830 VIS_OBS_MSG_7_9: 64 IFV410
 SG_ VIS_OBS_ID_7 : 0|4@1+ (1,0) [0|15] "N/A"  External
 SG_ VIS_OBS_classification_7 : 4|3@1+ (1,0) [0|7] "N/A"  External
 SG_ VIS_OBS_age_7 : 7|32@1+ (1,0) [0|4294967295] "N/A"  External
 SG_ VIS_OBS_brakeLight_Indicator_7 : 39|1@1+ (1,0) [0|1] "N/A"  External
 SG_ VIS_OBS_turnRight_Indicator_7 : 40|1@1+ (1,0) [0|1] "N/A"  External
 SG_ VIS_OBS_turnLeft_Indicator_7 : 41|1@1+ (1,0) [0|1] "N/A"  External
 SG_ VIS_OBS_ttc_const_vel_7 : 42|3@1+ (1,0) [0|7] "s"  External
 SG_ VIS_OBS_laneAssignment_7 : 45|3@1+ (1,-2) [-2|3] "N/A"  External
 SG_ VIS_OBS_motionStatus_7 : 48|3@1+ (1,0) [0|4] "N/A"  External
 SG_ VIS_OBS_motionCategory_7 : 51|4@1+ (1,0) [0|12] "N/A"  External
 SG_ VIS_OBS_motionOrientation_7 : 55|4@1+ (1,0) [0|8] "N/A"  External
 SG_ VIS_OBS_width_7 : 59|9@1+ (0.01,0) [0.4|2.95] "m"  External
 SG_ VIS_OBS_height_7 : 68|9@1+ (0.01,0) [0|4.2] "m"  External
 SG_ VIS_OBS_heading_7 : 77|12@1+ (0.0025,-3.14) [-3.14|3.14] "radians"  External
 SG_ VIS_OBS_latDistance_7 : 89|12@1+ (0.125,-100) [-100|100] "m"  External
 SG_ VIS_OBS_longDistance_7 : 101|12@1+ (0.125,-200) [-200|250] "m"  External
 SG_ VIS_OBS_LatVelocity_7 : 113|13@1+ (0.025,-50) [-50|50] "m/s"  External
 SG_ VIS_OBS_LongVelocity_7 : 126|13@1+ (0.025,-65) [-65|65] "m/s"  External
 SG_ VIS_OBS_LatAcc_7 : 139|12@1+ (0.01,-11) [-11|8] "m/s^2"  External
 SG_ VIS_OBS_LongAcc_7 : 151|12@1+ (0.01,-13) [-13|13] "m/s^2"  External
 SG_ VIS_OBS_RC_counter_318 : 504|8@1+ (1,0) [0|255] "N/A"  External
 SG_ VIS_OBS_messsage_counter_318 : 500|4@1+ (1,0) [0|15] "N/A"  External
 SG_ VIS_OBS_CIPV_Lost_7 : 166|2@1+ (1,0) [0|2] "N/A"  External
 SG_ VIS_OBS_ID_8 : 168|4@1+ (1,0) [0|15] "N/A"  External
 SG_ VIS_OBS_classification_8 : 172|3@1+ (1,0) [0|7] "N/A"  External
 SG_ VIS_OBS_age_8 : 175|32@1+ (1,0) [0|4294967295] "N/A"  External
 SG_ VIS_OBS_brakeLight_Indicator_8 : 207|1@1+ (1,0) [0|1] "N/A"  External
 SG_ VIS_OBS_turnRight_Indicator_8 : 208|1@1+ (1,0) [0|1] "N/A"  External
 SG_ VIS_OBS_turnLeft_Indicator_8 : 209|1@1+ (1,0) [0|1] "N/A"  External
 SG_ VIS_OBS_ttc_const_vel_8 : 210|3@1+ (1,0) [0|7] "s"  External
 SG_ VIS_OBS_laneAssignment_8 : 213|3@1+ (1,-2) [-2|3] "N/A"  External
 SG_ VIS_OBS_motionStatus_8 : 216|3@1+ (1,0) [0|4] "N/A"  External
 SG_ VIS_OBS_motionCategory_8 : 219|4@1+ (1,0) [0|12] "N/A"  External
 SG_ VIS_OBS_motionOrientation_8 : 223|4@1+ (1,0) [0|8] "N/A"  External
 SG_ VIS_OBS_width_8 : 227|9@1+ (0.01,0) [0.4|2.95] "m"  External
 SG_ VIS_OBS_height_8 : 236|9@1+ (0.01,0) [0|4.2] "m"  External
 SG_ VIS_OBS_heading_8 : 245|12@1+ (0.0025,-3.14) [-3.14|3.14] "radians"  External
 SG_ VIS_OBS_latDistance_8 : 257|12@1+ (0.125,-100) [-100|100] "m"  External
 SG_ VIS_OBS_longDistance_8 : 269|12@1+ (0.125,-200) [-200|250] "m"  External
 SG_ VIS_OBS_LatVelocity_8 : 281|13@1+ (0.025,-50) [-50|50] "m/s"  External
 SG_ VIS_OBS_LongVelocity_8 : 294|13@1+ (0.025,-65) [-65|65] "m/s"  External
 SG_ VIS_OBS_LatAcc_8 : 307|12@1+ (0.01,-11) [-11|8] "m/s^2"  External
 SG_ VIS_OBS_LongAcc_8 : 319|12@1+ (0.01,-13) [-13|13] "m/s^2"  External
 SG_ VIS_OBS_ID_9 : 336|4@1+ (1,0) [0|15] "N/A"  External
 SG_ VIS_OBS_classification_9 : 340|3@1+ (1,0) [0|7] "N/A"  External
 SG_ VIS_OBS_age_9 : 343|32@1+ (1,0) [0|4294967295] "N/A"  External
 SG_ VIS_OBS_brakeLight_Indicator_9 : 375|1@1+ (1,0) [0|1] "N/A"  External
 SG_ VIS_OBS_turnRight_Indicator_9 : 376|1@1+ (1,0) [0|1] "N/A"  External
 SG_ VIS_OBS_turnLeft_Indicator_9 : 377|1@1+ (1,0) [0|1] "N/A"  External
 SG_ VIS_OBS_ttc_const_vel_9 : 378|3@1+ (1,0) [0|7] "s"  External
 SG_ VIS_OBS_laneAssignment_9 : 381|3@1+ (1,-2) [-2|3] "N/A"  External
 SG_ VIS_OBS_motionStatus_9 : 384|3@1+ (1,0) [0|4] "N/A"  External
 SG_ VIS_OBS_motionCategory_9 : 387|4@1+ (1,0) [0|12] "N/A"  External
 SG_ VIS_OBS_motionOrientation_9 : 391|4@1+ (1,0) [0|8] "N/A"  External
 SG_ VIS_OBS_width_9 : 395|9@1+ (0.01,0) [0.4|2.95] "m"  External
 SG_ VIS_OBS_height_9 : 404|9@1+ (0.01,0) [0|4.2] "m"  External
 SG_ VIS_OBS_heading_9 : 413|12@1+ (0.0025,-3.14) [-3.14|3.14] "radians"  External
 SG_ VIS_OBS_latDistance_9 : 425|12@1+ (0.125,-100) [-100|100] "m"  External
 SG_ VIS_OBS_longDistance_9 : 437|12@1+ (0.125,-200) [-200|250] "m"  External
 SG_ VIS_OBS_LatVelocity_9 : 449|13@1+ (0.025,-50) [-50|50] "m/s"  External
 SG_ VIS_OBS_LongVelocity_9 : 462|13@1+ (0.025,-65) [-65|65] "m/s"  External
 SG_ VIS_OBS_LatAcc_9 : 475|12@1+ (0.01,-11) [-11|8] "m/s^2"  External
 SG_ VIS_OBS_LongAcc_9 : 487|12@1+ (0.01,-13) [-13|13] "m/s^2"  External
 SG_ VIS_OBS_CIPV_Lost_8 : 334|2@1+ (1,0) [0|2] "N/A"  External
 SG_ VIS_OBS_CIPV_Lost_9 : 332|2@1+ (1,0) [0|2] "N/A"  External

BO_ 1829 VIS_OBS_MSG_4_6: 64 IFV410
 SG_ VIS_OBS_ID_4 : 0|4@1+ (1,0) [0|15] "N/A"  External
 SG_ VIS_OBS_classification_4 : 4|3@1+ (1,0) [0|7] "N/A"  External
 SG_ VIS_OBS_age_4 : 7|32@1+ (1,0) [0|4294967295] "N/A"  External
 SG_ VIS_OBS_brakeLight_Indicator_4 : 39|1@1+ (1,0) [0|1] "N/A"  External
 SG_ VIS_OBS_turnRight_Indicator_4 : 40|1@1+ (1,0) [0|1] "N/A"  External
 SG_ VIS_OBS_turnLeft_Indicator_4 : 41|1@1+ (1,0) [0|1] "N/A"  External
 SG_ VIS_OBS_ttc_const_vel_4 : 42|3@1+ (1,0) [0|7] "s"  External
 SG_ VIS_OBS_laneAssignment_4 : 45|3@1+ (1,-2) [-2|3] "N/A"  External
 SG_ VIS_OBS_motionStatus_4 : 48|3@1+ (1,0) [0|4] "N/A"  External
 SG_ VIS_OBS_motionCategory_4 : 51|4@1+ (1,0) [0|12] "N/A"  External
 SG_ VIS_OBS_motionOrientation_4 : 55|4@1+ (1,0) [0|8] "N/A"  External
 SG_ VIS_OBS_width_4 : 59|9@1+ (0.01,0) [0.4|2.95] "m"  External
 SG_ VIS_OBS_height_4 : 68|9@1+ (0.01,0) [0|4.2] "m"  External
 SG_ VIS_OBS_heading_4 : 77|12@1+ (0.0025,-3.14) [-3.14|3.14] "radians"  External
 SG_ VIS_OBS_latDistance_4 : 89|12@1+ (0.125,-100) [-100|100] "m"  External
 SG_ VIS_OBS_longDistance_4 : 101|12@1+ (0.125,-200) [-200|250] "m"  External
 SG_ VIS_OBS_LatVelocity_4 : 113|13@1+ (0.025,-50) [-50|50] "m/s"  External
 SG_ VIS_OBS_LongVelocity_4 : 126|13@1+ (0.025,-65) [-65|65] "m/s"  External
 SG_ VIS_OBS_LatAcc_4 : 139|12@1+ (0.01,-11) [-11|8] "m/s^2"  External
 SG_ VIS_OBS_LongAcc_4 : 151|12@1+ (0.01,-13) [-13|13] "m/s^2"  External
 SG_ VIS_OBS_RC_counter_317 : 504|8@1+ (1,0) [0|255] "N/A"  External
 SG_ VIS_OBS_messsage_counter_317 : 500|4@1+ (1,0) [0|15] "N/A"  External
 SG_ VIS_OBS_ID_5 : 168|4@1+ (1,0) [0|15] "N/A"  External
 SG_ VIS_OBS_classification_5 : 172|3@1+ (1,0) [0|7] "N/A"  External
 SG_ VIS_OBS_age_5 : 175|32@1+ (1,0) [0|4294967295] "N/A"  External
 SG_ VIS_OBS_brakeLight_Indicator_5 : 207|1@1+ (1,0) [0|1] "N/A"  External
 SG_ VIS_OBS_turnRight_Indicator_5 : 208|1@1+ (1,0) [0|1] "N/A"  External
 SG_ VIS_OBS_turnLeft_Indicator_5 : 209|1@1+ (1,0) [0|1] "N/A"  External
 SG_ VIS_OBS_ttc_const_vel_5 : 210|3@1+ (1,0) [0|7] "s"  External
 SG_ VIS_OBS_laneAssignment_5 : 213|3@1+ (1,-2) [-2|3] "N/A"  External
 SG_ VIS_OBS_motionStatus_5 : 216|3@1+ (1,0) [0|4] "N/A"  External
 SG_ VIS_OBS_motionCategory_5 : 219|4@1+ (1,0) [0|12] "N/A"  External
 SG_ VIS_OBS_motionOrientation_5 : 223|4@1+ (1,0) [0|8] "N/A"  External
 SG_ VIS_OBS_width_5 : 227|9@1+ (0.01,0) [0.4|2.95] "m"  External
 SG_ VIS_OBS_height_5 : 236|9@1+ (0.01,0) [0|4.2] "m"  External
 SG_ VIS_OBS_heading_5 : 245|12@1+ (0.0025,-3.14) [-3.14|3.14] "radians"  External
 SG_ VIS_OBS_latDistance_5 : 257|12@1+ (0.125,-100) [-100|100] "m"  External
 SG_ VIS_OBS_longDistance_5 : 269|12@1+ (0.125,-200) [-200|250] "m"  External
 SG_ VIS_OBS_LatVelocity_5 : 281|13@1+ (0.025,-50) [-50|50] "m/s"  External
 SG_ VIS_OBS_LongVelocity_5 : 294|13@1+ (0.025,-65) [-65|65] "m/s"  External
 SG_ VIS_OBS_LatAcc_5 : 307|12@1+ (0.01,-11) [-11|8] "m/s^2"  External
 SG_ VIS_OBS_LongAcc_5 : 319|12@1+ (0.01,-13) [-13|13] "m/s^2"  External
 SG_ VIS_OBS_ID_6 : 336|4@1+ (1,0) [0|15] "N/A"  External
 SG_ VIS_OBS_classification_6 : 340|3@1+ (1,0) [0|7] "N/A"  External
 SG_ VIS_OBS_age_6 : 343|32@1+ (1,0) [0|4294967295] "N/A"  External
 SG_ VIS_OBS_brakeLight_Indicator_6 : 375|1@1+ (1,0) [0|1] "N/A"  External
 SG_ VIS_OBS_turnRight_Indicator_6 : 376|1@1+ (1,0) [0|1] "N/A"  External
 SG_ VIS_OBS_turnLeft_Indicator_6 : 377|1@1+ (1,0) [0|1] "N/A"  External
 SG_ VIS_OBS_ttc_const_vel_6 : 378|3@1+ (1,0) [0|7] "s"  External
 SG_ VIS_OBS_laneAssignment_6 : 381|3@1+ (1,-2) [-2|3] "N/A"  External
 SG_ VIS_OBS_motionStatus_6 : 384|3@1+ (1,0) [0|4] "N/A"  External
 SG_ VIS_OBS_motionCategory_6 : 387|4@1+ (1,0) [0|12] "N/A"  External
 SG_ VIS_OBS_motionOrientation_6 : 391|4@1+ (1,0) [0|8] "N/A"  External
 SG_ VIS_OBS_width_6 : 395|9@1+ (0.01,0) [0.4|2.95] "m"  External
 SG_ VIS_OBS_height_6 : 404|9@1+ (0.01,0) [0|4.2] "m"  External
 SG_ VIS_OBS_heading_6 : 413|12@1+ (0.0025,-3.14) [-3.14|3.14] "radians"  External
 SG_ VIS_OBS_latDistance_6 : 425|12@1+ (0.125,-100) [-100|100] "m"  External
 SG_ VIS_OBS_longDistance_6 : 437|12@1+ (0.125,-200) [-200|250] "m"  External
 SG_ VIS_OBS_LatVelocity_6 : 449|13@1+ (0.025,-50) [-50|50] "m/s"  External
 SG_ VIS_OBS_LongVelocity_6 : 462|13@1+ (0.025,-65) [-65|65] "m/s"  External
 SG_ VIS_OBS_LatAcc_6 : 475|12@1+ (0.01,-11) [-11|8] "m/s^2"  External
 SG_ VIS_OBS_LongAcc_6 : 487|12@1+ (0.01,-13) [-13|13] "m/s^2"  External
 SG_ VIS_OBS_CIPV_Lost_4 : 166|2@1+ (1,0) [0|2] "N/A"  External
 SG_ VIS_OBS_CIPV_Lost_5 : 334|2@1+ (1,0) [0|2] "N/A"  External
 SG_ VIS_OBS_CIPV_Lost_6 : 332|2@1+ (1,0) [0|2] "N/A" Vector__XXX

BO_ 753 XCP_CWMP_SLAVE_CTO: 64 IFV410

BO_ 752 XCP_CWMP_MASTER_CTO: 64 External
 SG_ xcp_cwmp_master_cto_byte_7 : 56|8@1+ (1,0) [0|255] ""  IFV410
 SG_ xcp_cwmp_master_cto_byte_6 : 48|8@1+ (1,0) [0|255] ""  IFV410
 SG_ xcp_cwmp_master_cto_byte_5 : 40|8@1+ (1,0) [0|255] ""  IFV410
 SG_ xcp_cwmp_master_cto_byte_4 : 32|8@1+ (1,0) [0|255] ""  IFV410
 SG_ xcp_cwmp_master_cto_byte_3 : 24|8@1+ (1,0) [0|255] ""  IFV410
 SG_ xcp_cwmp_master_cto_byte_2 : 16|8@1+ (1,0) [0|255] ""  IFV410
 SG_ xcp_cwmp_master_cto_byte_1 : 8|8@1+ (1,0) [0|255] ""  IFV410
 SG_ xcp_cwmp_master_cto_byte_0 : 0|8@1+ (1,0) [0|255] ""  IFV410

BO_ 1811 Last_Ignition_Cycle_Fault_Table: 64 IFV410
 SG_ IP2_Timeout_For_Fuel_B22_2 : 274|1@1+ (1,0) [0|1] ""  External
 SG_ BCM3_Timeout_B20_1 : 257|1@1+ (1,0) [0|1] ""  External
 SG_ Intrinsic_Parameter_CRCErr_B1f_5 : 253|1@1+ (1,0) [0|1] ""  External
 SG_ Intrinsic_Parameter_Miss_B1f_4 : 252|1@1+ (1,0) [0|1] ""  External
 SG_ EyeQ_GPIO_Toggle_fail_B1e_6 : 246|1@1+ (1,0) [0|1] ""  External
 SG_ EQ_AppMissInputSignalErr_B1b_7 : 223|1@1+ (1,0) [0|1] ""  External
 SG_ EYEQ_43_ROADBOUNDCORRECT_B1b_6 : 222|1@1+ (1,0) [0|1] ""  External
 SG_ EYEQ_35_VD_CORRUPT_OUTPUTS_B10_1 : 129|1@1+ (1,0) [0|1] ""  External
 SG_ EYEQ_36_VD_OVERLAP_FAULT_B10_0 : 128|1@1+ (1,0) [0|1] ""  External
 SG_ EYEQ_37_VD_SANITY_FAULT_Bf_7 : 127|1@1+ (1,0) [0|1] ""  External
 SG_ EYEQ_52_VD_PREDICTION_VALI_Bf_6 : 126|1@1+ (1,0) [0|1] ""  External
 SG_ EYEQ_55_ROAD_LANEWIDTH_VALI_Be_5 : 117|1@1+ (1,0) [0|1] ""  External
 SG_ EYEQ_57_ROAD_HPP_MODEL_VALI_Be_4 : 116|1@1+ (1,0) [0|1] ""  External
 SG_ EYEQ_56_ROAD_PP_VALIDATION_Be_3 : 115|1@1+ (1,0) [0|1] ""  External
 SG_ EYEQ_38_PED_CORRUPT_OUTPUT_B7_3 : 59|1@1+ (1,0) [0|1] ""  External
 SG_ EYEQ_39_PED_OVERLAP_FAULT_B7_2 : 58|1@1+ (1,0) [0|1] ""  External
 SG_ EYEQ_40_PED_SANITY_FAULT_B7_1 : 57|1@1+ (1,0) [0|1] ""  External
 SG_ EYEQ_51_PED_PREDICT_VAL_B7_0 : 56|1@1+ (1,0) [0|1] ""  External
 SG_ AurixInternalMemoryFail_B4_6 : 38|1@1+ (1,0) [0|1] ""  External
 SG_ AurixInternalElectronicFail_B4_5 : 37|1@1+ (1,0) [0|1] ""  External
 SG_ Eyeq_Vision_Object_RFC_B3_3 : 27|1@1+ (1,0) [0|1] ""  External
 SG_ Eyeq_Vision_Object_CRC_B3_2 : 26|1@1+ (1,0) [0|1] ""  External
 SG_ SAS1_Timeout_B24_5 : 293|1@1+ (1,0) [0|1] ""  External
 SG_ SAS1_SteerWheelSpd_Invalid_B32_5 : 405|1@1+ (1,0) [0|1] ""  External
 SG_ SAS1_SteerWheelAng_Invalid_B32_4 : 404|1@1+ (1,0) [0|1] ""  External
 SG_ SAS1_SAS_Sts_Error_B32_7 : 407|1@1+ (1,0) [0|1] ""  External
 SG_ SAS1_RollingCounter_B36_7 : 439|1@1+ (1,0) [0|1] ""  External
 SG_ SAS1_Checksum_B3A_7 : 471|1@1+ (1,0) [0|1] ""  External
 SG_ RSDS_R2_Timeout_B26_7 : 311|1@1+ (1,0) [0|1] ""  External
 SG_ RSDS_R2_RollingCounter_B39_4 : 460|1@1+ (1,0) [0|1] ""  External
 SG_ RSDS_R1_Timeout_B22_7 : 279|1@1+ (1,0) [0|1] ""  External
 SG_ RSDS_R1_RiTarSts_Abnormal_B34_0 : 416|1@1+ (1,0) [0|1] ""  External
 SG_ RSDS_R1_CheckSum_B3D_7 : 495|1@1+ (1,0) [0|1] ""  External
 SG_ RSDS_L2_Timeout_B25_6 : 302|1@1+ (1,0) [0|1] ""  External
 SG_ RSDS_L2_RollingCounter_B39_1 : 457|1@1+ (1,0) [0|1] ""  External
 SG_ RSDS_L1_CheckSum_B3D_1 : 489|1@1+ (1,0) [0|1] ""  External
 SG_ HUT8_TSR_SnvtySet_Invalid_B30_3 : 387|1@1+ (1,0) [0|1] ""  External
 SG_ HUT8_Timeout_B24_7 : 295|1@1+ (1,0) [0|1] ""  External
 SG_ HUT8_IFC_SnvtySet_Abnormal_B2F_5 : 381|1@1+ (1,0) [0|1] ""  External
 SG_ HUT8_FCW_SnvtySet_Abnormal_B33_0 : 408|1@1+ (1,0) [0|1] ""  External
 SG_ HUT11_Timeout_B24_6 : 294|1@1+ (1,0) [0|1] ""  External
 SG_ HUT11_NavSpdLimValue_B28_6 : 326|1@1+ (1,0) [0|1] ""  External
 SG_ HUT11_NavSpdLimUnit_B28_7 : 327|1@1+ (1,0) [0|1] ""  External
 SG_ ECM9_ECM_ACCSwErr_Error_B32_6 : 406|1@1+ (1,0) [0|1] ""  External
 SG_ ECM1_DrivingModeDis_G_B35_7 : 431|1@1+ (1,0) [0|1] ""  External
 SG_ BCM8_WiperSwitchSts_Error_B30_6 : 390|1@1+ (1,0) [0|1] ""  External
 SG_ DCT2_TC_Slip_State_Error_B34_7 : 423|1@1+ (1,0) [0|1] ""  External
 SG_ EPS1_TrqSnsrSts_Abnormal_B31_7 : 399|1@1+ (1,0) [0|1] ""  External
 SG_ DCT3_RatAct_Error_B2e_7 : 375|1@1+ (1,0) [0|1] ""  External
 SG_ ECM2_EngState_Error_B2e_6 : 374|1@1+ (1,0) [0|1] ""  External
 SG_ APS4_Timeout_B26_6 : 310|1@1+ (1,0) [0|1] ""  External
 SG_ HAP_FD1_Timeout_B26_5 : 309|1@1+ (1,0) [0|1] ""  External
 SG_ DCT2_Timeout_B24_4 : 292|1@1+ (1,0) [0|1] ""  External
 SG_ SWP5_Missing_With_Default_B22_6 : 278|1@1+ (1,0) [0|1] ""  External
 SG_ SWP4_Missing_With_Default_B22_5 : 277|1@1+ (1,0) [0|1] ""  External
 SG_ SWP2_Missing_With_Default_B22_4 : 276|1@1+ (1,0) [0|1] ""  External
 SG_ SWP1_Missing_With_Default_B22_3 : 275|1@1+ (1,0) [0|1] ""  External
 SG_ Configure_DID_Missing_B20_0 : 256|1@1+ (1,0) [0|1] ""  External
 SG_ Sun_Rays_Fault_B11_7 : 143|1@1+ (1,0) [0|1] ""  External
 SG_ CAMERA_INTRINSIC_CAL_ERROR_Bf_4 : 124|1@1+ (1,0) [0|1] ""  External
 SG_ EYEQ_MINOR_ERROR_BM_EM_ERR_FAILE : 174|1@1+ (1,0) [0|1] ""  External
 SG_ EYEQ_STATIC_CRC_FAULT_B6_1 : 49|1@1+ (1,0) [0|1] ""  External
 SG_ FEE_E_GC_READ_FAULT_B1_4 : 12|1@1+ (1,0) [0|1] ""  External
 SG_ EYEQ_GEN_34_Corrupted_Vehicle_In : 121|1@1+ (1,0) [0|1] ""  External
 SG_ EYEQ_GEN_11_INPUT_CRC_MISMATCH_B : 120|1@1+ (1,0) [0|1] ""  External
 SG_ EYEQ_GEN_4_YAW_HORIZON_DEVIATION : 112|1@1+ (1,0) [0|1] ""  External
 SG_ EYEQ_GEN_18_IMAGER_DATA_ROWS_COL : 111|1@1+ (1,0) [0|1] ""  External
 SG_ EYEQ_GEN_13_OLD_EGODATA_LAT_Be_2 : 114|1@1+ (1,0) [0|1] ""  External
 SG_ AEB_shutdown_9_ROI_DIFF_VC_FCV_B : 107|1@1+ (1,0) [0|1] ""  External
 SG_ AEB_shutdown_7_POS_DIFF_KALMAN_V : 106|1@1+ (1,0) [0|1] ""  External
 SG_ EYEQ_GEN_50_VMP_SANITY_FAILED_FA : 216|1@1+ (1,0) [0|1] ""  External
 SG_ EYEQ_FATAL_ERROR_APP_CPS_STL_FAI : 146|1@1+ (1,0) [0|1] ""  External
 SG_ EYEQ_GEN_24_CCFT_DIFF_RESULTS_FA : 227|1@1+ (1,0) [0|1] ""  External
 SG_ EYEQ_53_DECELERATION_DBS_OVERLAP : 226|1@1+ (1,0) [0|1] ""  External
 SG_ EYEQ_44_ROAD_SANITY_CORRECTION_V : 225|1@1+ (1,0) [0|1] ""  External
 SG_ EYEQ_GEN_21_CAMERA_HEIGHT_LIMIT_ : 224|1@1+ (1,0) [0|1] ""  External
 SG_ EYEQ_FATAL_ERROR_APP_INVALID_INT : 221|1@1+ (1,0) [0|1] ""  External
 SG_ EYEQ_45_ROAD_SFCONF_VALIDATION_B : 218|1@1+ (1,0) [0|1] ""  External
 SG_ EYEQ_48_ALGO_PITCH_MISMATCH_B1b_ : 217|1@1+ (1,0) [0|1] ""  External
 SG_ EyeQ_Minor_Error_Bm_Error_Fault_ : 160|1@1+ (1,0) [0|1] ""  External
 SG_ EyeQ_Fatal_Error_App_Init_Failed : 150|1@1+ (1,0) [0|1] ""  External
 SG_ EyeQ_Fatal_Error_App_Init_Camera : 151|1@1+ (1,0) [0|1] ""  External
 SG_ EyeQ_Fatal_Error_App_Fs_Error_Fa : 148|1@1+ (1,0) [0|1] ""  External
 SG_ EyeQ_Fatal_Error_App_Error_Fault : 147|1@1+ (1,0) [0|1] ""  External
 SG_ EyeQ_Fatal_Error_App_Calibration : 149|1@1+ (1,0) [0|1] ""  External
 SG_ EYEQ_33_ROAD_LANE_DISQUALIFICATI : 220|1@1+ (1,0) [0|1] ""  External
 SG_ EYEQ_42_ROAD_PREDICTION_VALIDATI : 219|1@1+ (1,0) [0|1] ""  External
 SG_ EYEQ_MES_49_Data_Path_Corruption : 215|1@1+ (1,0) [0|1] ""  External
 SG_ EyeQ_Minor_Error_Bm_Em_Err_Faile : 172|1@1+ (1,0) [0|1] ""  External
 SG_ EyeQ_Minor_Error_Bm_Em_Error_Fau : 161|1@1+ (1,0) [0|1] ""  External
 SG_ EyeQ_Minor_Error_Bm_Em_Err__0000 : 170|1@1+ (1,0) [0|1] ""  External
 SG_ EyeQ_Minor_Error_Bm_Em_Err__0001 : 171|1@1+ (1,0) [0|1] ""  External
 SG_ EyeQ_Minor_Error_Bm_Em_Err__0002 : 168|1@1+ (1,0) [0|1] ""  External
 SG_ EyeQ_Minor_Error_Bm_Em_Err__0003 : 162|1@1+ (1,0) [0|1] ""  External
 SG_ EyeQ_Minor_Error_Bm_Em_Err__0004 : 163|1@1+ (1,0) [0|1] ""  External
 SG_ EyeQ_Minor_Error_Bm_Em_Err__0005 : 164|1@1+ (1,0) [0|1] ""  External
 SG_ EyeQ_Minor_Error_Bm_Em_Err__0006 : 165|1@1+ (1,0) [0|1] ""  External
 SG_ EyeQ_Minor_Error_Bm_Em_Err__0007 : 169|1@1+ (1,0) [0|1] ""  External
 SG_ EyeQ_Minor_Error_Bm_Em_Err__0008 : 167|1@1+ (1,0) [0|1] ""  External
 SG_ EyeQ_Minor_Error_Bm_Em_Err__0009 : 166|1@1+ (1,0) [0|1] ""  External
 SG_ EyeQ_Minor_Error_Bm_Em_Err__0010 : 173|1@1+ (1,0) [0|1] ""  External
 SG_ EyeQ_Fatal_Error_Pv_Verificattio : 159|1@1+ (1,0) [0|1] ""  External
 SG_ EyeQ_Fatal_Error_Pv_General_Erro : 158|1@1+ (1,0) [0|1] ""  External
 SG_ EyeQ_Fatal_Error_Pll_Comparison_ : 157|1@1+ (1,0) [0|1] ""  External
 SG_ EyeQ_Fatal_Error_App_Pattern_Tes : 155|1@1+ (1,0) [0|1] ""  External
 SG_ Host_ENET_VersionMismatch_Err_B8 : 68|1@1+ (1,0) [0|1] ""  External
 SG_ Host_ENET_Missing_Message_Err_B8 : 65|1@1+ (1,0) [0|1] ""  External
 SG_ VISION_OUTOFCALIBRATION_B12_0 : 144|1@1+ (1,0) [0|1] ""  External
 SG_ VCU6_RollingCounter_B39_3 : 459|1@1+ (1,0) [0|1] ""  External
 SG_ VCU6_CheckSum_B3d_3 : 491|1@1+ (1,0) [0|1] ""  External
 SG_ VCU5_Timeout_B28_5 : 325|1@1+ (1,0) [0|1] ""  External
 SG_ VCU5_SysFltLvl_Error_B33_7 : 415|1@1+ (1,0) [0|1] ""  External
 SG_ VCU5_RollingCounter_B39_2 : 458|1@1+ (1,0) [0|1] ""  External
 SG_ VCU5_SysFltLvl_Reserved_B33_6 : 414|1@1+ (1,0) [0|1] ""  External
 SG_ VCU5_CheckSum_B3d_2 : 490|1@1+ (1,0) [0|1] ""  External
 SG_ VCU2_RollingCounter_B39_0 : 456|1@1+ (1,0) [0|1] ""  External
 SG_ VCU2_CheckSum_B3d_0 : 488|1@1+ (1,0) [0|1] ""  External
 SG_ VCU12_RollingCounter_B39_5 : 461|1@1+ (1,0) [0|1] ""  External
 SG_ VCU12_CheckSum_B3d_5 : 493|1@1+ (1,0) [0|1] ""  External
 SG_ VCU_FD4_Timeout_B28_4 : 324|1@1+ (1,0) [0|1] ""  External
 SG_ VCU_FD3_Timeout_B28_3 : 323|1@1+ (1,0) [0|1] ""  External
 SG_ VCU_FD3_GearSts_Invalid_B33_2 : 410|1@1+ (1,0) [0|1] ""  External
 SG_ VCU_FD2_VCU_ACCComIfNoResp_B33_5 : 413|1@1+ (1,0) [0|1] ""  External
 SG_ VCU_FD2_Timeout_B28_2 : 322|1@1+ (1,0) [0|1] ""  External
 SG_ VCU_FD2_MinNegAvlTq_B33_3 : 411|1@1+ (1,0) [0|1] ""  External
 SG_ VCU_FD2_MaxPosAvlTq_B33_4 : 412|1@1+ (1,0) [0|1] ""  External
 SG_ VCU_FD1_Timeout_B28_1 : 321|1@1+ (1,0) [0|1] ""  External
 SG_ VCU_FD1_BrkPedlSts_Error_B2d_5 : 365|1@1+ (1,0) [0|1] ""  External
 SG_ VCU_FD1_APedlPos_Invalid_B2d_7 : 367|1@1+ (1,0) [0|1] ""  External
 SG_ VCAN_Bus_Off_Fault_B21_3 : 267|1@1+ (1,0) [0|1] ""  External
 SG_ Variant_Coding_Mismatch_B21_0 : 264|1@1+ (1,0) [0|1] ""  External
 SG_ TD_Blockage_Test_12_1 : 145|1@1+ (1,0) [0|1] ""  External
 SG_ SWP5_Mismatch_B20_6 : 262|1@1+ (1,0) [0|1] ""  External
 SG_ SWP4_Mismatch_B20_5 : 261|1@1+ (1,0) [0|1] ""  External
 SG_ SWP2_Mismatch_B20_4 : 260|1@1+ (1,0) [0|1] ""  External
 SG_ SWP1_Mismatch_B20_3 : 259|1@1+ (1,0) [0|1] ""  External
 SG_ Splashes_Fault_10_7 : 135|1@1+ (1,0) [0|1] ""  External
 SG_ SelfGlare_Fault_11_5 : 141|1@1+ (1,0) [0|1] ""  External
 SG_ RSDS_R_5_RollingCounter_B36_2 : 434|1@1+ (1,0) [0|1] ""  External
 SG_ RSDS_R_5_Checksum_B3a_2 : 466|1@1+ (1,0) [0|1] ""  External
 SG_ RSDS_R_4_RollingCounter_B36_1 : 433|1@1+ (1,0) [0|1] ""  External
 SG_ RSDS_R_4_Checksum_B3a_1 : 465|1@1+ (1,0) [0|1] ""  External
 SG_ RSDS_R_3_RollingCounter_B36_0 : 432|1@1+ (1,0) [0|1] ""  External
 SG_ RSDS_R_3_Checksum_B3a_0 : 464|1@1+ (1,0) [0|1] ""  External
 SG_ RSDS_FD1_Timeout_B26_3 : 307|1@1+ (1,0) [0|1] ""  External
 SG_ RSDS_FD1_RiTarSts_Abnormal_B32_3 : 403|1@1+ (1,0) [0|1] ""  External
 SG_ RSDS_FD1_LeTarSts_Abnormal_B32_2 : 402|1@1+ (1,0) [0|1] ""  External
 SG_ Rain_Severity_Level_11_4 : 140|1@1+ (1,0) [0|1] ""  External
 SG_ R_PBox1_Timeout_B24_2 : 290|1@1+ (1,0) [0|1] ""  External
 SG_ Partial_Blockage_Fault_10_5 : 133|1@1+ (1,0) [0|1] ""  External
 SG_ PARAMETERS_INVALID_Bc_6 : 102|1@1+ (1,0) [0|1] ""  External
 SG_ Out_Of_Focus_Fault_B11_1 : 137|1@1+ (1,0) [0|1] ""  External
 SG_ NVM_E_REQ_FAILED_B0_7 : 7|1@1+ (1,0) [0|1] ""  External
 SG_ NVM_E_QUEUE_OVERFLOW_FAULT_0_4 : 4|1@1+ (1,0) [0|1] ""  External
 SG_ NVM_E_LOSS_OF_REDUNDANCY_B0_6 : 6|1@1+ (1,0) [0|1] ""  External
 SG_ NVM_E_INTEGRITY_FAILED_FAULT_0_5 : 5|1@1+ (1,0) [0|1] ""  External
 SG_ NBID_CRC_BOOT_REPORTED_B8_0 : 64|1@1+ (1,0) [0|1] ""  External
 SG_ MISSING_CAMERA_CALIBRATION_Bf_5 : 125|1@1+ (1,0) [0|1] ""  External
 SG_ MCU4_RollingCounter_B39_6 : 462|1@1+ (1,0) [0|1] ""  External
 SG_ MCU4_CheckSum_B3d_6 : 494|1@1+ (1,0) [0|1] ""  External
 SG_ MCU_FD1_Timeout_B28_0 : 320|1@1+ (1,0) [0|1] ""  External
 SG_ MCU_FD1_ActTrq_Invalid_B33_1 : 409|1@1+ (1,0) [0|1] ""  External
 SG_ Low_Visibility_Fault_11_6 : 142|1@1+ (1,0) [0|1] ""  External
 SG_ Low_Sun_Fault_11_0 : 136|1@1+ (1,0) [0|1] ""  External
 SG_ KAM_Design_Write_Fail_Fault_Bb_5 : 93|1@1+ (1,0) [0|1] ""  External
 SG_ KAM_Design_Read_Fail_Fault_Bb_4 : 92|1@1+ (1,0) [0|1] ""  External
 SG_ IP2_Timeout_Bb25_2 : 298|1@1+ (1,0) [0|1] ""  External
 SG_ IP2_IP_Error_Bb31_5 : 397|1@1+ (1,0) [0|1] ""  External
 SG_ IP2_ACC_Error_Bb31_6 : 398|1@1+ (1,0) [0|1] ""  External
 SG_ Host_ENET_MessageReception_Err_B : 67|1@1+ (1,0) [0|1] ""  External
 SG_ IFC_FD1_0x12B_Mute_B22_1 : 273|1@1+ (1,0) [0|1] ""  External
 SG_ HUT_FD1_TSR_SnvtySet_B30_2 : 386|1@1+ (1,0) [0|1] ""  External
 SG_ HUT_FD1_Timeout_B26_2 : 306|1@1+ (1,0) [0|1] ""  External
 SG_ HUT_FD1_NavSpdLimValue_B30_4 : 388|1@1+ (1,0) [0|1] ""  External
 SG_ HUT_FD1_NavSpdLimUnit_B30_5 : 389|1@1+ (1,0) [0|1] ""  External
 SG_ HUT_FD1_LSSWarnFormSwtReq_B30_1 : 385|1@1+ (1,0) [0|1] ""  External
 SG_ HUT_FD1_IFC_SnvtySet_Abnor_B30_0 : 384|1@1+ (1,0) [0|1] ""  External
 SG_ HUT_FD1_FCW_SnvtySet_Abnor_B30_7 : 391|1@1+ (1,0) [0|1] ""  External
 SG_ HOST_HEATER_PWR_AURIX_B7_6 : 62|1@1+ (1,0) [0|1] ""  External
 SG_ Host_ENET_Missing_Data_Err_B8_2 : 66|1@1+ (1,0) [0|1] ""  External
 SG_ Host_Callibration_CRC_Fault_B8_6 : 70|1@1+ (1,0) [0|1] ""  External
 SG_ GRAB_VIDEO_TIMEOUT_B4_7 : 39|1@1+ (1,0) [0|1] ""  External
 SG_ Full_Blockage_Fault_10_4 : 132|1@1+ (1,0) [0|1] ""  External
 SG_ Frozen_Windshield_Fault_11_3 : 139|1@1+ (1,0) [0|1] ""  External
 SG_ Foggy_Spots_Fault_11_2 : 138|1@1+ (1,0) [0|1] ""  External
 SG_ FET_Fault_Across_cycles_B2_4 : 20|1@1+ (1,0) [0|1] ""  External
 SG_ FET_Fail_Across_Cycles_B2_5 : 21|1@1+ (1,0) [0|1] ""  External
 SG_ FEE_E_WRITE_FAULT_B1_1 : 9|1@1+ (1,0) [0|1] ""  External
 SG_ FEE_E_WRITE_CYCLES_EXHAUST_B2_0 : 16|1@1+ (1,0) [0|1] ""  External
 SG_ FEE_E_UNCONFIG_BLK_EXCEED_B2_2 : 18|1@1+ (1,0) [0|1] ""  External
 SG_ FEE_E_READ_FAULT_B1_2 : 10|1@1+ (1,0) [0|1] ""  External
 SG_ FEE_E_INVALIDATE_FAULT_B1_7 : 15|1@1+ (1,0) [0|1] ""  External
 SG_ FEE_E_GC_WRITE_FAULT_B1_3 : 11|1@1+ (1,0) [0|1] ""  External
 SG_ FEE_E_GC_TRIG_FAULT_B2_1 : 17|1@1+ (1,0) [0|1] ""  External
 SG_ FEE_E_GC_INIT_FAULT_B1_0 : 8|1@1+ (1,0) [0|1] ""  External
 SG_ FEE_E_GC_ERASE_FAULT_B1_6 : 14|1@1+ (1,0) [0|1] ""  External
 SG_ FactoryMode_B20_7 : 263|1@1+ (1,0) [0|1] ""  External
 SG_ F_PBox1_Timeout_B24_3 : 291|1@1+ (1,0) [0|1] ""  External
 SG_ EYQQ_ROAD_INFO_COUNTER_ERROR_2_6 : 22|1@1+ (1,0) [0|1] ""  External
 SG_ EYEQ_VISION_SAFETY_DIAG_RFC_B5_3 : 43|1@1+ (1,0) [0|1] ""  External
 SG_ EYEQ_VISION_SAFETY_DIAG_CRC_B5_2 : 42|1@1+ (1,0) [0|1] ""  External
 SG_ EYEQ_VISION_AEB_INFO_RFC_B5_1 : 41|1@1+ (1,0) [0|1] ""  External
 SG_ EYEQ_VISION_AEB_INFO_CRC_B5_0 : 40|1@1+ (1,0) [0|1] ""  External
 SG_ EYEQ_VIS_OBSTACLES_INFO_RFC_B5_6 : 46|1@1+ (1,0) [0|1] ""  External
 SG_ EYEQ_VIS_OBSTACLES_INFO_CRC_B5_5 : 45|1@1+ (1,0) [0|1] ""  External
 SG_ EYEQ_VIS_FAILSAFESRFCFAULT_B6_4 : 52|1@1+ (1,0) [0|1] ""  External
 SG_ EYEQ_VIS_FAILSAFESCRCFAULT_B6_3 : 51|1@1+ (1,0) [0|1] ""  External
 SG_ EYEQ_STATIC_RFC_FAULT_B6_2 : 50|1@1+ (1,0) [0|1] ""  External
 SG_ EYEQ_DYNAMIC_RFC_FAULT_B6_0 : 48|1@1+ (1,0) [0|1] ""  External
 SG_ EYEQ_DYNAMIC_CRC_FAULT_B5_7 : 47|1@1+ (1,0) [0|1] ""  External
 SG_ EYEQ_ROAD_INFO_CRC_FAULT_B5_4 : 44|1@1+ (1,0) [0|1] ""  External
 SG_ EYEQ_OTA_SWAP_FAULT_B7_5 : 61|1@1+ (1,0) [0|1] ""  External
 SG_ EyeQ_MESP_Coding_failure_B9_1 : 73|1@1+ (1,0) [0|1] ""  External
 SG_ EYEQ_GEN_CR_ERR_FAULT_B2_3 : 19|1@1+ (1,0) [0|1] ""  External
 SG_ EYEQ_GEN_31_AEB_PARAM_FFI_Be_6 : 118|1@1+ (1,0) [0|1] ""  External
 SG_ EYEQ_GEN_29_RFC_ERR_Be_7 : 119|1@1+ (1,0) [0|1] ""  External
 SG_ EyeQ_DDR_RAM_CRC_Bb_7 : 95|1@1+ (1,0) [0|1] ""  External
 SG_ ESP2_VehStandstill_Invalid_B2c_2 : 354|1@1+ (1,0) [0|1] ""  External
 SG_ ESP2_Timeout_B27_4 : 316|1@1+ (1,0) [0|1] ""  External
 SG_ ESP2_RollingCounter_B37_4 : 444|1@1+ (1,0) [0|1] ""  External
 SG_ ESP2_HDCCtrl_Abnormal_B35_5 : 429|1@1+ (1,0) [0|1] ""  External
 SG_ ESP2_DrivingModDis_Abnor_B35_6 : 430|1@1+ (1,0) [0|1] ""  External
 SG_ ESP2_CheckSum_B3b_4 : 476|1@1+ (1,0) [0|1] ""  External
 SG_ ESP2_CDDAvailable_Error_B2c_0 : 352|1@1+ (1,0) [0|1] ""  External
 SG_ ESP2_AWBAvailable_Error_B2d_2 : 362|1@1+ (1,0) [0|1] ""  External
 SG_ ESP2_AEBAvailable_Error_B2c_4 : 356|1@1+ (1,0) [0|1] ""  External
 SG_ ESP2_ABPAvailable_Error_B2c_6 : 358|1@1+ (1,0) [0|1] ""  External
 SG_ ESP2_ABAavailable_Error_B2d_0 : 360|1@1+ (1,0) [0|1] ""  External
 SG_ ESP1_Timeout_B27_3 : 315|1@1+ (1,0) [0|1] ""  External
 SG_ ESP1_RollingCounter_B37_3 : 443|1@1+ (1,0) [0|1] ""  External
 SG_ ESP1_MasterCylBrkPress_B2b_0 : 344|1@1+ (1,0) [0|1] ""  External
 SG_ ESP1_ESPFailSts_Failure_B2b_6 : 350|1@1+ (1,0) [0|1] ""  External
 SG_ ESP1_CheckSum_B3b_3 : 475|1@1+ (1,0) [0|1] ""  External
 SG_ ESP_FD3_Timeout_B27_7 : 319|1@1+ (1,0) [0|1] ""  External
 SG_ ESP_FD3_SwtPosn_Invalid_B2e_1 : 369|1@1+ (1,0) [0|1] ""  External
 SG_ ESP_FD3_RRWheelSpd_Invalid_B2a_7 : 343|1@1+ (1,0) [0|1] ""  External
 SG_ ESP_FD3_RRWhDriveDirection_B29_3 : 331|1@1+ (1,0) [0|1] ""  External
 SG_ ESP_FD3_RLWheelSpd_Invalid_B2a_5 : 341|1@1+ (1,0) [0|1] ""  External
 SG_ ESP_FD3_RLWhDriveDirection_B29_1 : 329|1@1+ (1,0) [0|1] ""  External
 SG_ ESP_FD3_FRWheelSpd_Invalid_B2a_3 : 339|1@1+ (1,0) [0|1] ""  External
 SG_ ESP_FD3_FRWhDriveDirection_B29_7 : 335|1@1+ (1,0) [0|1] ""  External
 SG_ ESP_FD3_FLWheelSpd_Invalid_B2a_1 : 337|1@1+ (1,0) [0|1] ""  External
 SG_ ESP_FD3_FLWhDriveDirection_B29_5 : 333|1@1+ (1,0) [0|1] ""  External
 SG_ ESP_FD3_EPBSts_Error_B2e_5 : 373|1@1+ (1,0) [0|1] ""  External
 SG_ ESP_FD3_EPBErrSts_Error_B2e_3 : 371|1@1+ (1,0) [0|1] ""  External
 SG_ ESP_FD3_EPB1_RollCounter_B38_2 : 450|1@1+ (1,0) [0|1] ""  External
 SG_ ESP_FD3_EPB1_CheckSum_B3c_2 : 482|1@1+ (1,0) [0|1] ""  External
 SG_ ESP_FD3_ABS2_RollCounter_B38_4 : 452|1@1+ (1,0) [0|1] ""  External
 SG_ ESP_FD3_ABS2_CheckSum_B3c_4 : 484|1@1+ (1,0) [0|1] ""  External
 SG_ ESP_FD3_ABS1_RollCounter_B38_3 : 451|1@1+ (1,0) [0|1] ""  External
 SG_ ESP_FD3_ABS1_CheckSum_B3c_3 : 483|1@1+ (1,0) [0|1] ""  External
 SG_ ESP_FD2_VehStandstill_B2c_3 : 355|1@1+ (1,0) [0|1] ""  External
 SG_ ESP_FD2_VehSpd_Missing_B21_5 : 269|1@1+ (1,0) [0|1] ""  External
 SG_ ESP_FD2_VehSpd_Invalid_B2b_5 : 349|1@1+ (1,0) [0|1] ""  External
 SG_ ESP_FD2_Timeout_B27_6 : 318|1@1+ (1,0) [0|1] ""  External
 SG_ ESP_FD2_MasterCylBrkPress_B2b_1 : 345|1@1+ (1,0) [0|1] ""  External
 SG_ ESP_FD2_ESPFailSts_Failure_B2b_7 : 351|1@1+ (1,0) [0|1] ""  External
 SG_ ESP_FD2_ESP2_RollCounter_B38_7 : 455|1@1+ (1,0) [0|1] ""  External
 SG_ ESP_FD2_ESP2_CheckSum_B3c_7 : 487|1@1+ (1,0) [0|1] ""  External
 SG_ ESP_FD2_ESP1_RollCounter_B38_6 : 454|1@1+ (1,0) [0|1] ""  External
 SG_ ESP_FD2_ESP1_CheckSum_B3c_6 : 486|1@1+ (1,0) [0|1] ""  External
 SG_ ESP_FD2_CDDAvailable_Error_B2c_1 : 353|1@1+ (1,0) [0|1] ""  External
 SG_ ESP_FD2_AWBAvailable_Error_B2d_3 : 363|1@1+ (1,0) [0|1] ""  External
 SG_ ESP_FD2_AEBAvailable_Error_B2c_5 : 357|1@1+ (1,0) [0|1] ""  External
 SG_ ESP_FD2_ABSFailSts_Failure_B2b_3 : 347|1@1+ (1,0) [0|1] ""  External
 SG_ ESP_FD2_ABS3_RollCounter_B38_5 : 453|1@1+ (1,0) [0|1] ""  External
 SG_ ESP_FD2_ABS3_CheckSum_B3c_5 : 485|1@1+ (1,0) [0|1] ""  External
 SG_ ESP_FD2_ABPAvailable_Error_B2c_7 : 359|1@1+ (1,0) [0|1] ""  External
 SG_ ESP_FD2_ABAavailable_Error_B2d_1 : 361|1@1+ (1,0) [0|1] ""  External
 SG_ EPS2_Timeout_B26_1 : 305|1@1+ (1,0) [0|1] ""  External
 SG_ EPS2_RollingCounter_B36_6 : 438|1@1+ (1,0) [0|1] ""  External
 SG_ EPS2_LKATrqOvlDlvdSts_Temp_B2f_6 : 382|1@1+ (1,0) [0|1] ""  External
 SG_ EPS2_LKATrqOvlDlvdSts_Perm_B2f_7 : 383|1@1+ (1,0) [0|1] ""  External
 SG_ EPS2_CheckSum_B3a_6 : 470|1@1+ (1,0) [0|1] ""  External
 SG_ EPS1_Timeout_B26_0 : 304|1@1+ (1,0) [0|1] ""  External
 SG_ EPS1_SteerMod_Abnormal_B32_1 : 401|1@1+ (1,0) [0|1] ""  External
 SG_ EPS1_EPSFailSts_Failure_B32_0 : 400|1@1+ (1,0) [0|1] ""  External
 SG_ EPB1_Timeout_B27_5 : 317|1@1+ (1,0) [0|1] ""  External
 SG_ EPB1_SwtPosn_Invalid_B2e_0 : 368|1@1+ (1,0) [0|1] ""  External
 SG_ EPB1_RollingCounter_B37_5 : 445|1@1+ (1,0) [0|1] ""  External
 SG_ EPB1_EPBSts_Error_B2e_4 : 372|1@1+ (1,0) [0|1] ""  External
 SG_ EPB1_EPBErrSts_Error_B2e_2 : 370|1@1+ (1,0) [0|1] ""  External
 SG_ EPB1_CheckSum_B3b_5 : 477|1@1+ (1,0) [0|1] ""  External
 SG_ ECM9_Timeout_B23_6 : 286|1@1+ (1,0) [0|1] ""  External
 SG_ ECM9_RollingCounter_B38_1 : 449|1@1+ (1,0) [0|1] ""  External
 SG_ ECM9_ECMACCInterface_Error_B34_6 : 422|1@1+ (1,0) [0|1] ""  External
 SG_ ECM9_Checksum_B3c_1 : 481|1@1+ (1,0) [0|1] ""  External
 SG_ ECM8_TrqLoss_Invalid_B34_5 : 421|1@1+ (1,0) [0|1] ""  External
 SG_ ECM8_Timeout_B23_5 : 285|1@1+ (1,0) [0|1] ""  External
 SG_ ECM7_Timeout_B23_4 : 284|1@1+ (1,0) [0|1] ""  External
 SG_ ECM4_Timeout_B23_3 : 283|1@1+ (1,0) [0|1] ""  External
 SG_ ECM4_RollingCounter_B38_0 : 448|1@1+ (1,0) [0|1] ""  External
 SG_ ECM4_NetEngTrq_Invalid_B34_3 : 419|1@1+ (1,0) [0|1] ""  External
 SG_ ECM4_DrvEngTrqReq_Invalid_B34_4 : 420|1@1+ (1,0) [0|1] ""  External
 SG_ ECM4_Checksum_B3c_0 : 480|1@1+ (1,0) [0|1] ""  External
 SG_ ECM3_Timeout_B23_2 : 282|1@1+ (1,0) [0|1] ""  External
 SG_ ECM3_MaxEngTrqNorm_Abnorm_B34_2 : 418|1@1+ (1,0) [0|1] ""  External
 SG_ ECM2_Timeout_B23_1 : 281|1@1+ (1,0) [0|1] ""  External
 SG_ ECM2_AccelPedalPosn_Invd_B2d_6 : 366|1@1+ (1,0) [0|1] ""  External
 SG_ ECM1_Timeout_B23_0 : 280|1@1+ (1,0) [0|1] ""  External
 SG_ ECM1_Start_StopSts_Invalid_B34_1 : 417|1@1+ (1,0) [0|1] ""  External
 SG_ ECM1_RollingCounter_B37_7 : 447|1@1+ (1,0) [0|1] ""  External
 SG_ ECM1_Checksum_B3b_7 : 479|1@1+ (1,0) [0|1] ""  External
 SG_ ECM1_BrkPedalSts_Error_B2d_4 : 364|1@1+ (1,0) [0|1] ""  External
 SG_ DCT7_Timeout_B24_1 : 289|1@1+ (1,0) [0|1] ""  External
 SG_ DCT7_DrvFaiMsg_Failure_B35_4 : 428|1@1+ (1,0) [0|1] ""  External
 SG_ DCT5_Timeout_B24_0 : 288|1@1+ (1,0) [0|1] ""  External
 SG_ DCT5_TGS_LEVER_Invalid_B35_3 : 427|1@1+ (1,0) [0|1] ""  External
 SG_ DCT5_TARGET_GEAR_Invalid_B35_2 : 426|1@1+ (1,0) [0|1] ""  External
 SG_ DCT5_ShiftInPrg_Invalid_B35_1 : 425|1@1+ (1,0) [0|1] ""  External
 SG_ DCT5_RollingCounter_B37_6 : 446|1@1+ (1,0) [0|1] ""  External
 SG_ DCT5_CurrentGear_Invalid_B35_0 : 424|1@1+ (1,0) [0|1] ""  External
 SG_ DCT5_CheckSum_B3b_6 : 478|1@1+ (1,0) [0|1] ""  External
 SG_ DCT3_Timeout_B23_7 : 287|1@1+ (1,0) [0|1] ""  External
 SG_ CSA2_Timeout_B25_4 : 300|1@1+ (1,0) [0|1] ""  External
 SG_ CSA2_SteerWheelSpd_Invalid_B31_2 : 394|1@1+ (1,0) [0|1] ""  External
 SG_ CSA2_SteerWheelAng_Invalid_B31_1 : 393|1@1+ (1,0) [0|1] ""  External
 SG_ CSA2_SAS_Sts_Error_B31_4 : 396|1@1+ (1,0) [0|1] ""  External
 SG_ CSA2_Rollingcounter_B36_5 : 437|1@1+ (1,0) [0|1] ""  External
 SG_ CSA2_Checksum_B3a_5 : 469|1@1+ (1,0) [0|1] ""  External
 SG_ CSA2_CC_ACCSwt_Error_B31_3 : 395|1@1+ (1,0) [0|1] ""  External
 SG_ CSA1_Timeout_B25_3 : 299|1@1+ (1,0) [0|1] ""  External
 SG_ CSA1_FrntWiprSwtSts_Error_B31_0 : 392|1@1+ (1,0) [0|1] ""  External
 SG_ Blurred_Image_Fault_B10_6 : 134|1@1+ (1,0) [0|1] ""  External
 SG_ BCM8_WiprReq_Invalid_B2f_4 : 380|1@1+ (1,0) [0|1] ""  External
 SG_ BCM8_Timeout_B25_7 : 303|1@1+ (1,0) [0|1] ""  External
 SG_ BCM1_Timeout_B25_5 : 301|1@1+ (1,0) [0|1] ""  External
 SG_ AEB_shutdown_Invalid_Reason_Bd_1 : 105|1@1+ (1,0) [0|1] ""  External
 SG_ AEB_shutdown_4_DT_ERR_Bd_6 : 110|1@1+ (1,0) [0|1] ""  External
 SG_ AEB_shutdown_6_FCV_FCW_TTC_Bd_4 : 108|1@1+ (1,0) [0|1] ""  External
 SG_ AEB_shutdown_27_FcvSigFfi_Bf_2 : 122|1@1+ (1,0) [0|1] ""  External
 SG_ AEB_shutdown_25_CO_FOF_DIFF_Bd_5 : 109|1@1+ (1,0) [0|1] ""  External
 SG_ AEB_Safety_Violation_B21_7 : 271|1@1+ (1,0) [0|1] ""  External
 SG_ ACC_Safety_Violation_B22_0 : 272|1@1+ (1,0) [0|1] ""  External
 SG_ AC2_Timeout_B26_4 : 308|1@1+ (1,0) [0|1] ""  External
 SG_ AC2_ACAmbTemp_Invalid_B2f_3 : 379|1@1+ (1,0) [0|1] ""  External
 SG_ ABS3_VehSpd_Missing_B21_4 : 268|1@1+ (1,0) [0|1] ""  External
 SG_ ABS3_VehSpd_Invalid_B2b_4 : 348|1@1+ (1,0) [0|1] ""  External
 SG_ ABS3_ABSFailSts_Failure_B2b_2 : 346|1@1+ (1,0) [0|1] ""  External
 SG_ ABS2_RRWheelSpd_Invalid_B2a_6 : 342|1@1+ (1,0) [0|1] ""  External
 SG_ ABS2_RRWhDirection_Invalid_B29_2 : 330|1@1+ (1,0) [0|1] ""  External
 SG_ ABS2_RLWheelSpd_Invalid_B2a_4 : 340|1@1+ (1,0) [0|1] ""  External
 SG_ ABS2_RLWhDirection_Invalid_B29_0 : 328|1@1+ (1,0) [0|1] ""  External
 SG_ ABS1_FRWheelSpd_Invalid_B2a_2 : 338|1@1+ (1,0) [0|1] ""  External
 SG_ ABS1_FRWhDirection_Invalid_B29_6 : 334|1@1+ (1,0) [0|1] ""  External
 SG_ ABS1_FLWheelSpd_Invalid_B2a_0 : 336|1@1+ (1,0) [0|1] ""  External
 SG_ ABS1_FLWhDirection_Invalid_B29_4 : 332|1@1+ (1,0) [0|1] ""  External
 SG_ ABS3_Timeout_B27_2 : 314|1@1+ (1,0) [0|1] ""  External
 SG_ ABS2_Timeout_B27_1 : 313|1@1+ (1,0) [0|1] ""  External
 SG_ ABS3_RollingCounter_B37_2 : 442|1@1+ (1,0) [0|1] ""  External
 SG_ ABS2_RollingCounter_B37_1 : 441|1@1+ (1,0) [0|1] ""  External
 SG_ ABS3_CheckSum_B3b_2 : 474|1@1+ (1,0) [0|1] ""  External
 SG_ ABS2_CheckSum_B3b_1 : 473|1@1+ (1,0) [0|1] ""  External
 SG_ ABS1_Timeout_B27_0 : 312|1@1+ (1,0) [0|1] ""  External
 SG_ ABS1_RollingCounter_B37_0 : 440|1@1+ (1,0) [0|1] ""  External
 SG_ ABS1_CheckSum_B3b_0 : 472|1@1+ (1,0) [0|1] ""  External
 SG_ ABM2_VehYawRate_Missing_B21_6 : 270|1@1+ (1,0) [0|1] ""  External
 SG_ ABM2_VehYawRate_Invalid_B2f_0 : 376|1@1+ (1,0) [0|1] ""  External
 SG_ ABM2_VehLgtAccel_Invalid_B2f_1 : 377|1@1+ (1,0) [0|1] ""  External
 SG_ ABM2_VehLatAccel_Invalid_B2f_2 : 378|1@1+ (1,0) [0|1] ""  External
 SG_ ABM2_Timeout_B25_1 : 297|1@1+ (1,0) [0|1] ""  External
 SG_ ABM2_RollingCounter_B36_4 : 436|1@1+ (1,0) [0|1] ""  External
 SG_ ABM2_CheckSum_B3a_4 : 468|1@1+ (1,0) [0|1] ""  External
 SG_ ABM1_Timeout_B25_0 : 296|1@1+ (1,0) [0|1] ""  External
 SG_ ABM1_RollingCounter_B36_3 : 435|1@1+ (1,0) [0|1] ""  External
 SG_ ABM1_CheckSum_B3a_3 : 467|1@1+ (1,0) [0|1] ""  External
 SG_ Vision_Internal_Error_B1f_6 : 254|1@1+ (1,0) [0|1] ""  External
 SG_ EyeQ_Spi_Msg_Timeout_A_7 : 87|1@1+ (1,0) [0|1] ""  External
 SG_ Host_Spi_CRC_Error_A_2 : 82|1@1+ (1,0) [0|1] ""  External
 SG_ Host_Spi_Tx_Error_A_1 : 81|1@1+ (1,0) [0|1] ""  External
 SG_ Host_spi_msg_timeout_A_0 : 80|1@1+ (1,0) [0|1] ""  External
 SG_ EyeQ_Calibration_Checksum_9_4 : 76|1@1+ (1,0) [0|1] ""  External
 SG_ Imager_2V8_Supply_OutRange_6_7 : 55|1@1+ (1,0) [0|1] ""  External
 SG_ Aurix_1V25_Supply_OutRange_B6_6 : 54|1@1+ (1,0) [0|1] ""  External
 SG_ Imager_1V2_Supply_OutRange_6_5 : 53|1@1+ (1,0) [0|1] ""  External
 SG_ Battery_High_Fault_B21_2 : 266|1@1+ (1,0) [0|1] ""  External
 SG_ Battery_Low_Fault_B21_1 : 265|1@1+ (1,0) [0|1] ""  External
 SG_ PS_5V0_Out_Of_Range_4_4 : 36|1@1+ (1,0) [0|1] ""  External
 SG_ EyeQDDROnBrdThermstorOutRang_4_3 : 35|1@1+ (1,0) [0|1] ""  External
 SG_ EyeQDDROnBrdThermstorOveTemp_4_1 : 33|1@1+ (1,0) [0|1] ""  External
 SG_ EyeQ_Temp_Exceeded_3_0 : 24|1@1+ (1,0) [0|1] ""  External
 SG_ SYSTEM_OVER_TEMPERATURE_2_7 : 23|1@1+ (1,0) [0|1] ""  External
 SG_ EyeQ_Error_Out_Temp_Fault_1A_6 : 214|1@1+ (1,0) [0|1] ""  External
 SG_ EyeQErrOutSignalInternFault_1A_5 : 213|1@1+ (1,0) [0|1] ""  External
 SG_ EyeQ_Camera1_Temp_Fault_1A_4 : 212|1@1+ (1,0) [0|1] ""  External
 SG_ EyeQVdoErrFlg_ShotOutOfSync_1A_3 : 211|1@1+ (1,0) [0|1] ""  External
 SG_ EyeQVdoErrFlg_VdiErrShutdwn_1A_2 : 210|1@1+ (1,0) [0|1] ""  External
 SG_ EyeQVdoErrFlg_HdrVerifiErr_1A_1 : 209|1@1+ (1,0) [0|1] ""  External
 SG_ EyeQVdoErrFlg_CcftDecisionMismat : 208|1@1+ (1,0) [0|1] ""  External
 SG_ EyeQVdoErrFlg_HistogramsMismatch : 207|1@1+ (1,0) [0|1] ""  External
 SG_ EyeQVdoErrFlg_FrameCountReadFail : 206|1@1+ (1,0) [0|1] ""  External
 SG_ EyeQVdoErrFlgVdiErr_CoreIdFlt : 205|1@1+ (1,0) [0|1] ""  External
 SG_ EyeQVdoErrFlgVdiErr_StrtAftStrt : 204|1@1+ (1,0) [0|1] ""  External
 SG_ EyeQVdoErrFlgVdiErr_ParityHisFlt : 203|1@1+ (1,0) [0|1] ""  External
 SG_ EyeQVdoErrFlgVdiErr_ParityGamma : 202|1@1+ (1,0) [0|1] ""  External
 SG_ EyeQVdoErrFlgVdiErr_ParityWeight : 201|1@1+ (1,0) [0|1] ""  External
 SG_ EyeQVdoErrFlgVdiErr_ParityFifo : 200|1@1+ (1,0) [0|1] ""  External
 SG_ EyeQVdoErrFlgVdiErrFifo_Undflow : 199|1@1+ (1,0) [0|1] ""  External
 SG_ EyeQVdoErrFlgVdiErrFifo_Overflow : 198|1@1+ (1,0) [0|1] ""  External
 SG_ EyeQVdoErrFlgVdiErr_Timeout_18_5 : 197|1@1+ (1,0) [0|1] ""  External
 SG_ EyeQVdoErrFlgVdiErr_BuffInvldFmt : 196|1@1+ (1,0) [0|1] ""  External
 SG_ EyeQVdoErrFlg_Vdi_ErrNoBuff_18_3 : 195|1@1+ (1,0) [0|1] ""  External
 SG_ EyeQVdoErrFlgVdi_InternErr18_2 : 194|1@1+ (1,0) [0|1] ""  External
 SG_ EyeQVdoErrFlgSumNotMatHistgrmErr : 193|1@1+ (1,0) [0|1] ""  External
 SG_ EyeQVdoErrFlgZeroHistgrmErr_18_0 : 192|1@1+ (1,0) [0|1] ""  External
 SG_ EyeQVdoErrFlgRegWrtHilFailErr : 191|1@1+ (1,0) [0|1] ""  External
 SG_ EyeQVdoErrFlgErrRegFlagFlt_17_6 : 190|1@1+ (1,0) [0|1] ""  External
 SG_ EyeQVdoErrFlgInvldVdoHeaderFault : 189|1@1+ (1,0) [0|1] ""  External
 SG_ EyeQVdoErrFlgVerifiFailVdoErr : 188|1@1+ (1,0) [0|1] ""  External
 SG_ EyeQVdoErrFlgInconstFramVdoErr : 187|1@1+ (1,0) [0|1] ""  External
 SG_ EyeQ_Cam1VdoErrFlgLgcVdoErr_17_2 : 186|1@1+ (1,0) [0|1] ""  External
 SG_ EyeQCam1VdoErrFlgI2CNoOnTmVdoErr : 185|1@1+ (1,0) [0|1] ""  External
 SG_ EyeQCam1VdoErrFlgVdiVdoErr_17_0 : 184|1@1+ (1,0) [0|1] ""  External
 SG_ EyeQ_Cam_Vdo_Flt_16_7 : 183|1@1+ (1,0) [0|1] ""  External
 SG_ EyeQ_Cam_Ctrl_Flt_16_6 : 182|1@1+ (1,0) [0|1] ""  External
 SG_ EyeQ_Cam_Mal_Func_16_5 : 181|1@1+ (1,0) [0|1] ""  External
 SG_ Grab_Release_Failure_16_4 : 180|1@1+ (1,0) [0|1] ""  External
 SG_ Grab_Acquire_Failure_16_3 : 179|1@1+ (1,0) [0|1] ""  External
 SG_ Grab_Issue_Failure_16_2 : 178|1@1+ (1,0) [0|1] ""  External
 SG_ Grab_No_Free_Header_Failure_16_1 : 177|1@1+ (1,0) [0|1] ""  External
 SG_ Init_I2C_Failure_16_0 : 176|1@1+ (1,0) [0|1] ""  External
 SG_ Init_Vdi_Failure_15_7 : 175|1@1+ (1,0) [0|1] ""  External
 SG_ EyeQFatalErrApCamParaCcftCrc13_4 : 156|1@1+ (1,0) [0|1] ""  External
 SG_ EyeQFatalErrAppI2CTimoutErr_13_2 : 154|1@1+ (1,0) [0|1] ""  External
 SG_ EyeQFatalErrAppI2CCamSlfRst_13_1 : 153|1@1+ (1,0) [0|1] ""  External
 SG_ EyeQFatalErrAppI2CVidoGrb_13_0 : 152|1@1+ (1,0) [0|1] ""  External
 SG_ EYEQ_GEN54ACCSTLEXECUTFAILED_F_3 : 123|1@1+ (1,0) [0|1] ""  External
 SG_ EYEQ_GEN_26_CODE_CRC_E_1 : 113|1@1+ (1,0) [0|1] ""  External
 SG_ EyeQ_Core_Dump_Fault_C_5 : 101|1@1+ (1,0) [0|1] ""  External
 SG_ EyeQ_Init_Timeout_Fault_C_4 : 100|1@1+ (1,0) [0|1] ""  External
 SG_ EYEQ4_Mode_Fault_C_3 : 99|1@1+ (1,0) [0|1] ""  External
 SG_ EyeQ_Bist_Memory_Fault_C_2 : 98|1@1+ (1,0) [0|1] ""  External
 SG_ EyeQ_Core_Fault_C_1 : 97|1@1+ (1,0) [0|1] ""  External
 SG_ EyeQ_Boot_Fault_C_0 : 96|1@1+ (1,0) [0|1] ""  External
 SG_ EyeQ_DDR_Fault_B_6 : 94|1@1+ (1,0) [0|1] ""  External
 SG_ EyeQ_SerialFlashPowerUp_Fail_B_1 : 89|1@1+ (1,0) [0|1] ""  External
 SG_ EyeQ_SPI_CRC_ERROR_B_0 : 88|1@1+ (1,0) [0|1] ""  External
 SG_ EYEQ_Spi_Msg_Format_Error_A_6 : 86|1@1+ (1,0) [0|1] ""  External
 SG_ EyeQ_Spi_Frame_Format_Error_A_5 : 85|1@1+ (1,0) [0|1] ""  External
 SG_ Spi_Ipc_Comm_Reset_A_4 : 84|1@1+ (1,0) [0|1] ""  External
 SG_ Spi_version_mismatch_A_3 : 83|1@1+ (1,0) [0|1] ""  External
 SG_ Host_Spi_Msg_Format_Error_9_7 : 79|1@1+ (1,0) [0|1] ""  External
 SG_ Host_Spi_Frame_Format_Error_9_6 : 78|1@1+ (1,0) [0|1] ""  External
 SG_ EyeQ_Application_Checksum_9_3 : 75|1@1+ (1,0) [0|1] ""  External
 SG_ EyeQAppl_CompltAndComptibl_9_2 : 74|1@1+ (1,0) [0|1] ""  External
 SG_ EyeQOnBoardThermstorOutRange_4_2 : 34|1@1+ (1,0) [0|1] ""  External
 SG_ EyeQ_DDR_Over_Temp_4_0 : 32|1@1+ (1,0) [0|1] ""  External
 SG_ EyeQ_Boot_OverTemp_Fault_3_7 : 31|1@1+ (1,0) [0|1] ""  External
 SG_ EyeQ_Imager_Over_Temp_3_6 : 30|1@1+ (1,0) [0|1] ""  External
 SG_ EyeQ_VMP_Over_Temp_3_5 : 29|1@1+ (1,0) [0|1] ""  External
 SG_ EyeQ_MIPS_Over_Temp_3_4 : 28|1@1+ (1,0) [0|1] ""  External
 SG_ EyeQOnBoardThermistorOveTemp_3_1 : 25|1@1+ (1,0) [0|1] ""  External
 SG_ EYEQ_1V0_SUPPLY_OUT_OF_RANGE_0_3 : 3|1@1+ (1,0) [0|1] ""  External
 SG_ EYEQ_1V1_SUPPLY_OUT_OF_RANGE_0_2 : 2|1@1+ (1,0) [0|1] ""  External
 SG_ EYEQ_1V8_SUPPLY_OUT_OF_RANGE_0_1 : 1|1@1+ (1,0) [0|1] ""  External
 SG_ EYEQ_3V3_SUPPLY_OUT_OF_RANGE_0_0 : 0|1@1+ (1,0) [0|1] ""  External
 SG_ Windshield_heater_OPNLD_Error_B3 : 496|1@1+ (1,0) [0|1] ""  External
 SG_ WWINDSHIELD_HEATER_STG_FAULT_B3E : 497|1@1+ (1,0) [0|1] ""  External
 SG_ WINDSHIELD_HEATER_OVRLD_FAULT_B3 : 498|1@1+ (1,0) [0|1] ""  External
 SG_ WINDSHIELD_HEATER_STB_FAULT_B3E_ : 499|1@1+ (1,0) [0|1] ""  External

BO_ 1810 History_Fault: 64 IFV410
 SG_ IP2_Timeout_For_Fuel_B22_2 : 274|1@1+ (1,0) [0|1] ""  External
 SG_ BCM3_Timeout_B20_1 : 257|1@1+ (1,0) [0|1] ""  External
 SG_ Intrinsic_Parameter_CRCErr_B1f_5 : 253|1@1+ (1,0) [0|1] ""  External
 SG_ Intrinsic_Parameter_Miss_B1f_4 : 252|1@1+ (1,0) [0|1] ""  External
 SG_ EyeQ_GPIO_Toggle_fail_B1e_6 : 246|1@1+ (1,0) [0|1] ""  External
 SG_ EQ_AppMissInputSignalErr_B1b_7 : 223|1@1+ (1,0) [0|1] ""  External
 SG_ EYEQ_43_ROADBOUNDCORRECT_B1b_6 : 222|1@1+ (1,0) [0|1] ""  External
 SG_ EYEQ_35_VD_CORRUPT_OUTPUTS_B10_1 : 129|1@1+ (1,0) [0|1] ""  External
 SG_ EYEQ_36_VD_OVERLAP_FAULT_B10_0 : 128|1@1+ (1,0) [0|1] ""  External
 SG_ EYEQ_37_VD_SANITY_FAULT_Bf_7 : 127|1@1+ (1,0) [0|1] ""  External
 SG_ EYEQ_52_VD_PREDICTION_VALI_Bf_6 : 126|1@1+ (1,0) [0|1] ""  External
 SG_ EYEQ_55_ROAD_LANEWIDTH_VALI_Be_5 : 117|1@1+ (1,0) [0|1] ""  External
 SG_ EYEQ_57_ROAD_HPP_MODEL_VALI_Be_4 : 116|1@1+ (1,0) [0|1] ""  External
 SG_ EYEQ_56_ROAD_PP_VALIDATION_Be_3 : 115|1@1+ (1,0) [0|1] ""  External
 SG_ EYEQ_38_PED_CORRUPT_OUTPUT_B7_3 : 59|1@1+ (1,0) [0|1] ""  External
 SG_ EYEQ_39_PED_OVERLAP_FAULT_B7_2 : 58|1@1+ (1,0) [0|1] ""  External
 SG_ EYEQ_40_PED_SANITY_FAULT_B7_1 : 57|1@1+ (1,0) [0|1] ""  External
 SG_ EYEQ_51_PED_PREDICT_VAL_B7_0 : 56|1@1+ (1,0) [0|1] ""  External
 SG_ AurixInternalMemoryFail_B4_6 : 38|1@1+ (1,0) [0|1] ""  External
 SG_ AurixInternalElectronicFail_B4_5 : 37|1@1+ (1,0) [0|1] ""  External
 SG_ Eyeq_Vision_Object_RFC_B3_3 : 27|1@1+ (1,0) [0|1] ""  External
 SG_ Eyeq_Vision_Object_CRC_B3_2 : 26|1@1+ (1,0) [0|1] ""  External
 SG_ SAS1_Timeout_B24_5 : 293|1@1+ (1,0) [0|1] ""  External
 SG_ SAS1_SteerWheelSpd_Invalid_B32_5 : 405|1@1+ (1,0) [0|1] ""  External
 SG_ SAS1_SteerWheelAng_Invalid_B32_4 : 404|1@1+ (1,0) [0|1] ""  External
 SG_ SAS1_SAS_Sts_Error_B32_7 : 407|1@1+ (1,0) [0|1] ""  External
 SG_ SAS1_RollingCounter_B36_7 : 439|1@1+ (1,0) [0|1] ""  External
 SG_ SAS1_Checksum_B3A_7 : 471|1@1+ (1,0) [0|1] ""  External
 SG_ RSDS_R2_Timeout_B26_7 : 311|1@1+ (1,0) [0|1] ""  External
 SG_ RSDS_R2_RollingCounter_B39_4 : 460|1@1+ (1,0) [0|1] ""  External
 SG_ RSDS_R1_Timeout_B22_7 : 279|1@1+ (1,0) [0|1] ""  External
 SG_ RSDS_R1_RiTarSts_Abnormal_B34_0 : 416|1@1+ (1,0) [0|1] ""  External
 SG_ RSDS_R1_CheckSum_B3D_7 : 495|1@1+ (1,0) [0|1] ""  External
 SG_ RSDS_L2_Timeout_B25_6 : 302|1@1+ (1,0) [0|1] ""  External
 SG_ RSDS_L2_RollingCounter_B39_1 : 457|1@1+ (1,0) [0|1] ""  External
 SG_ RSDS_L1_CheckSum_B3D_1 : 489|1@1+ (1,0) [0|1] ""  External
 SG_ HUT8_TSR_SnvtySet_Invalid_B30_3 : 387|1@1+ (1,0) [0|1] ""  External
 SG_ HUT8_Timeout_B24_7 : 295|1@1+ (1,0) [0|1] ""  External
 SG_ HUT8_IFC_SnvtySet_Abnormal_B2F_5 : 381|1@1+ (1,0) [0|1] ""  External
 SG_ HUT8_FCW_SnvtySet_Abnormal_B33_0 : 408|1@1+ (1,0) [0|1] ""  External
 SG_ HUT11_Timeout_B24_6 : 294|1@1+ (1,0) [0|1] ""  External
 SG_ HUT11_NavSpdLimValue_B28_6 : 326|1@1+ (1,0) [0|1] ""  External
 SG_ HUT11_NavSpdLimUnit_B28_7 : 327|1@1+ (1,0) [0|1] ""  External
 SG_ ECM9_ECM_ACCSwErr_Error_B32_6 : 406|1@1+ (1,0) [0|1] ""  External
 SG_ ECM1_DrivingModeDis_G_B35_7 : 431|1@1+ (1,0) [0|1] ""  External
 SG_ BCM8_WiperSwitchSts_Error_B30_6 : 390|1@1+ (1,0) [0|1] ""  External
 SG_ DCT2_TC_Slip_State_Error_B34_7 : 423|1@1+ (1,0) [0|1] ""  External
 SG_ EPS1_TrqSnsrSts_Abnormal_B31_7 : 399|1@1+ (1,0) [0|1] ""  External
 SG_ DCT3_RatAct_Error_B2e_7 : 375|1@1+ (1,0) [0|1] ""  External
 SG_ ECM2_EngState_Error_B2e_6 : 374|1@1+ (1,0) [0|1] ""  External
 SG_ APS4_Timeout_B26_6 : 310|1@1+ (1,0) [0|1] ""  External
 SG_ HAP_FD1_Timeout_B26_5 : 309|1@1+ (1,0) [0|1] ""  External
 SG_ DCT2_Timeout_B24_4 : 292|1@1+ (1,0) [0|1] ""  External
 SG_ SWP5_Missing_With_Default_B22_6 : 278|1@1+ (1,0) [0|1] ""  External
 SG_ SWP4_Missing_With_Default_B22_5 : 277|1@1+ (1,0) [0|1] ""  External
 SG_ SWP2_Missing_With_Default_B22_4 : 276|1@1+ (1,0) [0|1] ""  External
 SG_ SWP1_Missing_With_Default_B22_3 : 275|1@1+ (1,0) [0|1] ""  External
 SG_ Configure_DID_Missing_B20_0 : 256|1@1+ (1,0) [0|1] ""  External
 SG_ Sun_Rays_Fault_B11_7 : 143|1@1+ (1,0) [0|1] ""  External
 SG_ CAMERA_INTRINSIC_CAL_ERROR_Bf_4 : 124|1@1+ (1,0) [0|1] ""  External
 SG_ EYEQ_MINOR_ERROR_BM_EM_ERR__0000 : 174|1@1+ (1,0) [0|1] ""  External
 SG_ EYEQ_STATIC_CRC_FAULT_B6_1 : 49|1@1+ (1,0) [0|1] ""  External
 SG_ FEE_E_GC_READ_FAULT_B1_4 : 12|1@1+ (1,0) [0|1] ""  External
 SG_ EYEQ_GEN_34_Corrupted_Vehic_0000 : 121|1@1+ (1,0) [0|1] ""  External
 SG_ EYEQ_GEN_11_INPUT_CRC_MISMA_0000 : 120|1@1+ (1,0) [0|1] ""  External
 SG_ EYEQ_GEN_4_YAW_HORIZON_DEVI_0000 : 112|1@1+ (1,0) [0|1] ""  External
 SG_ EYEQ_GEN_18_IMAGER_DATA_ROW_0000 : 111|1@1+ (1,0) [0|1] ""  External
 SG_ EYEQ_GEN_13_OLD_EGODATA_LAT_Be_2 : 114|1@1+ (1,0) [0|1] ""  External
 SG_ AEB_shutdown_9_ROI_DIFF_VC__0000 : 107|1@1+ (1,0) [0|1] ""  External
 SG_ AEB_shutdown_7_POS_DIFF_KAL_0000 : 106|1@1+ (1,0) [0|1] ""  External
 SG_ EYEQ_GEN_50_VMP_SANITY_FAIL_0000 : 216|1@1+ (1,0) [0|1] ""  External
 SG_ EYEQ_FATAL_ERROR_APP_CPS_ST_0000 : 146|1@1+ (1,0) [0|1] ""  External
 SG_ EYEQ_GEN_24_CCFT_DIFF_RESUL_0000 : 227|1@1+ (1,0) [0|1] ""  External
 SG_ EYEQ_53_DECELERATION_DBS_OV_0000 : 226|1@1+ (1,0) [0|1] ""  External
 SG_ EYEQ_44_ROAD_SANITY_CORRECT_0000 : 225|1@1+ (1,0) [0|1] ""  External
 SG_ EYEQ_GEN_21_CAMERA_HEIGHT_L_0000 : 224|1@1+ (1,0) [0|1] ""  External
 SG_ EYEQ_FATAL_ERROR_APP_INVALI_0000 : 221|1@1+ (1,0) [0|1] ""  External
 SG_ EYEQ_45_ROAD_SFCONF_VALIDAT_0000 : 218|1@1+ (1,0) [0|1] ""  External
 SG_ EYEQ_48_ALGO_PITCH_MISMATCH_0000 : 217|1@1+ (1,0) [0|1] ""  External
 SG_ EyeQ_Minor_Error_Bm_Error_F_0000 : 160|1@1+ (1,0) [0|1] ""  External
 SG_ EyeQ_Fatal_Error_App_Init_F_0000 : 150|1@1+ (1,0) [0|1] ""  External
 SG_ EyeQ_Fatal_Error_App_Init_C_0000 : 151|1@1+ (1,0) [0|1] ""  External
 SG_ EyeQ_Fatal_Error_App_Fs_Err_0000 : 148|1@1+ (1,0) [0|1] ""  External
 SG_ EyeQ_Fatal_Error_App_Error__0000 : 147|1@1+ (1,0) [0|1] ""  External
 SG_ EyeQ_Fatal_Error_App_Calibr_0000 : 149|1@1+ (1,0) [0|1] ""  External
 SG_ EYEQ_33_ROAD_LANE_DISQUALIF_0000 : 220|1@1+ (1,0) [0|1] ""  External
 SG_ EYEQ_42_ROAD_PREDICTION_VAL_0000 : 219|1@1+ (1,0) [0|1] ""  External
 SG_ EYEQ_MES_49_Data_Path_Corru_0000 : 215|1@1+ (1,0) [0|1] ""  External
 SG_ EyeQ_Minor_Error_Bm_Em_Err__0011 : 172|1@1+ (1,0) [0|1] ""  External
 SG_ EyeQ_Minor_Error_Bm_Em_Erro_0000 : 161|1@1+ (1,0) [0|1] ""  External
 SG_ EyeQ_Minor_Error_Bm_Em_Err__0012 : 170|1@1+ (1,0) [0|1] ""  External
 SG_ EyeQ_Minor_Error_Bm_Em_Err__0013 : 171|1@1+ (1,0) [0|1] ""  External
 SG_ EyeQ_Minor_Error_Bm_Em_Err__0014 : 168|1@1+ (1,0) [0|1] ""  External
 SG_ EyeQ_Minor_Error_Bm_Em_Err__0015 : 162|1@1+ (1,0) [0|1] ""  External
 SG_ EyeQ_Minor_Error_Bm_Em_Err__0016 : 163|1@1+ (1,0) [0|1] ""  External
 SG_ EyeQ_Minor_Error_Bm_Em_Err__0017 : 164|1@1+ (1,0) [0|1] ""  External
 SG_ EyeQ_Minor_Error_Bm_Em_Err__0018 : 165|1@1+ (1,0) [0|1] ""  External
 SG_ EyeQ_Minor_Error_Bm_Em_Err__0019 : 169|1@1+ (1,0) [0|1] ""  External
 SG_ EyeQ_Minor_Error_Bm_Em_Err__0020 : 167|1@1+ (1,0) [0|1] ""  External
 SG_ EyeQ_Minor_Error_Bm_Em_Err__0021 : 166|1@1+ (1,0) [0|1] ""  External
 SG_ EyeQ_Minor_Error_Bm_Em_Err__0022 : 173|1@1+ (1,0) [0|1] ""  External
 SG_ EyeQ_Fatal_Error_Pv_Verific_0000 : 159|1@1+ (1,0) [0|1] ""  External
 SG_ EyeQ_Fatal_Error_Pv_General_0000 : 158|1@1+ (1,0) [0|1] ""  External
 SG_ EyeQ_Fatal_Error_Pll_Compar_0000 : 157|1@1+ (1,0) [0|1] ""  External
 SG_ EyeQ_Fatal_Error_App_Patter_0000 : 155|1@1+ (1,0) [0|1] ""  External
 SG_ Host_ENET_VersionMismatch_E_0000 : 68|1@1+ (1,0) [0|1] ""  External
 SG_ Host_ENET_Missing_Message_E_0000 : 65|1@1+ (1,0) [0|1] ""  External
 SG_ VISION_OUTOFCALIBRATION_B12_0 : 144|1@1+ (1,0) [0|1] ""  External
 SG_ VCU6_RollingCounter_B39_3 : 459|1@1+ (1,0) [0|1] ""  External
 SG_ VCU6_CheckSum_B3d_3 : 491|1@1+ (1,0) [0|1] ""  External
 SG_ VCU5_Timeout_B28_5 : 325|1@1+ (1,0) [0|1] ""  External
 SG_ VCU5_SysFltLvl_Error_B33_7 : 415|1@1+ (1,0) [0|1] ""  External
 SG_ VCU5_RollingCounter_B39_2 : 458|1@1+ (1,0) [0|1] ""  External
 SG_ VCU5_SysFltLvl_Reserved_B33_6 : 414|1@1+ (1,0) [0|1] ""  External
 SG_ VCU5_CheckSum_B3d_2 : 490|1@1+ (1,0) [0|1] ""  External
 SG_ VCU2_RollingCounter_B39_0 : 456|1@1+ (1,0) [0|1] ""  External
 SG_ VCU2_CheckSum_B3d_0 : 488|1@1+ (1,0) [0|1] ""  External
 SG_ VCU12_RollingCounter_B39_5 : 461|1@1+ (1,0) [0|1] ""  External
 SG_ VCU12_CheckSum_B3d_5 : 493|1@1+ (1,0) [0|1] ""  External
 SG_ VCU_FD4_Timeout_B28_4 : 324|1@1+ (1,0) [0|1] ""  External
 SG_ VCU_FD3_Timeout_B28_3 : 323|1@1+ (1,0) [0|1] ""  External
 SG_ VCU_FD3_GearSts_Invalid_B33_2 : 410|1@1+ (1,0) [0|1] ""  External
 SG_ VCU_FD2_VCU_ACCComIfNoResp_B33_5 : 413|1@1+ (1,0) [0|1] ""  External
 SG_ VCU_FD2_Timeout_B28_2 : 322|1@1+ (1,0) [0|1] ""  External
 SG_ VCU_FD2_MinNegAvlTq_B33_3 : 411|1@1+ (1,0) [0|1] ""  External
 SG_ VCU_FD2_MaxPosAvlTq_B33_4 : 412|1@1+ (1,0) [0|1] ""  External
 SG_ VCU_FD1_Timeout_B28_1 : 321|1@1+ (1,0) [0|1] ""  External
 SG_ VCU_FD1_BrkPedlSts_Error_B2d_5 : 365|1@1+ (1,0) [0|1] ""  External
 SG_ VCU_FD1_APedlPos_Invalid_B2d_7 : 367|1@1+ (1,0) [0|1] ""  External
 SG_ VCAN_Bus_Off_Fault_B21_3 : 267|1@1+ (1,0) [0|1] ""  External
 SG_ Variant_Coding_Mismatch_B21_0 : 264|1@1+ (1,0) [0|1] ""  External
 SG_ TD_Blockage_Test_12_1 : 145|1@1+ (1,0) [0|1] ""  External
 SG_ SWP5_Mismatch_B20_6 : 262|1@1+ (1,0) [0|1] ""  External
 SG_ SWP4_Mismatch_B20_5 : 261|1@1+ (1,0) [0|1] ""  External
 SG_ SWP2_Mismatch_B20_4 : 260|1@1+ (1,0) [0|1] ""  External
 SG_ SWP1_Mismatch_B20_3 : 259|1@1+ (1,0) [0|1] ""  External
 SG_ Splashes_Fault_10_7 : 135|1@1+ (1,0) [0|1] ""  External
 SG_ SelfGlare_Fault_11_5 : 141|1@1+ (1,0) [0|1] ""  External
 SG_ RSDS_R_5_RollingCounter_B36_2 : 434|1@1+ (1,0) [0|1] ""  External
 SG_ RSDS_R_5_Checksum_B3a_2 : 466|1@1+ (1,0) [0|1] ""  External
 SG_ RSDS_R_4_RollingCounter_B36_1 : 433|1@1+ (1,0) [0|1] ""  External
 SG_ RSDS_R_4_Checksum_B3a_1 : 465|1@1+ (1,0) [0|1] ""  External
 SG_ RSDS_R_3_RollingCounter_B36_0 : 432|1@1+ (1,0) [0|1] ""  External
 SG_ RSDS_R_3_Checksum_B3a_0 : 464|1@1+ (1,0) [0|1] ""  External
 SG_ RSDS_FD1_Timeout_B26_3 : 307|1@1+ (1,0) [0|1] ""  External
 SG_ RSDS_FD1_RiTarSts_Abnormal_B32_3 : 403|1@1+ (1,0) [0|1] ""  External
 SG_ RSDS_FD1_LeTarSts_Abnormal_B32_2 : 402|1@1+ (1,0) [0|1] ""  External
 SG_ Rain_Severity_Level_11_4 : 140|1@1+ (1,0) [0|1] ""  External
 SG_ R_PBox1_Timeout_B24_2 : 290|1@1+ (1,0) [0|1] ""  External
 SG_ Partial_Blockage_Fault_10_5 : 133|1@1+ (1,0) [0|1] ""  External
 SG_ PARAMETERS_INVALID_Bc_6 : 102|1@1+ (1,0) [0|1] ""  External
 SG_ Out_Of_Focus_Fault_B11_1 : 137|1@1+ (1,0) [0|1] ""  External
 SG_ NVM_E_REQ_FAILED_B0_7 : 7|1@1+ (1,0) [0|1] ""  External
 SG_ NVM_E_QUEUE_OVERFLOW_FAULT_0_4 : 4|1@1+ (1,0) [0|1] ""  External
 SG_ NVM_E_LOSS_OF_REDUNDANCY_B0_6 : 6|1@1+ (1,0) [0|1] ""  External
 SG_ NVM_E_INTEGRITY_FAILED_FAULT_0_5 : 5|1@1+ (1,0) [0|1] ""  External
 SG_ NBID_CRC_BOOT_REPORTED_B8_0 : 64|1@1+ (1,0) [0|1] ""  External
 SG_ MISSING_CAMERA_CALIBRATION_Bf_5 : 125|1@1+ (1,0) [0|1] ""  External
 SG_ MCU4_RollingCounter_B39_6 : 462|1@1+ (1,0) [0|1] ""  External
 SG_ MCU4_CheckSum_B3d_6 : 494|1@1+ (1,0) [0|1] ""  External
 SG_ MCU_FD1_Timeout_B28_0 : 320|1@1+ (1,0) [0|1] ""  External
 SG_ MCU_FD1_ActTrq_Invalid_B33_1 : 409|1@1+ (1,0) [0|1] ""  External
 SG_ Low_Visibility_Fault_11_6 : 142|1@1+ (1,0) [0|1] ""  External
 SG_ Low_Sun_Fault_11_0 : 136|1@1+ (1,0) [0|1] ""  External
 SG_ KAM_Design_Write_Fail_Fault_Bb_5 : 93|1@1+ (1,0) [0|1] ""  External
 SG_ KAM_Design_Read_Fail_Fault_Bb_4 : 92|1@1+ (1,0) [0|1] ""  External
 SG_ IP2_Timeout_Bb25_2 : 298|1@1+ (1,0) [0|1] ""  External
 SG_ IP2_IP_Error_Bb31_5 : 397|1@1+ (1,0) [0|1] ""  External
 SG_ IP2_ACC_Error_Bb31_6 : 398|1@1+ (1,0) [0|1] ""  External
 SG_ Host_ENET_MessageReception__0000 : 67|1@1+ (1,0) [0|1] ""  External
 SG_ IFC_FD1_0x12B_Mute_B22_1 : 273|1@1+ (1,0) [0|1] ""  External
 SG_ HUT_FD1_TSR_SnvtySet_B30_2 : 386|1@1+ (1,0) [0|1] ""  External
 SG_ HUT_FD1_Timeout_B26_2 : 306|1@1+ (1,0) [0|1] ""  External
 SG_ HUT_FD1_NavSpdLimValue_B30_4 : 388|1@1+ (1,0) [0|1] ""  External
 SG_ HUT_FD1_NavSpdLimUnit_B30_5 : 389|1@1+ (1,0) [0|1] ""  External
 SG_ HUT_FD1_LSSWarnFormSwtReq_B30_1 : 385|1@1+ (1,0) [0|1] ""  External
 SG_ HUT_FD1_IFC_SnvtySet_Abnor_B30_0 : 384|1@1+ (1,0) [0|1] ""  External
 SG_ HUT_FD1_FCW_SnvtySet_Abnor_B30_7 : 391|1@1+ (1,0) [0|1] ""  External
 SG_ HOST_HEATER_PWR_AURIX_B7_6 : 62|1@1+ (1,0) [0|1] ""  External
 SG_ Host_ENET_Missing_Data_Err_B8_2 : 66|1@1+ (1,0) [0|1] ""  External
 SG_ Host_Callibration_CRC_Fault_B8_6 : 70|1@1+ (1,0) [0|1] ""  External
 SG_ GRAB_VIDEO_TIMEOUT_B4_7 : 39|1@1+ (1,0) [0|1] ""  External
 SG_ Full_Blockage_Fault_10_4 : 132|1@1+ (1,0) [0|1] ""  External
 SG_ Frozen_Windshield_Fault_11_3 : 139|1@1+ (1,0) [0|1] ""  External
 SG_ Foggy_Spots_Fault_11_2 : 138|1@1+ (1,0) [0|1] ""  External
 SG_ FET_Fault_Across_cycles_B2_4 : 20|1@1+ (1,0) [0|1] ""  External
 SG_ FET_Fail_Across_Cycles_B2_5 : 21|1@1+ (1,0) [0|1] ""  External
 SG_ FEE_E_WRITE_FAULT_B1_1 : 9|1@1+ (1,0) [0|1] ""  External
 SG_ FEE_E_WRITE_CYCLES_EXHAUST_B2_0 : 16|1@1+ (1,0) [0|1] ""  External
 SG_ FEE_E_UNCONFIG_BLK_EXCEED_B2_2 : 18|1@1+ (1,0) [0|1] ""  External
 SG_ FEE_E_READ_FAULT_B1_2 : 10|1@1+ (1,0) [0|1] ""  External
 SG_ FEE_E_INVALIDATE_FAULT_B1_7 : 15|1@1+ (1,0) [0|1] ""  External
 SG_ FEE_E_GC_WRITE_FAULT_B1_3 : 11|1@1+ (1,0) [0|1] ""  External
 SG_ FEE_E_GC_TRIG_FAULT_B2_1 : 17|1@1+ (1,0) [0|1] ""  External
 SG_ FEE_E_GC_INIT_FAULT_B1_0 : 8|1@1+ (1,0) [0|1] ""  External
 SG_ FEE_E_GC_ERASE_FAULT_B1_6 : 14|1@1+ (1,0) [0|1] ""  External
 SG_ FactoryMode_B20_7 : 263|1@1+ (1,0) [0|1] ""  External
 SG_ F_PBox1_Timeout_B24_3 : 291|1@1+ (1,0) [0|1] ""  External
 SG_ EYQQ_ROAD_INFO_COUNTER_ERROR_2_6 : 22|1@1+ (1,0) [0|1] ""  External
 SG_ EYEQ_VISION_SAFETY_DIAG_RFC_B5_3 : 43|1@1+ (1,0) [0|1] ""  External
 SG_ EYEQ_VISION_SAFETY_DIAG_CRC_B5_2 : 42|1@1+ (1,0) [0|1] ""  External
 SG_ EYEQ_VISION_AEB_INFO_RFC_B5_1 : 41|1@1+ (1,0) [0|1] ""  External
 SG_ EYEQ_VISION_AEB_INFO_CRC_B5_0 : 40|1@1+ (1,0) [0|1] ""  External
 SG_ EYEQ_VIS_OBSTACLES_INFO_RFC_B5_6 : 46|1@1+ (1,0) [0|1] ""  External
 SG_ EYEQ_VIS_OBSTACLES_INFO_CRC_B5_5 : 45|1@1+ (1,0) [0|1] ""  External
 SG_ EYEQ_VIS_FAILSAFESRFCFAULT_B6_4 : 52|1@1+ (1,0) [0|1] ""  External
 SG_ EYEQ_VIS_FAILSAFESCRCFAULT_B6_3 : 51|1@1+ (1,0) [0|1] ""  External
 SG_ EYEQ_STATIC_RFC_FAULT_B6_2 : 50|1@1+ (1,0) [0|1] ""  External
 SG_ EYEQ_DYNAMIC_RFC_FAULT_B6_0 : 48|1@1+ (1,0) [0|1] ""  External
 SG_ EYEQ_DYNAMIC_CRC_FAULT_B5_7 : 47|1@1+ (1,0) [0|1] ""  External
 SG_ EYEQ_ROAD_INFO_CRC_FAULT_B5_4 : 44|1@1+ (1,0) [0|1] ""  External
 SG_ EYEQ_OTA_SWAP_FAULT_B7_5 : 61|1@1+ (1,0) [0|1] ""  External
 SG_ EyeQ_MESP_Coding_failure_B9_1 : 73|1@1+ (1,0) [0|1] ""  External
 SG_ EYEQ_GEN_CR_ERR_FAULT_B2_3 : 19|1@1+ (1,0) [0|1] ""  External
 SG_ EYEQ_GEN_31_AEB_PARAM_FFI_Be_6 : 118|1@1+ (1,0) [0|1] ""  External
 SG_ EYEQ_GEN_29_RFC_ERR_Be_7 : 119|1@1+ (1,0) [0|1] ""  External
 SG_ EyeQ_DDR_RAM_CRC_Bb_7 : 95|1@1+ (1,0) [0|1] ""  External
 SG_ ESP2_VehStandstill_Invalid_B2c_2 : 354|1@1+ (1,0) [0|1] ""  External
 SG_ ESP2_Timeout_B27_4 : 316|1@1+ (1,0) [0|1] ""  External
 SG_ ESP2_RollingCounter_B37_4 : 444|1@1+ (1,0) [0|1] ""  External
 SG_ ESP2_HDCCtrl_Abnormal_B35_5 : 429|1@1+ (1,0) [0|1] ""  External
 SG_ ESP2_DrivingModDis_Abnor_B35_6 : 430|1@1+ (1,0) [0|1] ""  External
 SG_ ESP2_CheckSum_B3b_4 : 476|1@1+ (1,0) [0|1] ""  External
 SG_ ESP2_CDDAvailable_Error_B2c_0 : 352|1@1+ (1,0) [0|1] ""  External
 SG_ ESP2_AWBAvailable_Error_B2d_2 : 362|1@1+ (1,0) [0|1] ""  External
 SG_ ESP2_AEBAvailable_Error_B2c_4 : 356|1@1+ (1,0) [0|1] ""  External
 SG_ ESP2_ABPAvailable_Error_B2c_6 : 358|1@1+ (1,0) [0|1] ""  External
 SG_ ESP2_ABAavailable_Error_B2d_0 : 360|1@1+ (1,0) [0|1] ""  External
 SG_ ESP1_Timeout_B27_3 : 315|1@1+ (1,0) [0|1] ""  External
 SG_ ESP1_RollingCounter_B37_3 : 443|1@1+ (1,0) [0|1] ""  External
 SG_ ESP1_MasterCylBrkPress_B2b_0 : 344|1@1+ (1,0) [0|1] ""  External
 SG_ ESP1_ESPFailSts_Failure_B2b_6 : 350|1@1+ (1,0) [0|1] ""  External
 SG_ ESP1_CheckSum_B3b_3 : 475|1@1+ (1,0) [0|1] ""  External
 SG_ ESP_FD3_Timeout_B27_7 : 319|1@1+ (1,0) [0|1] ""  External
 SG_ ESP_FD3_SwtPosn_Invalid_B2e_1 : 369|1@1+ (1,0) [0|1] ""  External
 SG_ ESP_FD3_RRWheelSpd_Invalid_B2a_7 : 343|1@1+ (1,0) [0|1] ""  External
 SG_ ESP_FD3_RRWhDriveDirection_B29_3 : 331|1@1+ (1,0) [0|1] ""  External
 SG_ ESP_FD3_RLWheelSpd_Invalid_B2a_5 : 341|1@1+ (1,0) [0|1] ""  External
 SG_ ESP_FD3_RLWhDriveDirection_B29_1 : 329|1@1+ (1,0) [0|1] ""  External
 SG_ ESP_FD3_FRWheelSpd_Invalid_B2a_3 : 339|1@1+ (1,0) [0|1] ""  External
 SG_ ESP_FD3_FRWhDriveDirection_B29_7 : 335|1@1+ (1,0) [0|1] ""  External
 SG_ ESP_FD3_FLWheelSpd_Invalid_B2a_1 : 337|1@1+ (1,0) [0|1] ""  External
 SG_ ESP_FD3_FLWhDriveDirection_B29_5 : 333|1@1+ (1,0) [0|1] ""  External
 SG_ ESP_FD3_EPBSts_Error_B2e_5 : 373|1@1+ (1,0) [0|1] ""  External
 SG_ ESP_FD3_EPBErrSts_Error_B2e_3 : 371|1@1+ (1,0) [0|1] ""  External
 SG_ ESP_FD3_EPB1_RollCounter_B38_2 : 450|1@1+ (1,0) [0|1] ""  External
 SG_ ESP_FD3_EPB1_CheckSum_B3c_2 : 482|1@1+ (1,0) [0|1] ""  External
 SG_ ESP_FD3_ABS2_RollCounter_B38_4 : 452|1@1+ (1,0) [0|1] ""  External
 SG_ ESP_FD3_ABS2_CheckSum_B3c_4 : 484|1@1+ (1,0) [0|1] ""  External
 SG_ ESP_FD3_ABS1_RollCounter_B38_3 : 451|1@1+ (1,0) [0|1] ""  External
 SG_ ESP_FD3_ABS1_CheckSum_B3c_3 : 483|1@1+ (1,0) [0|1] ""  External
 SG_ ESP_FD2_VehStandstill_B2c_3 : 355|1@1+ (1,0) [0|1] ""  External
 SG_ ESP_FD2_VehSpd_Missing_B21_5 : 269|1@1+ (1,0) [0|1] ""  External
 SG_ ESP_FD2_VehSpd_Invalid_B2b_5 : 349|1@1+ (1,0) [0|1] ""  External
 SG_ ESP_FD2_Timeout_B27_6 : 318|1@1+ (1,0) [0|1] ""  External
 SG_ ESP_FD2_MasterCylBrkPress_B2b_1 : 345|1@1+ (1,0) [0|1] ""  External
 SG_ ESP_FD2_ESPFailSts_Failure_B2b_7 : 351|1@1+ (1,0) [0|1] ""  External
 SG_ ESP_FD2_ESP2_RollCounter_B38_7 : 455|1@1+ (1,0) [0|1] ""  External
 SG_ ESP_FD2_ESP2_CheckSum_B3c_7 : 487|1@1+ (1,0) [0|1] ""  External
 SG_ ESP_FD2_ESP1_RollCounter_B38_6 : 454|1@1+ (1,0) [0|1] ""  External
 SG_ ESP_FD2_ESP1_CheckSum_B3c_6 : 486|1@1+ (1,0) [0|1] ""  External
 SG_ ESP_FD2_CDDAvailable_Error_B2c_1 : 353|1@1+ (1,0) [0|1] ""  External
 SG_ ESP_FD2_AWBAvailable_Error_B2d_3 : 363|1@1+ (1,0) [0|1] ""  External
 SG_ ESP_FD2_AEBAvailable_Error_B2c_5 : 357|1@1+ (1,0) [0|1] ""  External
 SG_ ESP_FD2_ABSFailSts_Failure_B2b_3 : 347|1@1+ (1,0) [0|1] ""  External
 SG_ ESP_FD2_ABS3_RollCounter_B38_5 : 453|1@1+ (1,0) [0|1] ""  External
 SG_ ESP_FD2_ABS3_CheckSum_B3c_5 : 485|1@1+ (1,0) [0|1] ""  External
 SG_ ESP_FD2_ABPAvailable_Error_B2c_7 : 359|1@1+ (1,0) [0|1] ""  External
 SG_ ESP_FD2_ABAavailable_Error_B2d_1 : 361|1@1+ (1,0) [0|1] ""  External
 SG_ EPS2_Timeout_B26_1 : 305|1@1+ (1,0) [0|1] ""  External
 SG_ EPS2_RollingCounter_B36_6 : 438|1@1+ (1,0) [0|1] ""  External
 SG_ EPS2_LKATrqOvlDlvdSts_Temp_B2f_6 : 382|1@1+ (1,0) [0|1] ""  External
 SG_ EPS2_LKATrqOvlDlvdSts_Perm_B2f_7 : 383|1@1+ (1,0) [0|1] ""  External
 SG_ EPS2_CheckSum_B3a_6 : 470|1@1+ (1,0) [0|1] ""  External
 SG_ EPS1_Timeout_B26_0 : 304|1@1+ (1,0) [0|1] ""  External
 SG_ EPS1_SteerMod_Abnormal_B32_1 : 401|1@1+ (1,0) [0|1] ""  External
 SG_ EPS1_EPSFailSts_Failure_B32_0 : 400|1@1+ (1,0) [0|1] ""  External
 SG_ EPB1_Timeout_B27_5 : 317|1@1+ (1,0) [0|1] ""  External
 SG_ EPB1_SwtPosn_Invalid_B2e_0 : 368|1@1+ (1,0) [0|1] ""  External
 SG_ EPB1_RollingCounter_B37_5 : 445|1@1+ (1,0) [0|1] ""  External
 SG_ EPB1_EPBSts_Error_B2e_4 : 372|1@1+ (1,0) [0|1] ""  External
 SG_ EPB1_EPBErrSts_Error_B2e_2 : 370|1@1+ (1,0) [0|1] ""  External
 SG_ EPB1_CheckSum_B3b_5 : 477|1@1+ (1,0) [0|1] ""  External
 SG_ ECM9_Timeout_B23_6 : 286|1@1+ (1,0) [0|1] ""  External
 SG_ ECM9_RollingCounter_B38_1 : 449|1@1+ (1,0) [0|1] ""  External
 SG_ ECM9_ECMACCInterface_Error_B34_6 : 422|1@1+ (1,0) [0|1] ""  External
 SG_ ECM9_Checksum_B3c_1 : 481|1@1+ (1,0) [0|1] ""  External
 SG_ ECM8_TrqLoss_Invalid_B34_5 : 421|1@1+ (1,0) [0|1] ""  External
 SG_ ECM8_Timeout_B23_5 : 285|1@1+ (1,0) [0|1] ""  External
 SG_ ECM7_Timeout_B23_4 : 284|1@1+ (1,0) [0|1] ""  External
 SG_ ECM4_Timeout_B23_3 : 283|1@1+ (1,0) [0|1] ""  External
 SG_ ECM4_RollingCounter_B38_0 : 448|1@1+ (1,0) [0|1] ""  External
 SG_ ECM4_NetEngTrq_Invalid_B34_3 : 419|1@1+ (1,0) [0|1] ""  External
 SG_ ECM4_DrvEngTrqReq_Invalid_B34_4 : 420|1@1+ (1,0) [0|1] ""  External
 SG_ ECM4_Checksum_B3c_0 : 480|1@1+ (1,0) [0|1] ""  External
 SG_ ECM3_Timeout_B23_2 : 282|1@1+ (1,0) [0|1] ""  External
 SG_ ECM3_MaxEngTrqNorm_Abnorm_B34_2 : 418|1@1+ (1,0) [0|1] ""  External
 SG_ ECM2_Timeout_B23_1 : 281|1@1+ (1,0) [0|1] ""  External
 SG_ ECM2_AccelPedalPosn_Invd_B2d_6 : 366|1@1+ (1,0) [0|1] ""  External
 SG_ ECM1_Timeout_B23_0 : 280|1@1+ (1,0) [0|1] ""  External
 SG_ ECM1_Start_StopSts_Invalid_B34_1 : 417|1@1+ (1,0) [0|1] ""  External
 SG_ ECM1_RollingCounter_B37_7 : 447|1@1+ (1,0) [0|1] ""  External
 SG_ ECM1_Checksum_B3b_7 : 479|1@1+ (1,0) [0|1] ""  External
 SG_ ECM1_BrkPedalSts_Error_B2d_4 : 364|1@1+ (1,0) [0|1] ""  External
 SG_ DCT7_Timeout_B24_1 : 289|1@1+ (1,0) [0|1] ""  External
 SG_ DCT7_DrvFaiMsg_Failure_B35_4 : 428|1@1+ (1,0) [0|1] ""  External
 SG_ DCT5_Timeout_B24_0 : 288|1@1+ (1,0) [0|1] ""  External
 SG_ DCT5_TGS_LEVER_Invalid_B35_3 : 427|1@1+ (1,0) [0|1] ""  External
 SG_ DCT5_TARGET_GEAR_Invalid_B35_2 : 426|1@1+ (1,0) [0|1] ""  External
 SG_ DCT5_ShiftInPrg_Invalid_B35_1 : 425|1@1+ (1,0) [0|1] ""  External
 SG_ DCT5_RollingCounter_B37_6 : 446|1@1+ (1,0) [0|1] ""  External
 SG_ DCT5_CurrentGear_Invalid_B35_0 : 424|1@1+ (1,0) [0|1] ""  External
 SG_ DCT5_CheckSum_B3b_6 : 478|1@1+ (1,0) [0|1] ""  External
 SG_ DCT3_Timeout_B23_7 : 287|1@1+ (1,0) [0|1] ""  External
 SG_ CSA2_Timeout_B25_4 : 300|1@1+ (1,0) [0|1] ""  External
 SG_ CSA2_SteerWheelSpd_Invalid_B31_2 : 394|1@1+ (1,0) [0|1] ""  External
 SG_ CSA2_SteerWheelAng_Invalid_B31_1 : 393|1@1+ (1,0) [0|1] ""  External
 SG_ CSA2_SAS_Sts_Error_B31_4 : 396|1@1+ (1,0) [0|1] ""  External
 SG_ CSA2_Rollingcounter_B36_5 : 437|1@1+ (1,0) [0|1] ""  External
 SG_ CSA2_Checksum_B3a_5 : 469|1@1+ (1,0) [0|1] ""  External
 SG_ CSA2_CC_ACCSwt_Error_B31_3 : 395|1@1+ (1,0) [0|1] ""  External
 SG_ CSA1_Timeout_B25_3 : 299|1@1+ (1,0) [0|1] ""  External
 SG_ CSA1_FrntWiprSwtSts_Error_B31_0 : 392|1@1+ (1,0) [0|1] ""  External
 SG_ Blurred_Image_Fault_B10_6 : 134|1@1+ (1,0) [0|1] ""  External
 SG_ BCM8_WiprReq_Invalid_B2f_4 : 380|1@1+ (1,0) [0|1] ""  External
 SG_ BCM8_Timeout_B25_7 : 303|1@1+ (1,0) [0|1] ""  External
 SG_ BCM1_Timeout_B25_5 : 301|1@1+ (1,0) [0|1] ""  External
 SG_ AEB_shutdown_Invalid_Reason_Bd_1 : 105|1@1+ (1,0) [0|1] ""  External
 SG_ AEB_shutdown_4_DT_ERR_Bd_6 : 110|1@1+ (1,0) [0|1] ""  External
 SG_ AEB_shutdown_6_FCV_FCW_TTC_Bd_4 : 108|1@1+ (1,0) [0|1] ""  External
 SG_ AEB_shutdown_27_FcvSigFfi_Bf_2 : 122|1@1+ (1,0) [0|1] ""  External
 SG_ AEB_shutdown_25_CO_FOF_DIFF_Bd_5 : 109|1@1+ (1,0) [0|1] ""  External
 SG_ AEB_Safety_Violation_B21_7 : 271|1@1+ (1,0) [0|1] ""  External
 SG_ ACC_Safety_Violation_B22_0 : 272|1@1+ (1,0) [0|1] ""  External
 SG_ AC2_Timeout_B26_4 : 308|1@1+ (1,0) [0|1] ""  External
 SG_ AC2_ACAmbTemp_Invalid_B2f_3 : 379|1@1+ (1,0) [0|1] ""  External
 SG_ ABS3_VehSpd_Missing_B21_4 : 268|1@1+ (1,0) [0|1] ""  External
 SG_ ABS3_VehSpd_Invalid_B2b_4 : 348|1@1+ (1,0) [0|1] ""  External
 SG_ ABS3_ABSFailSts_Failure_B2b_2 : 346|1@1+ (1,0) [0|1] ""  External
 SG_ ABS2_RRWheelSpd_Invalid_B2a_6 : 342|1@1+ (1,0) [0|1] ""  External
 SG_ ABS2_RRWhDirection_Invalid_B29_2 : 330|1@1+ (1,0) [0|1] ""  External
 SG_ ABS2_RLWheelSpd_Invalid_B2a_4 : 340|1@1+ (1,0) [0|1] ""  External
 SG_ ABS2_RLWhDirection_Invalid_B29_0 : 328|1@1+ (1,0) [0|1] ""  External
 SG_ ABS1_FRWheelSpd_Invalid_B2a_2 : 338|1@1+ (1,0) [0|1] ""  External
 SG_ ABS1_FRWhDirection_Invalid_B29_6 : 334|1@1+ (1,0) [0|1] ""  External
 SG_ ABS1_FLWheelSpd_Invalid_B2a_0 : 336|1@1+ (1,0) [0|1] ""  External
 SG_ ABS1_FLWhDirection_Invalid_B29_4 : 332|1@1+ (1,0) [0|1] ""  External
 SG_ ABS3_Timeout_B27_2 : 314|1@1+ (1,0) [0|1] ""  External
 SG_ ABS2_Timeout_B27_1 : 313|1@1+ (1,0) [0|1] ""  External
 SG_ ABS3_RollingCounter_B37_2 : 442|1@1+ (1,0) [0|1] ""  External
 SG_ ABS2_RollingCounter_B37_1 : 441|1@1+ (1,0) [0|1] ""  External
 SG_ ABS3_CheckSum_B3b_2 : 474|1@1+ (1,0) [0|1] ""  External
 SG_ ABS2_CheckSum_B3b_1 : 473|1@1+ (1,0) [0|1] ""  External
 SG_ ABS1_Timeout_B27_0 : 312|1@1+ (1,0) [0|1] ""  External
 SG_ ABS1_RollingCounter_B37_0 : 440|1@1+ (1,0) [0|1] ""  External
 SG_ ABS1_CheckSum_B3b_0 : 472|1@1+ (1,0) [0|1] ""  External
 SG_ ABM2_VehYawRate_Missing_B21_6 : 270|1@1+ (1,0) [0|1] ""  External
 SG_ ABM2_VehYawRate_Invalid_B2f_0 : 376|1@1+ (1,0) [0|1] ""  External
 SG_ ABM2_VehLgtAccel_Invalid_B2f_1 : 377|1@1+ (1,0) [0|1] ""  External
 SG_ ABM2_VehLatAccel_Invalid_B2f_2 : 378|1@1+ (1,0) [0|1] ""  External
 SG_ ABM2_Timeout_B25_1 : 297|1@1+ (1,0) [0|1] ""  External
 SG_ ABM2_RollingCounter_B36_4 : 436|1@1+ (1,0) [0|1] ""  External
 SG_ ABM2_CheckSum_B3a_4 : 468|1@1+ (1,0) [0|1] ""  External
 SG_ ABM1_Timeout_B25_0 : 296|1@1+ (1,0) [0|1] ""  External
 SG_ ABM1_RollingCounter_B36_3 : 435|1@1+ (1,0) [0|1] ""  External
 SG_ ABM1_CheckSum_B3a_3 : 467|1@1+ (1,0) [0|1] ""  External
 SG_ Vision_Internal_Error_B1f_6 : 254|1@1+ (1,0) [0|1] ""  External
 SG_ EyeQ_Spi_Msg_Timeout_A_7 : 87|1@1+ (1,0) [0|1] ""  External
 SG_ Host_Spi_CRC_Error_A_2 : 82|1@1+ (1,0) [0|1] ""  External
 SG_ Host_Spi_Tx_Error_A_1 : 81|1@1+ (1,0) [0|1] ""  External
 SG_ Host_spi_msg_timeout_A_0 : 80|1@1+ (1,0) [0|1] ""  External
 SG_ EyeQ_Calibration_Checksum_9_4 : 76|1@1+ (1,0) [0|1] ""  External
 SG_ Imager_2V8_Supply_OutRange_6_7 : 55|1@1+ (1,0) [0|1] ""  External
 SG_ Aurix_1V25_Supply_OutRange_B6_6 : 54|1@1+ (1,0) [0|1] ""  External
 SG_ Imager_1V2_Supply_OutRange_6_5 : 53|1@1+ (1,0) [0|1] ""  External
 SG_ Battery_High_Fault_B21_2 : 266|1@1+ (1,0) [0|1] ""  External
 SG_ Battery_Low_Fault_B21_1 : 265|1@1+ (1,0) [0|1] ""  External
 SG_ PS_5V0_Out_Of_Range_4_4 : 36|1@1+ (1,0) [0|1] ""  External
 SG_ EyeQDDROnBrdThermstorOutRang_4_3 : 35|1@1+ (1,0) [0|1] ""  External
 SG_ EyeQDDROnBrdThermstorOveTemp_4_1 : 33|1@1+ (1,0) [0|1] ""  External
 SG_ EyeQ_Temp_Exceeded_3_0 : 24|1@1+ (1,0) [0|1] ""  External
 SG_ SYSTEM_OVER_TEMPERATURE_2_7 : 23|1@1+ (1,0) [0|1] ""  External
 SG_ EyeQ_Error_Out_Temp_Fault_1A_6 : 214|1@1+ (1,0) [0|1] ""  External
 SG_ EyeQErrOutSignalInternFault_1A_5 : 213|1@1+ (1,0) [0|1] ""  External
 SG_ EyeQ_Camera1_Temp_Fault_1A_4 : 212|1@1+ (1,0) [0|1] ""  External
 SG_ EyeQVdoErrFlg_ShotOutOfSync_1A_3 : 211|1@1+ (1,0) [0|1] ""  External
 SG_ EyeQVdoErrFlg_VdiErrShutdwn_1A_2 : 210|1@1+ (1,0) [0|1] ""  External
 SG_ EyeQVdoErrFlg_HdrVerifiErr_1A_1 : 209|1@1+ (1,0) [0|1] ""  External
 SG_ EyeQVdoErrFlg_CcftDecisionMismat : 208|1@1+ (1,0) [0|1] ""  External
 SG_ EyeQVdoErrFlg_HistogramsMismatch : 207|1@1+ (1,0) [0|1] ""  External
 SG_ EyeQVdoErrFlg_FrameCountReadFail : 206|1@1+ (1,0) [0|1] ""  External
 SG_ EyeQVdoErrFlgVdiErr_CoreIdFlt : 205|1@1+ (1,0) [0|1] ""  External
 SG_ EyeQVdoErrFlgVdiErr_StrtAftStrt : 204|1@1+ (1,0) [0|1] ""  External
 SG_ EyeQVdoErrFlgVdiErr_ParityHisFlt : 203|1@1+ (1,0) [0|1] ""  External
 SG_ EyeQVdoErrFlgVdiErr_ParityGamma : 202|1@1+ (1,0) [0|1] ""  External
 SG_ EyeQVdoErrFlgVdiErr_ParityWeight : 201|1@1+ (1,0) [0|1] ""  External
 SG_ EyeQVdoErrFlgVdiErr_ParityFifo : 200|1@1+ (1,0) [0|1] ""  External
 SG_ EyeQVdoErrFlgVdiErrFifo_Undflow : 199|1@1+ (1,0) [0|1] ""  External
 SG_ EyeQVdoErrFlgVdiErrFifo_Overflow : 198|1@1+ (1,0) [0|1] ""  External
 SG_ EyeQVdoErrFlgVdiErr_Timeout_18_5 : 197|1@1+ (1,0) [0|1] ""  External
 SG_ EyeQVdoErrFlgVdiErr_BuffInvldFmt : 196|1@1+ (1,0) [0|1] ""  External
 SG_ EyeQVdoErrFlg_Vdi_ErrNoBuff_18_3 : 195|1@1+ (1,0) [0|1] ""  External
 SG_ EyeQVdoErrFlgVdi_InternErr18_2 : 194|1@1+ (1,0) [0|1] ""  External
 SG_ EyeQVdoErrFlgSumNotMatHistgrmErr : 193|1@1+ (1,0) [0|1] ""  External
 SG_ EyeQVdoErrFlgZeroHistgrmErr_18_0 : 192|1@1+ (1,0) [0|1] ""  External
 SG_ EyeQVdoErrFlgRegWrtHilFailErr : 191|1@1+ (1,0) [0|1] ""  External
 SG_ EyeQVdoErrFlgErrRegFlagFlt_17_6 : 190|1@1+ (1,0) [0|1] ""  External
 SG_ EyeQVdoErrFlgInvldVdoHeaderFault : 189|1@1+ (1,0) [0|1] ""  External
 SG_ EyeQVdoErrFlgVerifiFailVdoErr : 188|1@1+ (1,0) [0|1] ""  External
 SG_ EyeQVdoErrFlgInconstFramVdoErr : 187|1@1+ (1,0) [0|1] ""  External
 SG_ EyeQ_Cam1VdoErrFlgLgcVdoErr_17_2 : 186|1@1+ (1,0) [0|1] ""  External
 SG_ EyeQCam1VdoErrFlgI2CNoOnTmVdoErr : 185|1@1+ (1,0) [0|1] ""  External
 SG_ EyeQCam1VdoErrFlgVdiVdoErr_17_0 : 184|1@1+ (1,0) [0|1] ""  External
 SG_ EyeQ_Cam_Vdo_Flt_16_7 : 183|1@1+ (1,0) [0|1] ""  External
 SG_ EyeQ_Cam_Ctrl_Flt_16_6 : 182|1@1+ (1,0) [0|1] ""  External
 SG_ EyeQ_Cam_Mal_Func_16_5 : 181|1@1+ (1,0) [0|1] ""  External
 SG_ Grab_Release_Failure_16_4 : 180|1@1+ (1,0) [0|1] ""  External
 SG_ Grab_Acquire_Failure_16_3 : 179|1@1+ (1,0) [0|1] ""  External
 SG_ Grab_Issue_Failure_16_2 : 178|1@1+ (1,0) [0|1] ""  External
 SG_ Grab_No_Free_Header_Failure_16_1 : 177|1@1+ (1,0) [0|1] ""  External
 SG_ Init_I2C_Failure_16_0 : 176|1@1+ (1,0) [0|1] ""  External
 SG_ Init_Vdi_Failure_15_7 : 175|1@1+ (1,0) [0|1] ""  External
 SG_ EyeQFatalErrApCamParaCcftCrc13_4 : 156|1@1+ (1,0) [0|1] ""  External
 SG_ EyeQFatalErrAppI2CTimoutErr_13_2 : 154|1@1+ (1,0) [0|1] ""  External
 SG_ EyeQFatalErrAppI2CCamSlfRst_13_1 : 153|1@1+ (1,0) [0|1] ""  External
 SG_ EyeQFatalErrAppI2CVidoGrb_13_0 : 152|1@1+ (1,0) [0|1] ""  External
 SG_ EYEQ_GEN54ACCSTLEXECUTFAILED_F_3 : 123|1@1+ (1,0) [0|1] ""  External
 SG_ EYEQ_GEN_26_CODE_CRC_E_1 : 113|1@1+ (1,0) [0|1] ""  External
 SG_ EyeQ_Core_Dump_Fault_C_5 : 101|1@1+ (1,0) [0|1] ""  External
 SG_ EyeQ_Init_Timeout_Fault_C_4 : 100|1@1+ (1,0) [0|1] ""  External
 SG_ EYEQ4_Mode_Fault_C_3 : 99|1@1+ (1,0) [0|1] ""  External
 SG_ EyeQ_Bist_Memory_Fault_C_2 : 98|1@1+ (1,0) [0|1] ""  External
 SG_ EyeQ_Core_Fault_C_1 : 97|1@1+ (1,0) [0|1] ""  External
 SG_ EyeQ_Boot_Fault_C_0 : 96|1@1+ (1,0) [0|1] ""  External
 SG_ EyeQ_DDR_Fault_B_6 : 94|1@1+ (1,0) [0|1] ""  External
 SG_ EyeQ_SerialFlashPowerUp_Fail_B_1 : 89|1@1+ (1,0) [0|1] ""  External
 SG_ EyeQ_SPI_CRC_ERROR_B_0 : 88|1@1+ (1,0) [0|1] ""  External
 SG_ EYEQ_Spi_Msg_Format_Error_A_6 : 86|1@1+ (1,0) [0|1] ""  External
 SG_ EyeQ_Spi_Frame_Format_Error_A_5 : 85|1@1+ (1,0) [0|1] ""  External
 SG_ Spi_Ipc_Comm_Reset_A_4 : 84|1@1+ (1,0) [0|1] ""  External
 SG_ Spi_version_mismatch_A_3 : 83|1@1+ (1,0) [0|1] ""  External
 SG_ Host_Spi_Msg_Format_Error_9_7 : 79|1@1+ (1,0) [0|1] ""  External
 SG_ Host_Spi_Frame_Format_Error_9_6 : 78|1@1+ (1,0) [0|1] ""  External
 SG_ EyeQ_Application_Checksum_9_3 : 75|1@1+ (1,0) [0|1] ""  External
 SG_ EyeQAppl_CompltAndComptibl_9_2 : 74|1@1+ (1,0) [0|1] ""  External
 SG_ EyeQOnBoardThermstorOutRange_4_2 : 34|1@1+ (1,0) [0|1] ""  External
 SG_ EyeQ_DDR_Over_Temp_4_0 : 32|1@1+ (1,0) [0|1] ""  External
 SG_ EyeQ_Boot_OverTemp_Fault_3_7 : 31|1@1+ (1,0) [0|1] ""  External
 SG_ EyeQ_Imager_Over_Temp_3_6 : 30|1@1+ (1,0) [0|1] ""  External
 SG_ EyeQ_VMP_Over_Temp_3_5 : 29|1@1+ (1,0) [0|1] ""  External
 SG_ EyeQ_MIPS_Over_Temp_3_4 : 28|1@1+ (1,0) [0|1] ""  External
 SG_ EyeQOnBoardThermistorOveTemp_3_1 : 25|1@1+ (1,0) [0|1] ""  External
 SG_ EYEQ_1V0_SUPPLY_OUT_OF_RANGE_0_3 : 3|1@1+ (1,0) [0|1] ""  External
 SG_ EYEQ_1V1_SUPPLY_OUT_OF_RANGE_0_2 : 2|1@1+ (1,0) [0|1] ""  External
 SG_ EYEQ_1V8_SUPPLY_OUT_OF_RANGE_0_1 : 1|1@1+ (1,0) [0|1] ""  External
 SG_ EYEQ_3V3_SUPPLY_OUT_OF_RANGE_0_0 : 0|1@1+ (1,0) [0|1] ""  External
 SG_ Windshield_heater_OPNLD_Err_0000 : 496|1@1+ (1,0) [0|1] ""  External
 SG_ WWINDSHIELD_HEATER_STG_FAUL_0000 : 497|1@1+ (1,0) [0|1] ""  External
 SG_ WINDSHIELD_HEATER_OVRLD_FAU_0000 : 498|1@1+ (1,0) [0|1] ""  External
 SG_ WINDSHIELD_HEATER_STB_FAULT_0000 : 499|1@1+ (1,0) [0|1] ""  External

CM_ BO_ 3221225472 "This is a message for not used signals, created by Vector CANdb++ DBC OLE DB Provider.";
BA_DEF_ BO_  "GenMsgSendType" ENUM  "FixedPeriodic","Event","EnabledPeriodic","NotUsed","NotUsed","EventPeriodic","NotUsed","NotUsed","NoMsgSendType";
BA_DEF_ BO_  "GenMsgCycleTime" INT 0 100000;
BA_DEF_ BO_  "GenMsgILSupport" ENUM  "No","Yes";
BA_DEF_ SG_  "GenSigStartValue" INT 0 1000000000;
BA_DEF_ SG_  "UsedOnPgmDBC" ENUM  "No","Yes";
BA_DEF_ SG_  "GenSigSendType" ENUM  "Cyclic","OnWrite","vector_leerstring","OnChange","vector_leerstring","IfActive","vector_leerstring","NoSigSendType";
BA_DEF_ BU_  "NmAsrNodeIdentifier" HEX 128 255;
BA_DEF_ BU_  "PowerType" ENUM  "Switched","Latched","Sleep","vector_leerstring","vector_leerstring";
BA_DEF_ BU_  "DiagNode" ENUM  "GGDS","GDS","NONE";
BA_DEF_ BU_  "EOL_SB_Flash" ENUM  "GGDS","GDS","NONE","vector_leerstring";
BA_DEF_ BU_  "ILUsed" ENUM  "No","Yes";
BA_DEF_  "DBName" STRING ;
BA_DEF_  "BusType" STRING ;
BA_DEF_  "VersionNumber_B" STRING ;
BA_DEF_  "StarNetworkGwType" ENUM  "0=NotDefined","1=HS1","2=HS2","3=HS3","4=HS4","5=HS5","6=MS1";
BA_DEF_  "NmType" STRING ;
BA_DEF_  "NetworkSpeed" ENUM  "500kBits/s","125kBit/s";
BA_DEF_  "NmAsrMessageCount" INT 128 128;
BA_DEF_  "NmAsrBaseAddress" HEX 1408 1408;
BA_DEF_  "VersionDay" INT 1 31;
BA_DEF_  "Manufacturer" STRING ;
BA_DEF_  "VersionMonth" INT 1 12;
BA_DEF_  "VersionYear" INT 2000 3000;
BA_DEF_  "NmBaseAddress" HEX 1280 1280;
BA_DEF_  "NmMessageCount" INT 0 128;
BA_DEF_  "GenNetworkName" STRING ;
BA_DEF_  "GenNetworkBaudrate" STRING ;
BA_DEF_ BU_  "ECU" STRING ;
BA_DEF_ BO_  "VFrameFormat" ENUM  "StandardCAN","ExtendedCAN","reserved","reserved","reserved","reserved","reserved","reserved","reserved","reserved","reserved","reserved","reserved","reserved","StandardCAN_FD","ExtendedCAN_FD";
BA_DEF_ SG_  "SystemSignalLongSymbol" STRING ;
BA_DEF_DEF_  "GenMsgSendType" "NoMsgSendType";
BA_DEF_DEF_  "GenMsgCycleTime" 0;
BA_DEF_DEF_  "GenMsgILSupport" "Yes";
BA_DEF_DEF_  "GenSigStartValue" 0;
BA_DEF_DEF_  "UsedOnPgmDBC" "Yes";
BA_DEF_DEF_  "GenSigSendType" "NoSigSendType";
BA_DEF_DEF_  "NmAsrNodeIdentifier" 128;
BA_DEF_DEF_  "PowerType" "Switched";
BA_DEF_DEF_  "DiagNode" "GGDS";
BA_DEF_DEF_  "EOL_SB_Flash" "GGDS";
BA_DEF_DEF_  "ILUsed" "Yes";
BA_DEF_DEF_  "DBName" "";
BA_DEF_DEF_  "BusType" "CANFD";
BA_DEF_DEF_  "VersionNumber_B" "B_1";
BA_DEF_DEF_  "StarNetworkGwType" "0=NotDefined";
BA_DEF_DEF_  "NmType" "Ford-OSEK";
BA_DEF_DEF_  "NetworkSpeed" "500kBits/s";
BA_DEF_DEF_  "NmAsrMessageCount" 128;
BA_DEF_DEF_  "NmAsrBaseAddress" 1408;
BA_DEF_DEF_  "VersionDay" 11;
BA_DEF_DEF_  "Manufacturer" "SGM";
BA_DEF_DEF_  "VersionMonth" 9;
BA_DEF_DEF_  "VersionYear" 2018;
BA_DEF_DEF_  "NmBaseAddress" 1280;
BA_DEF_DEF_  "NmMessageCount" 128;
BA_DEF_DEF_  "GenNetworkName" "INST_CAN";
BA_DEF_DEF_  "GenNetworkBaudrate" "500kBits/s";
BA_DEF_DEF_  "ECU" "ASDM";
BA_DEF_DEF_  "VFrameFormat" "StandardCAN";
BA_DEF_DEF_  "SystemSignalLongSymbol" "";
BA_ "BusType" "CAN FD";
BA_ "Manufacturer" "Vector";
BA_ "DBName" "INST_CANFD";
BA_ "ECU" BU_ External "GWM";
BA_ "GenMsgCycleTime" BO_ 1798 20;
BA_ "GenMsgSendType" BO_ 1798 0;
BA_ "VFrameFormat" BO_ 1798 14;
BA_ "GenMsgSendType" BO_ 1832 0;
BA_ "GenMsgCycleTime" BO_ 1832 50;
BA_ "VFrameFormat" BO_ 1832 14;
BA_ "GenMsgSendType" BO_ 1831 0;
BA_ "GenMsgCycleTime" BO_ 1831 50;
BA_ "VFrameFormat" BO_ 1831 14;
BA_ "GenMsgSendType" BO_ 1830 0;
BA_ "GenMsgCycleTime" BO_ 1830 50;
BA_ "VFrameFormat" BO_ 1830 14;
BA_ "GenMsgSendType" BO_ 1829 0;
BA_ "GenMsgCycleTime" BO_ 1829 50;
BA_ "VFrameFormat" BO_ 1829 14;
BA_ "GenMsgSendType" BO_ 753 1;
BA_ "VFrameFormat" BO_ 753 14;
BA_ "GenMsgSendType" BO_ 752 1;
BA_ "VFrameFormat" BO_ 752 14;
BA_ "GenMsgSendType" BO_ 1811 0;
BA_ "GenMsgCycleTime" BO_ 1811 1000;
BA_ "VFrameFormat" BO_ 1811 14;
BA_ "GenMsgSendType" BO_ 1810 0;
BA_ "GenMsgCycleTime" BO_ 1810 10;
BA_ "VFrameFormat" BO_ 1810 14;
BA_ "GenSigSendType" SG_ 3221225472 FWC_Power_Mode_State 0;
BA_ "GenSigSendType" SG_ 3221225472 FWC_InitTimeout 0;
BA_ "GenSigSendType" SG_ 3221225472 FWC_Diagnostic_Shutdown 0;
BA_ "GenSigSendType" SG_ 3221225472 FWC_Thermal_Shutdown 0;
BA_ "GenSigSendType" SG_ 3221225472 FWC_Init_Retry_Counter 0;
BA_ "GenSigSendType" SG_ 3221225472 FWC_Init_wait_ms 0;
BA_ "GenSigSendType" SG_ 3221225472 FWC_Reset_Request 0;
BA_ "GenSigSendType" SG_ 3221225472 FWC_I2C_Rolling_Count_Err 0;
BA_ "GenSigSendType" SG_ 3221225472 FWC_I2C_Lost_Comm 0;
BA_ "SystemSignalLongSymbol" SG_ 3221225472 EYEQ_MES_50_VMP_SANITY_FAILED_B2 "EYEQ_MES_50_VMP_SANITY_FAILED_B25_1";
BA_ "SystemSignalLongSymbol" SG_ 3221225472 EYEQ_MES_50_VMP_SANITY_FAIL_0000 "EYEQ_MES_50_VMP_SANITY_FAILED_B25_1";
BA_ "SystemSignalLongSymbol" SG_ 3221225472 FWC_Camera_Wrong_Assembly_Fault_ "FWC_Camera_Wrong_Assembly_Fault_Bd_0";
BA_ "GenSigSendType" SG_ 3221225472 Unreasonable_Radar_Data_Bc_7 0;
BA_ "GenSigSendType" SG_ 3221225472 Host_ENET_Message_CRC_Err_B8_0 0;
BA_ "GenSigSendType" SG_ 3221225472 FWC_CAMPWR_LDO_Fail_B1_5 0;
BA_ "SystemSignalLongSymbol" SG_ 3221225472 FWC_Camera_Wrong_Assembly_F_0000 "FWC_Camera_Wrong_Assembly_Fault_Bd_0";
BA_ "GenSigSendType" SG_ 3221225472 EYEQ_GEN_32_NO_MSG_ARRIVED_ERR_B 0;
BA_ "SystemSignalLongSymbol" SG_ 3221225472 EYEQ_GEN_32_NO_MSG_ARRIVED_ERR_B "EYEQ_GEN_32_NO_MSG_ARRIVED_ERR_B10_1";
BA_ "GenSigSendType" SG_ 3221225472 FWC_ImagerFuseID_Mismatch_Fault_ 0;
BA_ "SystemSignalLongSymbol" SG_ 3221225472 FWC_ImagerFuseID_Mismatch_Fault_ "FWC_ImagerFuseID_Mismatch_Fault_Bf_7";
BA_ "GenSigSendType" SG_ 3221225472 Host_Application_CRC_Fault_B8_5 0;
BA_ "GenSigSendType" SG_ 3221225472 Host_On_Board_Thermistor_Out_Of_ 0;
BA_ "SystemSignalLongSymbol" SG_ 3221225472 Host_On_Board_Thermistor_Out_Of_ "Host_On_Board_Thermistor_Out_Of_Range_B4_1";
BA_ "GenSigSendType" SG_ 3221225472 Host_On_Board_Thermistor_Over_Te 0;
BA_ "SystemSignalLongSymbol" SG_ 3221225472 Host_On_Board_Thermistor_Over_Te "Host_On_Board_Thermistor_Over_Temp_B3_0";
BA_ "GenSigSendType" SG_ 3221225472 EYEQ_GEN_32_NO_MSG_ARRIVED__0000 0;
BA_ "SystemSignalLongSymbol" SG_ 3221225472 EYEQ_GEN_32_NO_MSG_ARRIVED__0000 "EYEQ_GEN_32_NO_MSG_ARRIVED_ERR_B10_1";
BA_ "GenSigSendType" SG_ 3221225472 FWC_ImagerFuseID_Mismatch_F_0000 0;
BA_ "SystemSignalLongSymbol" SG_ 3221225472 FWC_ImagerFuseID_Mismatch_F_0000 "FWC_ImagerFuseID_Mismatch_Fault_Bf_7";
BA_ "GenSigSendType" SG_ 3221225472 Host_On_Board_Thermistor_Ou_0000 0;
BA_ "SystemSignalLongSymbol" SG_ 3221225472 Host_On_Board_Thermistor_Ou_0000 "Host_On_Board_Thermistor_Out_Of_Range_B4_1";
BA_ "GenSigSendType" SG_ 3221225472 Host_On_Board_Thermistor_Ov_0000 0;
BA_ "SystemSignalLongSymbol" SG_ 3221225472 Host_On_Board_Thermistor_Ov_0000 "Host_On_Board_Thermistor_Over_Temp_B3_0";
BA_ "GenSigStartValue" SG_ 3221225472 Host_ThermSts 2;
BA_ "GenSigSendType" SG_ 3221225472 Host_ThermSts 0;
BA_ "GenSigSendType" SG_ 3221225472 LKA_SW_Status 0;
BA_ "GenSigSendType" SG_ 3221225472 LKA_LED_Status 0;
BA_ "GenSigStartValue" SG_ 3221225472 FCWPed_Angle 512;
BA_ "GenSigStartValue" SG_ 3221225472 FCWCIPS_RangeRate 512;
BA_ "GenSigStartValue" SG_ 3221225472 FCWCIPV_Angle 512;
BA_ "GenSigStartValue" SG_ 3221225472 FCWCIPS_Angle 512;
BA_ "GenSigStartValue" SG_ 3221225472 HostAccel 128;
BA_ "GenSigStartValue" SG_ 3221225472 LeadAccel 128;
BA_ "GenSigStartValue" SG_ 3221225472 FCWCIPV_RangeRate 512;
BA_ "GenSigStartValue" SG_ 3221225472 NeededDecel 128;
BA_ "GenSigStartValue" SG_ 3221225472 Min_DecelRequest 128;
BA_ "GenSigStartValue" SG_ 3221225472 CMbBCIPS_Angle 512;
BA_ "GenSigStartValue" SG_ 3221225472 CMbBCIPS_RangeRate 512;
BA_ "GenSigStartValue" SG_ 3221225472 CMbBCIPS_RangeAccel 512;
BA_ "GenSigStartValue" SG_ 3221225472 CMbBCIPV_Angle 512;
BA_ "GenSigStartValue" SG_ 3221225472 CMbBCIPV_RangeRate 512;
BA_ "GenSigStartValue" SG_ 3221225472 CMbBCIPV_RangeAccel 512;
BA_ "GenSigStartValue" SG_ 3221225472 CIB_Host_Long_Accel_mpss 128;
BA_ "GenSigSendType" SG_ 3221225472 AEB_shutdown_11_Temperature_is_o 0;
BA_ "SystemSignalLongSymbol" SG_ 3221225472 AEB_shutdown_11_Temperature_is_o "AEB_shutdown_11_Temperature_is_out_of_limits_Be_4";
BA_ "GenSigSendType" SG_ 3221225472 AEB_shutdown_10_video_error_in_l 0;
BA_ "SystemSignalLongSymbol" SG_ 3221225472 AEB_shutdown_10_video_error_in_l "AEB_shutdown_10_video_error_in_last_frame_Be_3";
BA_ "GenSigSendType" SG_ 3221225472 EyeQ_Cal_Complete_And_Compatible 0;
BA_ "SystemSignalLongSymbol" SG_ 3221225472 EyeQ_Cal_Complete_And_Compatible "EyeQ_Cal_Complete_And_Compatible_SWP3_B9_0";
BA_ "GenSigSendType" SG_ 3221225472 Host_Cal_Complete_And_Compatible 0;
BA_ "SystemSignalLongSymbol" SG_ 3221225472 Host_Cal_Complete_And_Compatible "Host_Cal_Complete_And_Compatible_B8_7";
BA_ "GenSigSendType" SG_ 3221225472 MCU5_RollingCounter_B39_7 0;
BA_ "GenSigSendType" SG_ 3221225472 MCU5_CheckSum_B3d_7 0;
BA_ "GenSigSendType" SG_ 3221225472 MCU_FD1_ActRotSpd_Invalid_B33_0 0;
BA_ "GenSigSendType" SG_ 3221225472 AEB_shutdown_11_Temperature_0000 0;
BA_ "SystemSignalLongSymbol" SG_ 3221225472 AEB_shutdown_11_Temperature_0000 "AEB_shutdown_11_Temperature_is_out_of_limits_Be_4";
BA_ "GenSigSendType" SG_ 3221225472 AEB_shutdown_10_video_error_0000 0;
BA_ "SystemSignalLongSymbol" SG_ 3221225472 AEB_shutdown_10_video_error_0000 "AEB_shutdown_10_video_error_in_last_frame_Be_3";
BA_ "GenSigSendType" SG_ 3221225472 EyeQ_Cal_Complete_And_Compa_0000 0;
BA_ "SystemSignalLongSymbol" SG_ 3221225472 EyeQ_Cal_Complete_And_Compa_0000 "EyeQ_Cal_Complete_And_Compatible_SWP3_B9_0";
BA_ "GenSigSendType" SG_ 3221225472 Host_Cal_Complete_And_Compa_0000 0;
BA_ "SystemSignalLongSymbol" SG_ 3221225472 Host_Cal_Complete_And_Compa_0000 "Host_Cal_Complete_And_Compatible_B8_7";
BA_ "GenSigSendType" SG_ 3221225472 AEB_shutdown_11_Temperature_0001 0;
BA_ "SystemSignalLongSymbol" SG_ 3221225472 AEB_shutdown_11_Temperature_0001 "AEB_shutdown_11_Temperature_is_out_of_limits_Be_4";
BA_ "GenSigSendType" SG_ 3221225472 AEB_shutdown_10_video_error_0001 0;
BA_ "SystemSignalLongSymbol" SG_ 3221225472 AEB_shutdown_10_video_error_0001 "AEB_shutdown_10_video_error_in_last_frame_Be_3";
BA_ "GenSigSendType" SG_ 3221225472 EyeQ_Cal_Complete_And_Compa_0001 0;
BA_ "SystemSignalLongSymbol" SG_ 3221225472 EyeQ_Cal_Complete_And_Compa_0001 "EyeQ_Cal_Complete_And_Compatible_SWP3_B9_0";
BA_ "GenSigSendType" SG_ 3221225472 Host_Cal_Complete_And_Compa_0001 0;
BA_ "SystemSignalLongSymbol" SG_ 3221225472 Host_Cal_Complete_And_Compa_0001 "Host_Cal_Complete_And_Compatible_B8_7";
BA_ "GenSigSendType" SG_ 3221225472 AEB_shutdown_11_Temperature_0002 0;
BA_ "SystemSignalLongSymbol" SG_ 3221225472 AEB_shutdown_11_Temperature_0002 "AEB_shutdown_11_Temperature_is_out_of_limits_Be_4";
BA_ "GenSigSendType" SG_ 3221225472 AEB_shutdown_10_video_error_0002 0;
BA_ "SystemSignalLongSymbol" SG_ 3221225472 AEB_shutdown_10_video_error_0002 "AEB_shutdown_10_video_error_in_last_frame_Be_3";
BA_ "GenSigSendType" SG_ 3221225472 EyeQ_Cal_Complete_And_Compa_0002 0;
BA_ "SystemSignalLongSymbol" SG_ 3221225472 EyeQ_Cal_Complete_And_Compa_0002 "EyeQ_Cal_Complete_And_Compatible_SWP3_B9_0";
BA_ "GenSigSendType" SG_ 3221225472 Host_Cal_Complete_And_Compa_0002 0;
BA_ "SystemSignalLongSymbol" SG_ 3221225472 Host_Cal_Complete_And_Compa_0002 "Host_Cal_Complete_And_Compatible_B8_7";
BA_ "GenSigSendType" SG_ 3221225472 comp_yaw_rate_filtered 0;
BA_ "GenSigStartValue" SG_ 3221225472 comp_yaw_rate_filtered 273.4375;
BA_ "GenSigSendType" SG_ 3221225472 VehYaw_WActl 0;
BA_ "GenSigStartValue" SG_ 3221225472 VehYaw_WActl 10000;
BA_ "GenSigSendType" SG_ 3221225472 LROSYawRate_Est 0;
BA_ "GenSigStartValue" SG_ 3221225472 LROSYawRate_Est 10000;
BA_ "GenSigSendType" SG_ 1798 steering_angle_qf 0;
BA_ "GenSigSendType" SG_ 1798 timestamp_ms_output 0;
BA_ "GenSigSendType" SG_ 1798 yaw_rate_bias_qf 0;
BA_ "GenSigSendType" SG_ 1798 raw_yaw_rate_rps 0;
BA_ "GenSigStartValue" SG_ 1798 raw_yaw_rate_rps 273.4375;
BA_ "GenSigSendType" SG_ 1798 Yaw_Rate_Raw 0;
BA_ "GenSigStartValue" SG_ 1798 Yaw_Rate_Raw 273.4375;
BA_ "GenSigSendType" SG_ 1798 Yaw_Rate_Raw_QF 0;
BA_ "GenSigSendType" SG_ 1798 Yaw_Rate_Reference 0;
BA_ "GenSigStartValue" SG_ 1798 Yaw_Rate_Reference 273.4375;
BA_ "GenSigSendType" SG_ 1798 Yaw_Rate_Refernce_QF 0;
BA_ "GenSigSendType" SG_ 1798 Host_Vehicle_Speed 0;
BA_ "GenSigSendType" SG_ 1798 Host_Vehicle_Speed_QF 0;
BA_ "GenSigSendType" SG_ 1798 F_Vehicle_Stationary 0;
BA_ "GenSigSendType" SG_ 1798 Curr_run_time_input 0;
BA_ "GenSigSendType" SG_ 1798 Yaw_Rate_Compensated_Unfiltered 0;
BA_ "GenSigStartValue" SG_ 1798 Yaw_Rate_Compensated_Unfiltered 273.4375;
BA_ "GenSigSendType" SG_ 1798 Yaw_Rate_Compensated_Filtered 0;
BA_ "GenSigStartValue" SG_ 1798 Yaw_Rate_Compensated_Filtered 273.4375;
BA_ "GenSigSendType" SG_ 1798 Yaw_Rate_Raw_Bias 0;
BA_ "GenSigStartValue" SG_ 1798 Yaw_Rate_Raw_Bias 9.375;
BA_ "GenSigSendType" SG_ 1798 Yaw_Rate_Compensated_QF 0;
BA_ "GenSigSendType" SG_ 1811 DCT3_RatAct_Error_B2e_7 0;
BA_ "GenSigSendType" SG_ 1811 ECM2_EngState_Error_B2e_6 0;
BA_ "SystemSignalLongSymbol" SG_ 1811 EYEQ_MINOR_ERROR_BM_EM_ERR_FAILE "EYEQ_MINOR_ERROR_BM_EM_ERR_FAILED_NB_OPERATION_FAULT_B15_6";
BA_ "GenSigSendType" SG_ 1811 EYEQ_STATIC_CRC_FAULT_B6_1 0;
BA_ "GenSigSendType" SG_ 1811 FEE_E_GC_READ_FAULT_B1_4 0;
BA_ "GenSigSendType" SG_ 1811 EYEQ_GEN_34_Corrupted_Vehicle_In 0;
BA_ "SystemSignalLongSymbol" SG_ 1811 EYEQ_GEN_34_Corrupted_Vehicle_In "EYEQ_GEN_34_Corrupted_Vehicle_Info_Input_Signals_Bf_1";
BA_ "GenSigSendType" SG_ 1811 EYEQ_GEN_11_INPUT_CRC_MISMATCH_B 0;
BA_ "SystemSignalLongSymbol" SG_ 1811 EYEQ_GEN_11_INPUT_CRC_MISMATCH_B "EYEQ_GEN_11_INPUT_CRC_MISMATCH_Bf_0";
BA_ "GenSigSendType" SG_ 1811 EYEQ_GEN_4_YAW_HORIZON_DEVIATION 0;
BA_ "SystemSignalLongSymbol" SG_ 1811 EYEQ_GEN_4_YAW_HORIZON_DEVIATION "EYEQ_GEN_4_YAW_HORIZON_DEVIATION_Be_0";
BA_ "GenSigSendType" SG_ 1811 EYEQ_GEN_18_IMAGER_DATA_ROWS_COL 0;
BA_ "SystemSignalLongSymbol" SG_ 1811 EYEQ_GEN_18_IMAGER_DATA_ROWS_COL "EYEQ_GEN_18_IMAGER_DATA_ROWS_COLS_Bd_7";
BA_ "GenSigSendType" SG_ 1811 EYEQ_GEN_13_OLD_EGODATA_LAT_Be_2 0;
BA_ "GenSigSendType" SG_ 1811 AEB_shutdown_9_ROI_DIFF_VC_FCV_B 0;
BA_ "SystemSignalLongSymbol" SG_ 1811 AEB_shutdown_9_ROI_DIFF_VC_FCV_B "AEB_shutdown_9_ROI_DIFF_VC_FCV_Bd_3";
BA_ "GenSigSendType" SG_ 1811 AEB_shutdown_7_POS_DIFF_KALMAN_V 0;
BA_ "SystemSignalLongSymbol" SG_ 1811 AEB_shutdown_7_POS_DIFF_KALMAN_V "AEB_shutdown_7_POS_DIFF_KALMAN_VAL_Bd_2";
BA_ "GenSigSendType" SG_ 1811 EYEQ_GEN_50_VMP_SANITY_FAILED_FA 0;
BA_ "SystemSignalLongSymbol" SG_ 1811 EYEQ_GEN_50_VMP_SANITY_FAILED_FA "EYEQ_GEN_50_VMP_SANITY_FAILED_FAULT_1b_0";
BA_ "GenSigSendType" SG_ 1811 EYEQ_FATAL_ERROR_APP_CPS_STL_FAI 0;
BA_ "SystemSignalLongSymbol" SG_ 1811 EYEQ_FATAL_ERROR_APP_CPS_STL_FAI "EYEQ_FATAL_ERROR_APP_CPS_STL_FAILED_FAULT_12_2";
BA_ "GenSigSendType" SG_ 1811 EYEQ_GEN_24_CCFT_DIFF_RESULTS_FA 0;
BA_ "SystemSignalLongSymbol" SG_ 1811 EYEQ_GEN_24_CCFT_DIFF_RESULTS_FA "EYEQ_GEN_24_CCFT_DIFF_RESULTS_FAULT_1c_3";
BA_ "SystemSignalLongSymbol" SG_ 1811 EYEQ_53_DECELERATION_DBS_OVERLAP "EYEQ_53_DECELERATION_DBS_OVERLAP_FAULT_B1c_2";
BA_ "SystemSignalLongSymbol" SG_ 1811 EYEQ_44_ROAD_SANITY_CORRECTION_V "EYEQ_44_ROAD_SANITY_CORRECTION_VALIDATION_FAULT_B1c_1";
BA_ "GenSigSendType" SG_ 1811 EYEQ_GEN_21_CAMERA_HEIGHT_LIMIT_ 0;
BA_ "SystemSignalLongSymbol" SG_ 1811 EYEQ_GEN_21_CAMERA_HEIGHT_LIMIT_ "EYEQ_GEN_21_CAMERA_HEIGHT_LIMIT_EXCEEDED_FAULT_1c_0";
BA_ "GenSigSendType" SG_ 1811 EYEQ_FATAL_ERROR_APP_INVALID_INT 0;
BA_ "SystemSignalLongSymbol" SG_ 1811 EYEQ_FATAL_ERROR_APP_INVALID_INT "EYEQ_FATAL_ERROR_APP_INVALID_INTRINSIC_CALIB_FAULT_1b_5";
BA_ "SystemSignalLongSymbol" SG_ 1811 EYEQ_45_ROAD_SFCONF_VALIDATION_B "EYEQ_45_ROAD_SFCONF_VALIDATION_B1b_2";
BA_ "SystemSignalLongSymbol" SG_ 1811 EYEQ_48_ALGO_PITCH_MISMATCH_B1b_ "EYEQ_48_ALGO_PITCH_MISMATCH_B1b_1";
BA_ "GenSigSendType" SG_ 1811 EyeQ_Minor_Error_Bm_Error_Fault_ 0;
BA_ "SystemSignalLongSymbol" SG_ 1811 EyeQ_Minor_Error_Bm_Error_Fault_ "EyeQ_Minor_Error_Bm_Error_Fault_14_0";
BA_ "GenSigSendType" SG_ 1811 EyeQ_Fatal_Error_App_Init_Failed 0;
BA_ "SystemSignalLongSymbol" SG_ 1811 EyeQ_Fatal_Error_App_Init_Failed "EyeQ_Fatal_Error_App_Init_Failed_Fault_12_6";
BA_ "GenSigSendType" SG_ 1811 EyeQ_Fatal_Error_App_Init_Camera 0;
BA_ "SystemSignalLongSymbol" SG_ 1811 EyeQ_Fatal_Error_App_Init_Camera "EyeQ_Fatal_Error_App_Init_Camera_Init_Fault_12_7";
BA_ "GenSigSendType" SG_ 1811 EyeQ_Fatal_Error_App_Fs_Error_Fa 0;
BA_ "SystemSignalLongSymbol" SG_ 1811 EyeQ_Fatal_Error_App_Fs_Error_Fa "EyeQ_Fatal_Error_App_Fs_Error_Fault_12_4";
BA_ "GenSigSendType" SG_ 1811 EyeQ_Fatal_Error_App_Error_Fault 0;
BA_ "SystemSignalLongSymbol" SG_ 1811 EyeQ_Fatal_Error_App_Error_Fault "EyeQ_Fatal_Error_App_Error_Fault_12_3";
BA_ "GenSigSendType" SG_ 1811 EyeQ_Fatal_Error_App_Calibration 0;
BA_ "SystemSignalLongSymbol" SG_ 1811 EyeQ_Fatal_Error_App_Calibration "EyeQ_Fatal_Error_App_Calibration_Error_Fault_12_5";
BA_ "SystemSignalLongSymbol" SG_ 1811 EYEQ_33_ROAD_LANE_DISQUALIFICATI "EYEQ_33_ROAD_LANE_DISQUALIFICATINO_FAILED_B1b_4";
BA_ "SystemSignalLongSymbol" SG_ 1811 EYEQ_42_ROAD_PREDICTION_VALIDATI "EYEQ_42_ROAD_PREDICTION_VALIDATION_B1b_3";
BA_ "SystemSignalLongSymbol" SG_ 1811 EYEQ_MES_49_Data_Path_Corruption "EYEQ_MES_49_Data_Path_Corruption_B1a_7";
BA_ "GenSigSendType" SG_ 1811 EyeQ_Minor_Error_Bm_Em_Err_Faile 0;
BA_ "SystemSignalLongSymbol" SG_ 1811 EyeQ_Minor_Error_Bm_Em_Err_Faile "EyeQ_Minor_Error_Bm_Em_Err_Failed_Post_Init_IL_Fault_15_4";
BA_ "GenSigSendType" SG_ 1811 EyeQ_Minor_Error_Bm_Em_Error_Fau 0;
BA_ "SystemSignalLongSymbol" SG_ 1811 EyeQ_Minor_Error_Bm_Em_Error_Fau "EyeQ_Minor_Error_Bm_Em_Error_Fault_14_1";
BA_ "GenSigSendType" SG_ 1811 EyeQ_Minor_Error_Bm_Em_Err__0000 0;
BA_ "SystemSignalLongSymbol" SG_ 1811 EyeQ_Minor_Error_Bm_Em_Err__0000 "EyeQ_Minor_Error_Bm_Em_Err_Failed_Post_Init_Ep_Fault_15_2";
BA_ "GenSigSendType" SG_ 1811 EyeQ_Minor_Error_Bm_Em_Err__0001 0;
BA_ "SystemSignalLongSymbol" SG_ 1811 EyeQ_Minor_Error_Bm_Em_Err__0001 "EyeQ_Minor_Error_Bm_Em_Err_Failed_Post_Init_Create_Logger_Fault_15_3";
BA_ "GenSigSendType" SG_ 1811 EyeQ_Minor_Error_Bm_Em_Err__0002 0;
BA_ "SystemSignalLongSymbol" SG_ 1811 EyeQ_Minor_Error_Bm_Em_Err__0002 "EyeQ_Minor_Error_Bm_Em_Err_Failed_Open_Blackbox_Fault_15_0";
BA_ "GenSigSendType" SG_ 1811 EyeQ_Minor_Error_Bm_Em_Err__0003 0;
BA_ "SystemSignalLongSymbol" SG_ 1811 EyeQ_Minor_Error_Bm_Em_Err__0003 "EyeQ_Minor_Error_Bm_Em_Err_Failed_Load_Setting_Fault_14_2";
BA_ "GenSigSendType" SG_ 1811 EyeQ_Minor_Error_Bm_Em_Err__0004 0;
BA_ "SystemSignalLongSymbol" SG_ 1811 EyeQ_Minor_Error_Bm_Em_Err__0004 "EyeQ_Minor_Error_Bm_Em_Err_Failed_Load_Registry_Fault_14_3";
BA_ "GenSigSendType" SG_ 1811 EyeQ_Minor_Error_Bm_Em_Err__0005 0;
BA_ "SystemSignalLongSymbol" SG_ 1811 EyeQ_Minor_Error_Bm_Em_Err__0005 "EyeQ_Minor_Error_Bm_Em_Err_Failed_Init_Registry_Fault_14_4";
BA_ "GenSigSendType" SG_ 1811 EyeQ_Minor_Error_Bm_Em_Err__0006 0;
BA_ "SystemSignalLongSymbol" SG_ 1811 EyeQ_Minor_Error_Bm_Em_Err__0006 "EyeQ_Minor_Error_Bm_Em_Err_Failed_Init_Fault_14_5";
BA_ "GenSigSendType" SG_ 1811 EyeQ_Minor_Error_Bm_Em_Err__0007 0;
BA_ "SystemSignalLongSymbol" SG_ 1811 EyeQ_Minor_Error_Bm_Em_Err__0007 "EyeQ_Minor_Error_Bm_Em_Err_Failed_Init_Ep_Fault_15_1";
BA_ "GenSigSendType" SG_ 1811 EyeQ_Minor_Error_Bm_Em_Err__0008 0;
BA_ "SystemSignalLongSymbol" SG_ 1811 EyeQ_Minor_Error_Bm_Em_Err__0008 "EyeQ_Minor_Error_Bm_Em_Err_Failed_Init_Bb_Reg_Fault_14_7";
BA_ "GenSigSendType" SG_ 1811 EyeQ_Minor_Error_Bm_Em_Err__0009 0;
BA_ "SystemSignalLongSymbol" SG_ 1811 EyeQ_Minor_Error_Bm_Em_Err__0009 "EyeQ_Minor_Error_Bm_Em_Err_Failed_Init_Bb_Fault_14_6";
BA_ "GenSigSendType" SG_ 1811 EyeQ_Minor_Error_Bm_Em_Err__0010 0;
BA_ "SystemSignalLongSymbol" SG_ 1811 EyeQ_Minor_Error_Bm_Em_Err__0010 "EyeQ_Minor_Error_Bm_Em_Err_Failed_Check_Reg_Versions_Fault_15_5";
BA_ "GenSigSendType" SG_ 1811 EyeQ_Fatal_Error_Pv_Verificattio 0;
BA_ "SystemSignalLongSymbol" SG_ 1811 EyeQ_Fatal_Error_Pv_Verificattio "EyeQ_Fatal_Error_Pv_Verificattion_Error_Fault_13_7";
BA_ "GenSigSendType" SG_ 1811 EyeQ_Fatal_Error_Pv_General_Erro 0;
BA_ "SystemSignalLongSymbol" SG_ 1811 EyeQ_Fatal_Error_Pv_General_Erro "EyeQ_Fatal_Error_Pv_General_Error_Fault_13_6";
BA_ "GenSigSendType" SG_ 1811 EyeQ_Fatal_Error_Pll_Comparison_ 0;
BA_ "SystemSignalLongSymbol" SG_ 1811 EyeQ_Fatal_Error_Pll_Comparison_ "EyeQ_Fatal_Error_Pll_Comparison_Error_Fault_13_5";
BA_ "GenSigSendType" SG_ 1811 EyeQ_Fatal_Error_App_Pattern_Tes 0;
BA_ "SystemSignalLongSymbol" SG_ 1811 EyeQ_Fatal_Error_App_Pattern_Tes "EyeQ_Fatal_Error_App_Pattern_Test_Fault_13_3";
BA_ "GenSigSendType" SG_ 1811 Host_ENET_VersionMismatch_Err_B8 0;
BA_ "SystemSignalLongSymbol" SG_ 1811 Host_ENET_VersionMismatch_Err_B8 "Host_ENET_VersionMismatch_Err_B8_4";
BA_ "GenSigSendType" SG_ 1811 Host_ENET_Missing_Message_Err_B8 0;
BA_ "SystemSignalLongSymbol" SG_ 1811 Host_ENET_Missing_Message_Err_B8 "Host_ENET_Missing_Message_Err_B8_1";
BA_ "GenSigSendType" SG_ 1811 NVM_E_REQ_FAILED_B0_7 0;
BA_ "GenSigSendType" SG_ 1811 NVM_E_QUEUE_OVERFLOW_FAULT_0_4 0;
BA_ "GenSigSendType" SG_ 1811 NVM_E_LOSS_OF_REDUNDANCY_B0_6 0;
BA_ "GenSigSendType" SG_ 1811 NVM_E_INTEGRITY_FAILED_FAULT_0_5 0;
BA_ "GenSigSendType" SG_ 1811 NBID_CRC_BOOT_REPORTED_B8_0 0;
BA_ "GenSigSendType" SG_ 1811 MISSING_CAMERA_CALIBRATION_Bf_5 0;
BA_ "GenSigSendType" SG_ 1811 MCU4_RollingCounter_B39_6 0;
BA_ "GenSigSendType" SG_ 1811 MCU4_CheckSum_B3d_6 0;
BA_ "GenSigSendType" SG_ 1811 MCU_FD1_Timeout_B28_0 0;
BA_ "GenSigSendType" SG_ 1811 MCU_FD1_ActTrq_Invalid_B33_1 0;
BA_ "GenSigSendType" SG_ 1811 Host_ENET_MessageReception_Err_B 0;
BA_ "SystemSignalLongSymbol" SG_ 1811 Host_ENET_MessageReception_Err_B "Host_ENET_MessageReception_Err_B8_3";
BA_ "GenSigSendType" SG_ 1811 IFC_FD1_0x12B_Mute_B22_1 0;
BA_ "GenSigSendType" SG_ 1811 HUT_FD1_TSR_SnvtySet_B30_2 0;
BA_ "GenSigSendType" SG_ 1811 HUT_FD1_Timeout_B26_2 0;
BA_ "GenSigSendType" SG_ 1811 HUT_FD1_NavSpdLimValue_B30_4 0;
BA_ "GenSigSendType" SG_ 1811 HUT_FD1_NavSpdLimUnit_B30_5 0;
BA_ "GenSigSendType" SG_ 1811 HUT_FD1_LSSWarnFormSwtReq_B30_1 0;
BA_ "GenSigSendType" SG_ 1811 HUT_FD1_IFC_SnvtySet_Abnor_B30_0 0;
BA_ "GenSigSendType" SG_ 1811 HUT_FD1_FCW_SnvtySet_Abnor_B30_7 0;
BA_ "GenSigSendType" SG_ 1811 HOST_HEATER_PWR_AURIX_B7_6 0;
BA_ "GenSigSendType" SG_ 1811 Host_ENET_Missing_Data_Err_B8_2 0;
BA_ "GenSigSendType" SG_ 1811 GRAB_VIDEO_TIMEOUT_B4_7 0;
BA_ "GenSigSendType" SG_ 1811 Frozen_Windshield_Fault_11_3 0;
BA_ "GenSigSendType" SG_ 1811 FET_Fault_Across_cycles_B2_4 0;
BA_ "GenSigSendType" SG_ 1811 FEE_E_WRITE_FAULT_B1_1 0;
BA_ "GenSigSendType" SG_ 1811 FEE_E_WRITE_CYCLES_EXHAUST_B2_0 0;
BA_ "GenSigSendType" SG_ 1811 FEE_E_UNCONFIG_BLK_EXCEED_B2_2 0;
BA_ "GenSigSendType" SG_ 1811 FEE_E_READ_FAULT_B1_2 0;
BA_ "GenSigSendType" SG_ 1811 FEE_E_INVALIDATE_FAULT_B1_7 0;
BA_ "GenSigSendType" SG_ 1811 FEE_E_GC_WRITE_FAULT_B1_3 0;
BA_ "GenSigSendType" SG_ 1811 FEE_E_GC_TRIG_FAULT_B2_1 0;
BA_ "GenSigSendType" SG_ 1811 FEE_E_GC_INIT_FAULT_B1_0 0;
BA_ "GenSigSendType" SG_ 1811 FEE_E_GC_ERASE_FAULT_B1_6 0;
BA_ "GenSigSendType" SG_ 1811 FactoryMode_B20_7 0;
BA_ "GenSigSendType" SG_ 1811 F_PBox1_Timeout_B24_3 0;
BA_ "GenSigSendType" SG_ 1811 EYQQ_ROAD_INFO_COUNTER_ERROR_2_6 0;
BA_ "GenSigSendType" SG_ 1811 EYEQ_VISION_SAFETY_DIAG_RFC_B5_3 0;
BA_ "GenSigSendType" SG_ 1811 EYEQ_VISION_SAFETY_DIAG_CRC_B5_2 0;
BA_ "GenSigSendType" SG_ 1811 EYEQ_VISION_AEB_INFO_RFC_B5_1 0;
BA_ "GenSigSendType" SG_ 1811 EYEQ_VISION_AEB_INFO_CRC_B5_0 0;
BA_ "GenSigSendType" SG_ 1811 EYEQ_VIS_OBSTACLES_INFO_RFC_B5_6 0;
BA_ "GenSigSendType" SG_ 1811 EYEQ_VIS_OBSTACLES_INFO_CRC_B5_5 0;
BA_ "GenSigSendType" SG_ 1811 EYEQ_VIS_FAILSAFESRFCFAULT_B6_4 0;
BA_ "GenSigSendType" SG_ 1811 EYEQ_VIS_FAILSAFESCRCFAULT_B6_3 0;
BA_ "GenSigSendType" SG_ 1811 EYEQ_STATIC_RFC_FAULT_B6_2 0;
BA_ "GenSigSendType" SG_ 1811 EYEQ_DYNAMIC_RFC_FAULT_B6_0 0;
BA_ "GenSigSendType" SG_ 1811 EYEQ_DYNAMIC_CRC_FAULT_B5_7 0;
BA_ "GenSigSendType" SG_ 1811 EYEQ_ROAD_INFO_CRC_FAULT_B5_4 0;
BA_ "GenSigSendType" SG_ 1811 EYEQ_OTA_SWAP_FAULT_B7_5 0;
BA_ "GenSigSendType" SG_ 1811 EYEQ_GEN_CR_ERR_FAULT_B2_3 0;
BA_ "GenSigSendType" SG_ 1811 ESP2_VehStandstill_Invalid_B2c_2 0;
BA_ "GenSigSendType" SG_ 1811 ESP2_Timeout_B27_4 0;
BA_ "GenSigSendType" SG_ 1811 ESP2_RollingCounter_B37_4 0;
BA_ "GenSigSendType" SG_ 1811 ESP2_HDCCtrl_Abnormal_B35_5 0;
BA_ "GenSigSendType" SG_ 1811 ESP2_DrivingModDis_Abnor_B35_6 0;
BA_ "GenSigSendType" SG_ 1811 ESP2_CheckSum_B3b_4 0;
BA_ "GenSigSendType" SG_ 1811 ESP2_CDDAvailable_Error_B2c_0 0;
BA_ "GenSigSendType" SG_ 1811 ESP2_AWBAvailable_Error_B2d_2 0;
BA_ "GenSigSendType" SG_ 1811 ESP2_AEBAvailable_Error_B2c_4 0;
BA_ "GenSigSendType" SG_ 1811 ESP2_ABPAvailable_Error_B2c_6 0;
BA_ "GenSigSendType" SG_ 1811 ESP2_ABAavailable_Error_B2d_0 0;
BA_ "GenSigSendType" SG_ 1811 ESP1_Timeout_B27_3 0;
BA_ "GenSigSendType" SG_ 1811 ESP1_RollingCounter_B37_3 0;
BA_ "GenSigSendType" SG_ 1811 ESP1_MasterCylBrkPress_B2b_0 0;
BA_ "GenSigSendType" SG_ 1811 ESP1_ESPFailSts_Failure_B2b_6 0;
BA_ "GenSigSendType" SG_ 1811 ESP1_CheckSum_B3b_3 0;
BA_ "GenSigSendType" SG_ 1811 ESP_FD3_Timeout_B27_7 0;
BA_ "GenSigSendType" SG_ 1811 ESP_FD3_SwtPosn_Invalid_B2e_1 0;
BA_ "GenSigSendType" SG_ 1811 ESP_FD3_RRWheelSpd_Invalid_B2a_7 0;
BA_ "GenSigSendType" SG_ 1811 ESP_FD3_RRWhDriveDirection_B29_3 0;
BA_ "GenSigSendType" SG_ 1811 ESP_FD3_RLWheelSpd_Invalid_B2a_5 0;
BA_ "GenSigSendType" SG_ 1811 ESP_FD3_RLWhDriveDirection_B29_1 0;
BA_ "GenSigSendType" SG_ 1811 ESP_FD3_FRWheelSpd_Invalid_B2a_3 0;
BA_ "GenSigSendType" SG_ 1811 ESP_FD3_FRWhDriveDirection_B29_7 0;
BA_ "GenSigSendType" SG_ 1811 ESP_FD3_FLWheelSpd_Invalid_B2a_1 0;
BA_ "GenSigSendType" SG_ 1811 ESP_FD3_FLWhDriveDirection_B29_5 0;
BA_ "GenSigSendType" SG_ 1811 ESP_FD3_EPBSts_Error_B2e_5 0;
BA_ "GenSigSendType" SG_ 1811 ESP_FD3_EPBErrSts_Error_B2e_3 0;
BA_ "GenSigSendType" SG_ 1811 ESP_FD3_EPB1_RollCounter_B38_2 0;
BA_ "GenSigSendType" SG_ 1811 ESP_FD3_EPB1_CheckSum_B3c_2 0;
BA_ "GenSigSendType" SG_ 1811 ESP_FD3_ABS2_RollCounter_B38_4 0;
BA_ "GenSigSendType" SG_ 1811 ESP_FD3_ABS2_CheckSum_B3c_4 0;
BA_ "GenSigSendType" SG_ 1811 ESP_FD3_ABS1_RollCounter_B38_3 0;
BA_ "GenSigSendType" SG_ 1811 ESP_FD3_ABS1_CheckSum_B3c_3 0;
BA_ "GenSigSendType" SG_ 1811 ESP_FD2_VehStandstill_B2c_3 0;
BA_ "GenSigSendType" SG_ 1811 ESP_FD2_VehSpd_Missing_B21_5 0;
BA_ "GenSigSendType" SG_ 1811 ESP_FD2_VehSpd_Invalid_B2b_5 0;
BA_ "GenSigSendType" SG_ 1811 ESP_FD2_Timeout_B27_6 0;
BA_ "GenSigSendType" SG_ 1811 ESP_FD2_MasterCylBrkPress_B2b_1 0;
BA_ "GenSigSendType" SG_ 1811 ESP_FD2_ESPFailSts_Failure_B2b_7 0;
BA_ "GenSigSendType" SG_ 1811 ESP_FD2_ESP2_RollCounter_B38_7 0;
BA_ "GenSigSendType" SG_ 1811 ESP_FD2_ESP2_CheckSum_B3c_7 0;
BA_ "GenSigSendType" SG_ 1811 ESP_FD2_ESP1_RollCounter_B38_6 0;
BA_ "GenSigSendType" SG_ 1811 ESP_FD2_ESP1_CheckSum_B3c_6 0;
BA_ "GenSigSendType" SG_ 1811 ESP_FD2_CDDAvailable_Error_B2c_1 0;
BA_ "GenSigSendType" SG_ 1811 ESP_FD2_AWBAvailable_Error_B2d_3 0;
BA_ "GenSigSendType" SG_ 1811 ESP_FD2_AEBAvailable_Error_B2c_5 0;
BA_ "GenSigSendType" SG_ 1811 ESP_FD2_ABSFailSts_Failure_B2b_3 0;
BA_ "GenSigSendType" SG_ 1811 ESP_FD2_ABS3_RollCounter_B38_5 0;
BA_ "GenSigSendType" SG_ 1811 ESP_FD2_ABS3_CheckSum_B3c_5 0;
BA_ "GenSigSendType" SG_ 1811 ESP_FD2_ABPAvailable_Error_B2c_7 0;
BA_ "GenSigSendType" SG_ 1811 ESP_FD2_ABAavailable_Error_B2d_1 0;
BA_ "GenSigSendType" SG_ 1811 EPS2_Timeout_B26_1 0;
BA_ "GenSigSendType" SG_ 1811 EPS2_RollingCounter_B36_6 0;
BA_ "GenSigSendType" SG_ 1811 EPS2_LKATrqOvlDlvdSts_Temp_B2f_6 0;
BA_ "GenSigSendType" SG_ 1811 EPS2_LKATrqOvlDlvdSts_Perm_B2f_7 0;
BA_ "GenSigSendType" SG_ 1811 EPS2_CheckSum_B3a_6 0;
BA_ "GenSigSendType" SG_ 1811 EPS1_Timeout_B26_0 0;
BA_ "GenSigSendType" SG_ 1811 EPS1_SteerMod_Abnormal_B32_1 0;
BA_ "GenSigSendType" SG_ 1811 EPS1_EPSFailSts_Failure_B32_0 0;
BA_ "GenSigSendType" SG_ 1811 EPB1_Timeout_B27_5 0;
BA_ "GenSigSendType" SG_ 1811 EPB1_SwtPosn_Invalid_B2e_0 0;
BA_ "GenSigSendType" SG_ 1811 EPB1_RollingCounter_B37_5 0;
BA_ "GenSigSendType" SG_ 1811 EPB1_EPBSts_Error_B2e_4 0;
BA_ "GenSigSendType" SG_ 1811 EPB1_EPBErrSts_Error_B2e_2 0;
BA_ "GenSigSendType" SG_ 1811 EPB1_CheckSum_B3b_5 0;
BA_ "GenSigSendType" SG_ 1811 ECM9_Timeout_B23_6 0;
BA_ "GenSigSendType" SG_ 1811 ECM9_RollingCounter_B38_1 0;
BA_ "GenSigSendType" SG_ 1811 ECM9_ECMACCInterface_Error_B34_6 0;
BA_ "GenSigSendType" SG_ 1811 ECM9_Checksum_B3c_1 0;
BA_ "GenSigSendType" SG_ 1811 ECM8_TrqLoss_Invalid_B34_5 0;
BA_ "GenSigSendType" SG_ 1811 ECM8_Timeout_B23_5 0;
BA_ "GenSigSendType" SG_ 1811 ECM7_Timeout_B23_4 0;
BA_ "GenSigSendType" SG_ 1811 ECM4_Timeout_B23_3 0;
BA_ "GenSigSendType" SG_ 1811 ECM4_RollingCounter_B38_0 0;
BA_ "GenSigSendType" SG_ 1811 ECM4_NetEngTrq_Invalid_B34_3 0;
BA_ "GenSigSendType" SG_ 1811 ECM4_DrvEngTrqReq_Invalid_B34_4 0;
BA_ "GenSigSendType" SG_ 1811 ECM4_Checksum_B3c_0 0;
BA_ "GenSigSendType" SG_ 1811 ECM3_Timeout_B23_2 0;
BA_ "GenSigSendType" SG_ 1811 ECM3_MaxEngTrqNorm_Abnorm_B34_2 0;
BA_ "GenSigSendType" SG_ 1811 ECM2_Timeout_B23_1 0;
BA_ "GenSigSendType" SG_ 1811 ECM2_AccelPedalPosn_Invd_B2d_6 0;
BA_ "GenSigSendType" SG_ 1811 ECM1_Timeout_B23_0 0;
BA_ "GenSigSendType" SG_ 1811 ECM1_Start_StopSts_Invalid_B34_1 0;
BA_ "GenSigSendType" SG_ 1811 ECM1_RollingCounter_B37_7 0;
BA_ "GenSigSendType" SG_ 1811 ECM1_Checksum_B3b_7 0;
BA_ "GenSigSendType" SG_ 1811 ECM1_BrkPedalSts_Error_B2d_4 0;
BA_ "GenSigSendType" SG_ 1811 DCT7_Timeout_B24_1 0;
BA_ "GenSigSendType" SG_ 1811 DCT7_DrvFaiMsg_Failure_B35_4 0;
BA_ "GenSigSendType" SG_ 1811 DCT5_Timeout_B24_0 0;
BA_ "GenSigSendType" SG_ 1811 DCT5_TARGET_GEAR_Invalid_B35_2 0;
BA_ "GenSigSendType" SG_ 1811 DCT5_ShiftInPrg_Invalid_B35_1 0;
BA_ "GenSigSendType" SG_ 1811 DCT5_RollingCounter_B37_6 0;
BA_ "GenSigSendType" SG_ 1811 DCT5_CurrentGear_Invalid_B35_0 0;
BA_ "GenSigSendType" SG_ 1811 DCT5_CheckSum_B3b_6 0;
BA_ "GenSigSendType" SG_ 1811 DCT3_Timeout_B23_7 0;
BA_ "GenSigSendType" SG_ 1811 CSA2_Timeout_B25_4 0;
BA_ "GenSigSendType" SG_ 1811 CSA2_SteerWheelSpd_Invalid_B31_2 0;
BA_ "GenSigSendType" SG_ 1811 CSA2_SteerWheelAng_Invalid_B31_1 0;
BA_ "GenSigSendType" SG_ 1811 CSA2_SAS_Sts_Error_B31_4 0;
BA_ "GenSigSendType" SG_ 1811 CSA2_Rollingcounter_B36_5 0;
BA_ "GenSigSendType" SG_ 1811 CSA2_Checksum_B3a_5 0;
BA_ "GenSigSendType" SG_ 1811 CSA2_CC_ACCSwt_Error_B31_3 0;
BA_ "GenSigSendType" SG_ 1811 CSA1_Timeout_B25_3 0;
BA_ "GenSigSendType" SG_ 1811 CSA1_FrntWiprSwtSts_Error_B31_0 0;
BA_ "GenSigSendType" SG_ 1811 Vision_Internal_Error_B1f_6 0;
BA_ "GenSigSendType" SG_ 1811 EyeQ_Spi_Msg_Timeout_A_7 0;
BA_ "GenSigSendType" SG_ 1811 Host_Spi_CRC_Error_A_2 0;
BA_ "GenSigSendType" SG_ 1811 Host_Spi_Tx_Error_A_1 0;
BA_ "GenSigSendType" SG_ 1811 Host_spi_msg_timeout_A_0 0;
BA_ "GenSigSendType" SG_ 1811 EyeQ_Calibration_Checksum_9_4 0;
BA_ "GenSigSendType" SG_ 1811 Imager_2V8_Supply_OutRange_6_7 0;
BA_ "GenSigSendType" SG_ 1811 Aurix_1V25_Supply_OutRange_B6_6 0;
BA_ "GenSigSendType" SG_ 1811 Imager_1V2_Supply_OutRange_6_5 0;
BA_ "GenSigSendType" SG_ 1811 Battery_High_Fault_B21_2 0;
BA_ "GenSigSendType" SG_ 1811 Battery_Low_Fault_B21_1 0;
BA_ "GenSigSendType" SG_ 1811 PS_5V0_Out_Of_Range_4_4 0;
BA_ "GenSigSendType" SG_ 1811 EyeQDDROnBrdThermstorOutRang_4_3 0;
BA_ "GenSigSendType" SG_ 1811 EyeQDDROnBrdThermstorOveTemp_4_1 0;
BA_ "GenSigSendType" SG_ 1811 EyeQ_Temp_Exceeded_3_0 0;
BA_ "GenSigSendType" SG_ 1811 SYSTEM_OVER_TEMPERATURE_2_7 0;
BA_ "GenSigSendType" SG_ 1811 EyeQ_Error_Out_Temp_Fault_1A_6 0;
BA_ "GenSigSendType" SG_ 1811 EyeQErrOutSignalInternFault_1A_5 0;
BA_ "GenSigSendType" SG_ 1811 EyeQ_Camera1_Temp_Fault_1A_4 0;
BA_ "GenSigSendType" SG_ 1811 EyeQVdoErrFlg_ShotOutOfSync_1A_3 0;
BA_ "GenSigSendType" SG_ 1811 EyeQVdoErrFlg_VdiErrShutdwn_1A_2 0;
BA_ "GenSigSendType" SG_ 1811 EyeQVdoErrFlg_HdrVerifiErr_1A_1 0;
BA_ "GenSigSendType" SG_ 1811 EyeQVdoErrFlg_CcftDecisionMismat 0;
BA_ "GenSigSendType" SG_ 1811 EyeQVdoErrFlg_HistogramsMismatch 0;
BA_ "GenSigSendType" SG_ 1811 EyeQVdoErrFlg_FrameCountReadFail 0;
BA_ "GenSigSendType" SG_ 1811 EyeQVdoErrFlgVdiErr_CoreIdFlt 0;
BA_ "GenSigSendType" SG_ 1811 EyeQVdoErrFlgVdiErr_StrtAftStrt 0;
BA_ "GenSigSendType" SG_ 1811 EyeQVdoErrFlgVdiErr_ParityHisFlt 0;
BA_ "GenSigSendType" SG_ 1811 EyeQVdoErrFlgVdiErr_ParityGamma 0;
BA_ "GenSigSendType" SG_ 1811 EyeQVdoErrFlgVdiErr_ParityWeight 0;
BA_ "GenSigSendType" SG_ 1811 EyeQVdoErrFlgVdiErr_ParityFifo 0;
BA_ "GenSigSendType" SG_ 1811 EyeQVdoErrFlgVdiErrFifo_Undflow 0;
BA_ "GenSigSendType" SG_ 1811 EyeQVdoErrFlgVdiErrFifo_Overflow 0;
BA_ "GenSigSendType" SG_ 1811 EyeQVdoErrFlgVdiErr_Timeout_18_5 0;
BA_ "GenSigSendType" SG_ 1811 EyeQVdoErrFlgVdiErr_BuffInvldFmt 0;
BA_ "GenSigSendType" SG_ 1811 EyeQVdoErrFlg_Vdi_ErrNoBuff_18_3 0;
BA_ "GenSigSendType" SG_ 1811 EyeQVdoErrFlgVdi_InternErr18_2 0;
BA_ "GenSigSendType" SG_ 1811 EyeQVdoErrFlgSumNotMatHistgrmErr 0;
BA_ "GenSigSendType" SG_ 1811 EyeQVdoErrFlgZeroHistgrmErr_18_0 0;
BA_ "GenSigSendType" SG_ 1811 EyeQVdoErrFlgRegWrtHilFailErr 0;
BA_ "GenSigSendType" SG_ 1811 EyeQVdoErrFlgErrRegFlagFlt_17_6 0;
BA_ "GenSigSendType" SG_ 1811 EyeQVdoErrFlgInvldVdoHeaderFault 0;
BA_ "GenSigSendType" SG_ 1811 EyeQVdoErrFlgVerifiFailVdoErr 0;
BA_ "GenSigSendType" SG_ 1811 EyeQVdoErrFlgInconstFramVdoErr 0;
BA_ "GenSigSendType" SG_ 1811 EyeQ_Cam1VdoErrFlgLgcVdoErr_17_2 0;
BA_ "GenSigSendType" SG_ 1811 EyeQCam1VdoErrFlgI2CNoOnTmVdoErr 0;
BA_ "GenSigSendType" SG_ 1811 EyeQCam1VdoErrFlgVdiVdoErr_17_0 0;
BA_ "GenSigSendType" SG_ 1811 EyeQ_Cam_Vdo_Flt_16_7 0;
BA_ "GenSigSendType" SG_ 1811 EyeQ_Cam_Ctrl_Flt_16_6 0;
BA_ "GenSigSendType" SG_ 1811 EyeQ_Cam_Mal_Func_16_5 0;
BA_ "GenSigSendType" SG_ 1811 Grab_Release_Failure_16_4 0;
BA_ "GenSigSendType" SG_ 1811 Grab_Acquire_Failure_16_3 0;
BA_ "GenSigSendType" SG_ 1811 Grab_Issue_Failure_16_2 0;
BA_ "GenSigSendType" SG_ 1811 Grab_No_Free_Header_Failure_16_1 0;
BA_ "GenSigSendType" SG_ 1811 Init_I2C_Failure_16_0 0;
BA_ "GenSigSendType" SG_ 1811 Init_Vdi_Failure_15_7 0;
BA_ "GenSigSendType" SG_ 1811 EyeQFatalErrApCamParaCcftCrc13_4 0;
BA_ "GenSigSendType" SG_ 1811 EyeQFatalErrAppI2CTimoutErr_13_2 0;
BA_ "GenSigSendType" SG_ 1811 EyeQFatalErrAppI2CCamSlfRst_13_1 0;
BA_ "GenSigSendType" SG_ 1811 EyeQFatalErrAppI2CVidoGrb_13_0 0;
BA_ "GenSigSendType" SG_ 1811 EYEQ_GEN54ACCSTLEXECUTFAILED_F_3 0;
BA_ "GenSigSendType" SG_ 1811 EYEQ_GEN_26_CODE_CRC_E_1 0;
BA_ "GenSigSendType" SG_ 1811 EyeQ_Core_Dump_Fault_C_5 0;
BA_ "GenSigSendType" SG_ 1811 EyeQ_Init_Timeout_Fault_C_4 0;
BA_ "GenSigSendType" SG_ 1811 EYEQ4_Mode_Fault_C_3 0;
BA_ "GenSigSendType" SG_ 1811 EyeQ_Bist_Memory_Fault_C_2 0;
BA_ "GenSigSendType" SG_ 1811 EyeQ_Core_Fault_C_1 0;
BA_ "GenSigSendType" SG_ 1811 EyeQ_Boot_Fault_C_0 0;
BA_ "GenSigSendType" SG_ 1811 EyeQ_DDR_Fault_B_6 0;
BA_ "GenSigSendType" SG_ 1811 EyeQ_SerialFlashPowerUp_Fail_B_1 0;
BA_ "GenSigSendType" SG_ 1811 EyeQ_SPI_CRC_ERROR_B_0 0;
BA_ "GenSigSendType" SG_ 1811 EYEQ_Spi_Msg_Format_Error_A_6 0;
BA_ "GenSigSendType" SG_ 1811 EyeQ_Spi_Frame_Format_Error_A_5 0;
BA_ "GenSigSendType" SG_ 1811 Spi_Ipc_Comm_Reset_A_4 0;
BA_ "GenSigSendType" SG_ 1811 Spi_version_mismatch_A_3 0;
BA_ "GenSigSendType" SG_ 1811 Host_Spi_Msg_Format_Error_9_7 0;
BA_ "GenSigSendType" SG_ 1811 Host_Spi_Frame_Format_Error_9_6 0;
BA_ "GenSigSendType" SG_ 1811 EyeQ_Application_Checksum_9_3 0;
BA_ "GenSigSendType" SG_ 1811 EyeQAppl_CompltAndComptibl_9_2 0;
BA_ "GenSigSendType" SG_ 1811 EyeQOnBoardThermstorOutRange_4_2 0;
BA_ "GenSigSendType" SG_ 1811 EyeQ_DDR_Over_Temp_4_0 0;
BA_ "GenSigSendType" SG_ 1811 EyeQ_Boot_OverTemp_Fault_3_7 0;
BA_ "GenSigSendType" SG_ 1811 EyeQ_Imager_Over_Temp_3_6 0;
BA_ "GenSigSendType" SG_ 1811 EyeQ_VMP_Over_Temp_3_5 0;
BA_ "GenSigSendType" SG_ 1811 EyeQ_MIPS_Over_Temp_3_4 0;
BA_ "GenSigSendType" SG_ 1811 EyeQOnBoardThermistorOveTemp_3_1 0;
BA_ "GenSigSendType" SG_ 1811 EYEQ_1V0_SUPPLY_OUT_OF_RANGE_0_3 0;
BA_ "GenSigSendType" SG_ 1811 EYEQ_1V1_SUPPLY_OUT_OF_RANGE_0_2 0;
BA_ "GenSigSendType" SG_ 1811 EYEQ_1V8_SUPPLY_OUT_OF_RANGE_0_1 0;
BA_ "GenSigSendType" SG_ 1811 EYEQ_3V3_SUPPLY_OUT_OF_RANGE_0_0 0;
BA_ "SystemSignalLongSymbol" SG_ 1811 Windshield_heater_OPNLD_Error_B3 "Windshield_heater_OPNLD_Error_B3E_0";
BA_ "SystemSignalLongSymbol" SG_ 1811 WWINDSHIELD_HEATER_STG_FAULT_B3E "WWINDSHIELD_HEATER_STG_FAULT_B3E_1";
BA_ "SystemSignalLongSymbol" SG_ 1811 WINDSHIELD_HEATER_OVRLD_FAULT_B3 "WINDSHIELD_HEATER_OVRLD_FAULT_B3E_2";
BA_ "SystemSignalLongSymbol" SG_ 1811 WINDSHIELD_HEATER_STB_FAULT_B3E_ "WINDSHIELD_HEATER_STB_FAULT_B3E_3";
BA_ "GenSigSendType" SG_ 1810 DCT3_RatAct_Error_B2e_7 0;
BA_ "GenSigSendType" SG_ 1810 ECM2_EngState_Error_B2e_6 0;
BA_ "SystemSignalLongSymbol" SG_ 1810 EYEQ_MINOR_ERROR_BM_EM_ERR__0000 "EYEQ_MINOR_ERROR_BM_EM_ERR_FAILED_NB_OPERATION_FAULT_B15_6";
BA_ "GenSigSendType" SG_ 1810 EYEQ_STATIC_CRC_FAULT_B6_1 0;
BA_ "GenSigSendType" SG_ 1810 FEE_E_GC_READ_FAULT_B1_4 0;
BA_ "GenSigSendType" SG_ 1810 EYEQ_GEN_34_Corrupted_Vehic_0000 0;
BA_ "SystemSignalLongSymbol" SG_ 1810 EYEQ_GEN_34_Corrupted_Vehic_0000 "EYEQ_GEN_34_Corrupted_Vehicle_Info_Input_Signals_Bf_1";
BA_ "GenSigSendType" SG_ 1810 EYEQ_GEN_11_INPUT_CRC_MISMA_0000 0;
BA_ "SystemSignalLongSymbol" SG_ 1810 EYEQ_GEN_11_INPUT_CRC_MISMA_0000 "EYEQ_GEN_11_INPUT_CRC_MISMATCH_Bf_0";
BA_ "GenSigSendType" SG_ 1810 EYEQ_GEN_4_YAW_HORIZON_DEVI_0000 0;
BA_ "SystemSignalLongSymbol" SG_ 1810 EYEQ_GEN_4_YAW_HORIZON_DEVI_0000 "EYEQ_GEN_4_YAW_HORIZON_DEVIATION_Be_0";
BA_ "GenSigSendType" SG_ 1810 EYEQ_GEN_18_IMAGER_DATA_ROW_0000 0;
BA_ "SystemSignalLongSymbol" SG_ 1810 EYEQ_GEN_18_IMAGER_DATA_ROW_0000 "EYEQ_GEN_18_IMAGER_DATA_ROWS_COLS_Bd_7";
BA_ "GenSigSendType" SG_ 1810 EYEQ_GEN_13_OLD_EGODATA_LAT_Be_2 0;
BA_ "GenSigSendType" SG_ 1810 AEB_shutdown_9_ROI_DIFF_VC__0000 0;
BA_ "SystemSignalLongSymbol" SG_ 1810 AEB_shutdown_9_ROI_DIFF_VC__0000 "AEB_shutdown_9_ROI_DIFF_VC_FCV_Bd_3";
BA_ "GenSigSendType" SG_ 1810 AEB_shutdown_7_POS_DIFF_KAL_0000 0;
BA_ "SystemSignalLongSymbol" SG_ 1810 AEB_shutdown_7_POS_DIFF_KAL_0000 "AEB_shutdown_7_POS_DIFF_KALMAN_VAL_Bd_2";
BA_ "GenSigSendType" SG_ 1810 EYEQ_GEN_50_VMP_SANITY_FAIL_0000 0;
BA_ "SystemSignalLongSymbol" SG_ 1810 EYEQ_GEN_50_VMP_SANITY_FAIL_0000 "EYEQ_GEN_50_VMP_SANITY_FAILED_FAULT_1b_0";
BA_ "GenSigSendType" SG_ 1810 EYEQ_FATAL_ERROR_APP_CPS_ST_0000 0;
BA_ "SystemSignalLongSymbol" SG_ 1810 EYEQ_FATAL_ERROR_APP_CPS_ST_0000 "EYEQ_FATAL_ERROR_APP_CPS_STL_FAILED_FAULT_12_2";
BA_ "GenSigSendType" SG_ 1810 EYEQ_GEN_24_CCFT_DIFF_RESUL_0000 0;
BA_ "SystemSignalLongSymbol" SG_ 1810 EYEQ_GEN_24_CCFT_DIFF_RESUL_0000 "EYEQ_GEN_24_CCFT_DIFF_RESULTS_FAULT_1c_3";
BA_ "SystemSignalLongSymbol" SG_ 1810 EYEQ_53_DECELERATION_DBS_OV_0000 "EYEQ_53_DECELERATION_DBS_OVERLAP_FAULT_B1c_2";
BA_ "SystemSignalLongSymbol" SG_ 1810 EYEQ_44_ROAD_SANITY_CORRECT_0000 "EYEQ_44_ROAD_SANITY_CORRECTION_VALIDATION_FAULT_B1c_1";
BA_ "GenSigSendType" SG_ 1810 EYEQ_GEN_21_CAMERA_HEIGHT_L_0000 0;
BA_ "SystemSignalLongSymbol" SG_ 1810 EYEQ_GEN_21_CAMERA_HEIGHT_L_0000 "EYEQ_GEN_21_CAMERA_HEIGHT_LIMIT_EXCEEDED_FAULT_1c_0";
BA_ "GenSigSendType" SG_ 1810 EYEQ_FATAL_ERROR_APP_INVALI_0000 0;
BA_ "SystemSignalLongSymbol" SG_ 1810 EYEQ_FATAL_ERROR_APP_INVALI_0000 "EYEQ_FATAL_ERROR_APP_INVALID_INTRINSIC_CALIB_FAULT_1b_5";
BA_ "SystemSignalLongSymbol" SG_ 1810 EYEQ_45_ROAD_SFCONF_VALIDAT_0000 "EYEQ_45_ROAD_SFCONF_VALIDATION_B1b_2";
BA_ "SystemSignalLongSymbol" SG_ 1810 EYEQ_48_ALGO_PITCH_MISMATCH_0000 "EYEQ_48_ALGO_PITCH_MISMATCH_B1b_1";
BA_ "GenSigSendType" SG_ 1810 EyeQ_Minor_Error_Bm_Error_F_0000 0;
BA_ "SystemSignalLongSymbol" SG_ 1810 EyeQ_Minor_Error_Bm_Error_F_0000 "EyeQ_Minor_Error_Bm_Error_Fault_14_0";
BA_ "GenSigSendType" SG_ 1810 EyeQ_Fatal_Error_App_Init_F_0000 0;
BA_ "SystemSignalLongSymbol" SG_ 1810 EyeQ_Fatal_Error_App_Init_F_0000 "EyeQ_Fatal_Error_App_Init_Failed_Fault_12_6";
BA_ "GenSigSendType" SG_ 1810 EyeQ_Fatal_Error_App_Init_C_0000 0;
BA_ "SystemSignalLongSymbol" SG_ 1810 EyeQ_Fatal_Error_App_Init_C_0000 "EyeQ_Fatal_Error_App_Init_Camera_Init_Fault_12_7";
BA_ "GenSigSendType" SG_ 1810 EyeQ_Fatal_Error_App_Fs_Err_0000 0;
BA_ "SystemSignalLongSymbol" SG_ 1810 EyeQ_Fatal_Error_App_Fs_Err_0000 "EyeQ_Fatal_Error_App_Fs_Error_Fault_12_4";
BA_ "GenSigSendType" SG_ 1810 EyeQ_Fatal_Error_App_Error__0000 0;
BA_ "SystemSignalLongSymbol" SG_ 1810 EyeQ_Fatal_Error_App_Error__0000 "EyeQ_Fatal_Error_App_Error_Fault_12_3";
BA_ "GenSigSendType" SG_ 1810 EyeQ_Fatal_Error_App_Calibr_0000 0;
BA_ "SystemSignalLongSymbol" SG_ 1810 EyeQ_Fatal_Error_App_Calibr_0000 "EyeQ_Fatal_Error_App_Calibration_Error_Fault_12_5";
BA_ "SystemSignalLongSymbol" SG_ 1810 EYEQ_33_ROAD_LANE_DISQUALIF_0000 "EYEQ_33_ROAD_LANE_DISQUALIFICATINO_FAILED_B1b_4";
BA_ "SystemSignalLongSymbol" SG_ 1810 EYEQ_42_ROAD_PREDICTION_VAL_0000 "EYEQ_42_ROAD_PREDICTION_VALIDATION_B1b_3";
BA_ "SystemSignalLongSymbol" SG_ 1810 EYEQ_MES_49_Data_Path_Corru_0000 "EYEQ_MES_49_Data_Path_Corruption_B1a_7";
BA_ "GenSigSendType" SG_ 1810 EyeQ_Minor_Error_Bm_Em_Err__0011 0;
BA_ "SystemSignalLongSymbol" SG_ 1810 EyeQ_Minor_Error_Bm_Em_Err__0011 "EyeQ_Minor_Error_Bm_Em_Err_Failed_Post_Init_IL_Fault_15_4";
BA_ "GenSigSendType" SG_ 1810 EyeQ_Minor_Error_Bm_Em_Erro_0000 0;
BA_ "SystemSignalLongSymbol" SG_ 1810 EyeQ_Minor_Error_Bm_Em_Erro_0000 "EyeQ_Minor_Error_Bm_Em_Error_Fault_14_1";
BA_ "GenSigSendType" SG_ 1810 EyeQ_Minor_Error_Bm_Em_Err__0012 0;
BA_ "SystemSignalLongSymbol" SG_ 1810 EyeQ_Minor_Error_Bm_Em_Err__0012 "EyeQ_Minor_Error_Bm_Em_Err_Failed_Post_Init_Ep_Fault_15_2";
BA_ "GenSigSendType" SG_ 1810 EyeQ_Minor_Error_Bm_Em_Err__0013 0;
BA_ "SystemSignalLongSymbol" SG_ 1810 EyeQ_Minor_Error_Bm_Em_Err__0013 "EyeQ_Minor_Error_Bm_Em_Err_Failed_Post_Init_Create_Logger_Fault_15_3";
BA_ "GenSigSendType" SG_ 1810 EyeQ_Minor_Error_Bm_Em_Err__0014 0;
BA_ "SystemSignalLongSymbol" SG_ 1810 EyeQ_Minor_Error_Bm_Em_Err__0014 "EyeQ_Minor_Error_Bm_Em_Err_Failed_Open_Blackbox_Fault_15_0";
BA_ "GenSigSendType" SG_ 1810 EyeQ_Minor_Error_Bm_Em_Err__0015 0;
BA_ "SystemSignalLongSymbol" SG_ 1810 EyeQ_Minor_Error_Bm_Em_Err__0015 "EyeQ_Minor_Error_Bm_Em_Err_Failed_Load_Setting_Fault_14_2";
BA_ "GenSigSendType" SG_ 1810 EyeQ_Minor_Error_Bm_Em_Err__0016 0;
BA_ "SystemSignalLongSymbol" SG_ 1810 EyeQ_Minor_Error_Bm_Em_Err__0016 "EyeQ_Minor_Error_Bm_Em_Err_Failed_Load_Registry_Fault_14_3";
BA_ "GenSigSendType" SG_ 1810 EyeQ_Minor_Error_Bm_Em_Err__0017 0;
BA_ "SystemSignalLongSymbol" SG_ 1810 EyeQ_Minor_Error_Bm_Em_Err__0017 "EyeQ_Minor_Error_Bm_Em_Err_Failed_Init_Registry_Fault_14_4";
BA_ "GenSigSendType" SG_ 1810 EyeQ_Minor_Error_Bm_Em_Err__0018 0;
BA_ "SystemSignalLongSymbol" SG_ 1810 EyeQ_Minor_Error_Bm_Em_Err__0018 "EyeQ_Minor_Error_Bm_Em_Err_Failed_Init_Fault_14_5";
BA_ "GenSigSendType" SG_ 1810 EyeQ_Minor_Error_Bm_Em_Err__0019 0;
BA_ "SystemSignalLongSymbol" SG_ 1810 EyeQ_Minor_Error_Bm_Em_Err__0019 "EyeQ_Minor_Error_Bm_Em_Err_Failed_Init_Ep_Fault_15_1";
BA_ "GenSigSendType" SG_ 1810 EyeQ_Minor_Error_Bm_Em_Err__0020 0;
BA_ "SystemSignalLongSymbol" SG_ 1810 EyeQ_Minor_Error_Bm_Em_Err__0020 "EyeQ_Minor_Error_Bm_Em_Err_Failed_Init_Bb_Reg_Fault_14_7";
BA_ "GenSigSendType" SG_ 1810 EyeQ_Minor_Error_Bm_Em_Err__0021 0;
BA_ "SystemSignalLongSymbol" SG_ 1810 EyeQ_Minor_Error_Bm_Em_Err__0021 "EyeQ_Minor_Error_Bm_Em_Err_Failed_Init_Bb_Fault_14_6";
BA_ "GenSigSendType" SG_ 1810 EyeQ_Minor_Error_Bm_Em_Err__0022 0;
BA_ "SystemSignalLongSymbol" SG_ 1810 EyeQ_Minor_Error_Bm_Em_Err__0022 "EyeQ_Minor_Error_Bm_Em_Err_Failed_Check_Reg_Versions_Fault_15_5";
BA_ "GenSigSendType" SG_ 1810 EyeQ_Fatal_Error_Pv_Verific_0000 0;
BA_ "SystemSignalLongSymbol" SG_ 1810 EyeQ_Fatal_Error_Pv_Verific_0000 "EyeQ_Fatal_Error_Pv_Verificattion_Error_Fault_13_7";
BA_ "GenSigSendType" SG_ 1810 EyeQ_Fatal_Error_Pv_General_0000 0;
BA_ "SystemSignalLongSymbol" SG_ 1810 EyeQ_Fatal_Error_Pv_General_0000 "EyeQ_Fatal_Error_Pv_General_Error_Fault_13_6";
BA_ "GenSigSendType" SG_ 1810 EyeQ_Fatal_Error_Pll_Compar_0000 0;
BA_ "SystemSignalLongSymbol" SG_ 1810 EyeQ_Fatal_Error_Pll_Compar_0000 "EyeQ_Fatal_Error_Pll_Comparison_Error_Fault_13_5";
BA_ "GenSigSendType" SG_ 1810 EyeQ_Fatal_Error_App_Patter_0000 0;
BA_ "SystemSignalLongSymbol" SG_ 1810 EyeQ_Fatal_Error_App_Patter_0000 "EyeQ_Fatal_Error_App_Pattern_Test_Fault_13_3";
BA_ "GenSigSendType" SG_ 1810 Host_ENET_VersionMismatch_E_0000 0;
BA_ "SystemSignalLongSymbol" SG_ 1810 Host_ENET_VersionMismatch_E_0000 "Host_ENET_VersionMismatch_Err_B8_4";
BA_ "GenSigSendType" SG_ 1810 Host_ENET_Missing_Message_E_0000 0;
BA_ "SystemSignalLongSymbol" SG_ 1810 Host_ENET_Missing_Message_E_0000 "Host_ENET_Missing_Message_Err_B8_1";
BA_ "GenSigSendType" SG_ 1810 NVM_E_REQ_FAILED_B0_7 0;
BA_ "GenSigSendType" SG_ 1810 NVM_E_QUEUE_OVERFLOW_FAULT_0_4 0;
BA_ "GenSigSendType" SG_ 1810 NVM_E_LOSS_OF_REDUNDANCY_B0_6 0;
BA_ "GenSigSendType" SG_ 1810 NVM_E_INTEGRITY_FAILED_FAULT_0_5 0;
BA_ "GenSigSendType" SG_ 1810 NBID_CRC_BOOT_REPORTED_B8_0 0;
BA_ "GenSigSendType" SG_ 1810 MISSING_CAMERA_CALIBRATION_Bf_5 0;
BA_ "GenSigSendType" SG_ 1810 MCU4_RollingCounter_B39_6 0;
BA_ "GenSigSendType" SG_ 1810 MCU4_CheckSum_B3d_6 0;
BA_ "GenSigSendType" SG_ 1810 MCU_FD1_Timeout_B28_0 0;
BA_ "GenSigSendType" SG_ 1810 MCU_FD1_ActTrq_Invalid_B33_1 0;
BA_ "GenSigSendType" SG_ 1810 Host_ENET_MessageReception__0000 0;
BA_ "SystemSignalLongSymbol" SG_ 1810 Host_ENET_MessageReception__0000 "Host_ENET_MessageReception_Err_B8_3";
BA_ "GenSigSendType" SG_ 1810 IFC_FD1_0x12B_Mute_B22_1 0;
BA_ "GenSigSendType" SG_ 1810 HUT_FD1_TSR_SnvtySet_B30_2 0;
BA_ "GenSigSendType" SG_ 1810 HUT_FD1_Timeout_B26_2 0;
BA_ "GenSigSendType" SG_ 1810 HUT_FD1_NavSpdLimValue_B30_4 0;
BA_ "GenSigSendType" SG_ 1810 HUT_FD1_NavSpdLimUnit_B30_5 0;
BA_ "GenSigSendType" SG_ 1810 HUT_FD1_LSSWarnFormSwtReq_B30_1 0;
BA_ "GenSigSendType" SG_ 1810 HUT_FD1_IFC_SnvtySet_Abnor_B30_0 0;
BA_ "GenSigSendType" SG_ 1810 HUT_FD1_FCW_SnvtySet_Abnor_B30_7 0;
BA_ "GenSigSendType" SG_ 1810 HOST_HEATER_PWR_AURIX_B7_6 0;
BA_ "GenSigSendType" SG_ 1810 Host_ENET_Missing_Data_Err_B8_2 0;
BA_ "GenSigSendType" SG_ 1810 GRAB_VIDEO_TIMEOUT_B4_7 0;
BA_ "GenSigSendType" SG_ 1810 Frozen_Windshield_Fault_11_3 0;
BA_ "GenSigSendType" SG_ 1810 FET_Fault_Across_cycles_B2_4 0;
BA_ "GenSigSendType" SG_ 1810 FEE_E_WRITE_FAULT_B1_1 0;
BA_ "GenSigSendType" SG_ 1810 FEE_E_WRITE_CYCLES_EXHAUST_B2_0 0;
BA_ "GenSigSendType" SG_ 1810 FEE_E_UNCONFIG_BLK_EXCEED_B2_2 0;
BA_ "GenSigSendType" SG_ 1810 FEE_E_READ_FAULT_B1_2 0;
BA_ "GenSigSendType" SG_ 1810 FEE_E_INVALIDATE_FAULT_B1_7 0;
BA_ "GenSigSendType" SG_ 1810 FEE_E_GC_WRITE_FAULT_B1_3 0;
BA_ "GenSigSendType" SG_ 1810 FEE_E_GC_TRIG_FAULT_B2_1 0;
BA_ "GenSigSendType" SG_ 1810 FEE_E_GC_INIT_FAULT_B1_0 0;
BA_ "GenSigSendType" SG_ 1810 FEE_E_GC_ERASE_FAULT_B1_6 0;
BA_ "GenSigSendType" SG_ 1810 FactoryMode_B20_7 0;
BA_ "GenSigSendType" SG_ 1810 F_PBox1_Timeout_B24_3 0;
BA_ "GenSigSendType" SG_ 1810 EYQQ_ROAD_INFO_COUNTER_ERROR_2_6 0;
BA_ "GenSigSendType" SG_ 1810 EYEQ_VISION_SAFETY_DIAG_RFC_B5_3 0;
BA_ "GenSigSendType" SG_ 1810 EYEQ_VISION_SAFETY_DIAG_CRC_B5_2 0;
BA_ "GenSigSendType" SG_ 1810 EYEQ_VISION_AEB_INFO_RFC_B5_1 0;
BA_ "GenSigSendType" SG_ 1810 EYEQ_VISION_AEB_INFO_CRC_B5_0 0;
BA_ "GenSigSendType" SG_ 1810 EYEQ_VIS_OBSTACLES_INFO_RFC_B5_6 0;
BA_ "GenSigSendType" SG_ 1810 EYEQ_VIS_OBSTACLES_INFO_CRC_B5_5 0;
BA_ "GenSigSendType" SG_ 1810 EYEQ_VIS_FAILSAFESRFCFAULT_B6_4 0;
BA_ "GenSigSendType" SG_ 1810 EYEQ_VIS_FAILSAFESCRCFAULT_B6_3 0;
BA_ "GenSigSendType" SG_ 1810 EYEQ_STATIC_RFC_FAULT_B6_2 0;
BA_ "GenSigSendType" SG_ 1810 EYEQ_DYNAMIC_RFC_FAULT_B6_0 0;
BA_ "GenSigSendType" SG_ 1810 EYEQ_DYNAMIC_CRC_FAULT_B5_7 0;
BA_ "GenSigSendType" SG_ 1810 EYEQ_ROAD_INFO_CRC_FAULT_B5_4 0;
BA_ "GenSigSendType" SG_ 1810 EYEQ_OTA_SWAP_FAULT_B7_5 0;
BA_ "GenSigSendType" SG_ 1810 EYEQ_GEN_CR_ERR_FAULT_B2_3 0;
BA_ "GenSigSendType" SG_ 1810 ESP2_VehStandstill_Invalid_B2c_2 0;
BA_ "GenSigSendType" SG_ 1810 ESP2_Timeout_B27_4 0;
BA_ "GenSigSendType" SG_ 1810 ESP2_RollingCounter_B37_4 0;
BA_ "GenSigSendType" SG_ 1810 ESP2_HDCCtrl_Abnormal_B35_5 0;
BA_ "GenSigSendType" SG_ 1810 ESP2_DrivingModDis_Abnor_B35_6 0;
BA_ "GenSigSendType" SG_ 1810 ESP2_CheckSum_B3b_4 0;
BA_ "GenSigSendType" SG_ 1810 ESP2_CDDAvailable_Error_B2c_0 0;
BA_ "GenSigSendType" SG_ 1810 ESP2_AWBAvailable_Error_B2d_2 0;
BA_ "GenSigSendType" SG_ 1810 ESP2_AEBAvailable_Error_B2c_4 0;
BA_ "GenSigSendType" SG_ 1810 ESP2_ABPAvailable_Error_B2c_6 0;
BA_ "GenSigSendType" SG_ 1810 ESP2_ABAavailable_Error_B2d_0 0;
BA_ "GenSigSendType" SG_ 1810 ESP1_Timeout_B27_3 0;
BA_ "GenSigSendType" SG_ 1810 ESP1_RollingCounter_B37_3 0;
BA_ "GenSigSendType" SG_ 1810 ESP1_MasterCylBrkPress_B2b_0 0;
BA_ "GenSigSendType" SG_ 1810 ESP1_ESPFailSts_Failure_B2b_6 0;
BA_ "GenSigSendType" SG_ 1810 ESP1_CheckSum_B3b_3 0;
BA_ "GenSigSendType" SG_ 1810 ESP_FD3_Timeout_B27_7 0;
BA_ "GenSigSendType" SG_ 1810 ESP_FD3_SwtPosn_Invalid_B2e_1 0;
BA_ "GenSigSendType" SG_ 1810 ESP_FD3_RRWheelSpd_Invalid_B2a_7 0;
BA_ "GenSigSendType" SG_ 1810 ESP_FD3_RRWhDriveDirection_B29_3 0;
BA_ "GenSigSendType" SG_ 1810 ESP_FD3_RLWheelSpd_Invalid_B2a_5 0;
BA_ "GenSigSendType" SG_ 1810 ESP_FD3_RLWhDriveDirection_B29_1 0;
BA_ "GenSigSendType" SG_ 1810 ESP_FD3_FRWheelSpd_Invalid_B2a_3 0;
BA_ "GenSigSendType" SG_ 1810 ESP_FD3_FRWhDriveDirection_B29_7 0;
BA_ "GenSigSendType" SG_ 1810 ESP_FD3_FLWheelSpd_Invalid_B2a_1 0;
BA_ "GenSigSendType" SG_ 1810 ESP_FD3_FLWhDriveDirection_B29_5 0;
BA_ "GenSigSendType" SG_ 1810 ESP_FD3_EPBSts_Error_B2e_5 0;
BA_ "GenSigSendType" SG_ 1810 ESP_FD3_EPBErrSts_Error_B2e_3 0;
BA_ "GenSigSendType" SG_ 1810 ESP_FD3_EPB1_RollCounter_B38_2 0;
BA_ "GenSigSendType" SG_ 1810 ESP_FD3_EPB1_CheckSum_B3c_2 0;
BA_ "GenSigSendType" SG_ 1810 ESP_FD3_ABS2_RollCounter_B38_4 0;
BA_ "GenSigSendType" SG_ 1810 ESP_FD3_ABS2_CheckSum_B3c_4 0;
BA_ "GenSigSendType" SG_ 1810 ESP_FD3_ABS1_RollCounter_B38_3 0;
BA_ "GenSigSendType" SG_ 1810 ESP_FD3_ABS1_CheckSum_B3c_3 0;
BA_ "GenSigSendType" SG_ 1810 ESP_FD2_VehStandstill_B2c_3 0;
BA_ "GenSigSendType" SG_ 1810 ESP_FD2_VehSpd_Missing_B21_5 0;
BA_ "GenSigSendType" SG_ 1810 ESP_FD2_VehSpd_Invalid_B2b_5 0;
BA_ "GenSigSendType" SG_ 1810 ESP_FD2_Timeout_B27_6 0;
BA_ "GenSigSendType" SG_ 1810 ESP_FD2_MasterCylBrkPress_B2b_1 0;
BA_ "GenSigSendType" SG_ 1810 ESP_FD2_ESPFailSts_Failure_B2b_7 0;
BA_ "GenSigSendType" SG_ 1810 ESP_FD2_ESP2_RollCounter_B38_7 0;
BA_ "GenSigSendType" SG_ 1810 ESP_FD2_ESP2_CheckSum_B3c_7 0;
BA_ "GenSigSendType" SG_ 1810 ESP_FD2_ESP1_RollCounter_B38_6 0;
BA_ "GenSigSendType" SG_ 1810 ESP_FD2_ESP1_CheckSum_B3c_6 0;
BA_ "GenSigSendType" SG_ 1810 ESP_FD2_CDDAvailable_Error_B2c_1 0;
BA_ "GenSigSendType" SG_ 1810 ESP_FD2_AWBAvailable_Error_B2d_3 0;
BA_ "GenSigSendType" SG_ 1810 ESP_FD2_AEBAvailable_Error_B2c_5 0;
BA_ "GenSigSendType" SG_ 1810 ESP_FD2_ABSFailSts_Failure_B2b_3 0;
BA_ "GenSigSendType" SG_ 1810 ESP_FD2_ABS3_RollCounter_B38_5 0;
BA_ "GenSigSendType" SG_ 1810 ESP_FD2_ABS3_CheckSum_B3c_5 0;
BA_ "GenSigSendType" SG_ 1810 ESP_FD2_ABPAvailable_Error_B2c_7 0;
BA_ "GenSigSendType" SG_ 1810 ESP_FD2_ABAavailable_Error_B2d_1 0;
BA_ "GenSigSendType" SG_ 1810 EPS2_Timeout_B26_1 0;
BA_ "GenSigSendType" SG_ 1810 EPS2_RollingCounter_B36_6 0;
BA_ "GenSigSendType" SG_ 1810 EPS2_LKATrqOvlDlvdSts_Temp_B2f_6 0;
BA_ "GenSigSendType" SG_ 1810 EPS2_LKATrqOvlDlvdSts_Perm_B2f_7 0;
BA_ "GenSigSendType" SG_ 1810 EPS2_CheckSum_B3a_6 0;
BA_ "GenSigSendType" SG_ 1810 EPS1_Timeout_B26_0 0;
BA_ "GenSigSendType" SG_ 1810 EPS1_SteerMod_Abnormal_B32_1 0;
BA_ "GenSigSendType" SG_ 1810 EPS1_EPSFailSts_Failure_B32_0 0;
BA_ "GenSigSendType" SG_ 1810 EPB1_Timeout_B27_5 0;
BA_ "GenSigSendType" SG_ 1810 EPB1_SwtPosn_Invalid_B2e_0 0;
BA_ "GenSigSendType" SG_ 1810 EPB1_RollingCounter_B37_5 0;
BA_ "GenSigSendType" SG_ 1810 EPB1_EPBSts_Error_B2e_4 0;
BA_ "GenSigSendType" SG_ 1810 EPB1_EPBErrSts_Error_B2e_2 0;
BA_ "GenSigSendType" SG_ 1810 EPB1_CheckSum_B3b_5 0;
BA_ "GenSigSendType" SG_ 1810 ECM9_Timeout_B23_6 0;
BA_ "GenSigSendType" SG_ 1810 ECM9_RollingCounter_B38_1 0;
BA_ "GenSigSendType" SG_ 1810 ECM9_ECMACCInterface_Error_B34_6 0;
BA_ "GenSigSendType" SG_ 1810 ECM9_Checksum_B3c_1 0;
BA_ "GenSigSendType" SG_ 1810 ECM8_TrqLoss_Invalid_B34_5 0;
BA_ "GenSigSendType" SG_ 1810 ECM8_Timeout_B23_5 0;
BA_ "GenSigSendType" SG_ 1810 ECM7_Timeout_B23_4 0;
BA_ "GenSigSendType" SG_ 1810 ECM4_Timeout_B23_3 0;
BA_ "GenSigSendType" SG_ 1810 ECM4_RollingCounter_B38_0 0;
BA_ "GenSigSendType" SG_ 1810 ECM4_NetEngTrq_Invalid_B34_3 0;
BA_ "GenSigSendType" SG_ 1810 ECM4_DrvEngTrqReq_Invalid_B34_4 0;
BA_ "GenSigSendType" SG_ 1810 ECM4_Checksum_B3c_0 0;
BA_ "GenSigSendType" SG_ 1810 ECM3_Timeout_B23_2 0;
BA_ "GenSigSendType" SG_ 1810 ECM3_MaxEngTrqNorm_Abnorm_B34_2 0;
BA_ "GenSigSendType" SG_ 1810 ECM2_Timeout_B23_1 0;
BA_ "GenSigSendType" SG_ 1810 ECM2_AccelPedalPosn_Invd_B2d_6 0;
BA_ "GenSigSendType" SG_ 1810 ECM1_Timeout_B23_0 0;
BA_ "GenSigSendType" SG_ 1810 ECM1_Start_StopSts_Invalid_B34_1 0;
BA_ "GenSigSendType" SG_ 1810 ECM1_RollingCounter_B37_7 0;
BA_ "GenSigSendType" SG_ 1810 ECM1_Checksum_B3b_7 0;
BA_ "GenSigSendType" SG_ 1810 ECM1_BrkPedalSts_Error_B2d_4 0;
BA_ "GenSigSendType" SG_ 1810 DCT7_Timeout_B24_1 0;
BA_ "GenSigSendType" SG_ 1810 DCT7_DrvFaiMsg_Failure_B35_4 0;
BA_ "GenSigSendType" SG_ 1810 DCT5_Timeout_B24_0 0;
BA_ "GenSigSendType" SG_ 1810 DCT5_TARGET_GEAR_Invalid_B35_2 0;
BA_ "GenSigSendType" SG_ 1810 DCT5_ShiftInPrg_Invalid_B35_1 0;
BA_ "GenSigSendType" SG_ 1810 DCT5_RollingCounter_B37_6 0;
BA_ "GenSigSendType" SG_ 1810 DCT5_CurrentGear_Invalid_B35_0 0;
BA_ "GenSigSendType" SG_ 1810 DCT5_CheckSum_B3b_6 0;
BA_ "GenSigSendType" SG_ 1810 DCT3_Timeout_B23_7 0;
BA_ "GenSigSendType" SG_ 1810 CSA2_Timeout_B25_4 0;
BA_ "GenSigSendType" SG_ 1810 CSA2_SteerWheelSpd_Invalid_B31_2 0;
BA_ "GenSigSendType" SG_ 1810 CSA2_SteerWheelAng_Invalid_B31_1 0;
BA_ "GenSigSendType" SG_ 1810 CSA2_SAS_Sts_Error_B31_4 0;
BA_ "GenSigSendType" SG_ 1810 CSA2_Rollingcounter_B36_5 0;
BA_ "GenSigSendType" SG_ 1810 CSA2_Checksum_B3a_5 0;
BA_ "GenSigSendType" SG_ 1810 CSA2_CC_ACCSwt_Error_B31_3 0;
BA_ "GenSigSendType" SG_ 1810 CSA1_Timeout_B25_3 0;
BA_ "GenSigSendType" SG_ 1810 CSA1_FrntWiprSwtSts_Error_B31_0 0;
BA_ "GenSigSendType" SG_ 1810 Vision_Internal_Error_B1f_6 0;
BA_ "GenSigSendType" SG_ 1810 EyeQ_Spi_Msg_Timeout_A_7 0;
BA_ "GenSigSendType" SG_ 1810 Host_Spi_CRC_Error_A_2 0;
BA_ "GenSigSendType" SG_ 1810 Host_Spi_Tx_Error_A_1 0;
BA_ "GenSigSendType" SG_ 1810 Host_spi_msg_timeout_A_0 0;
BA_ "GenSigSendType" SG_ 1810 EyeQ_Calibration_Checksum_9_4 0;
BA_ "GenSigSendType" SG_ 1810 Imager_2V8_Supply_OutRange_6_7 0;
BA_ "GenSigSendType" SG_ 1810 Aurix_1V25_Supply_OutRange_B6_6 0;
BA_ "GenSigSendType" SG_ 1810 Imager_1V2_Supply_OutRange_6_5 0;
BA_ "GenSigSendType" SG_ 1810 Battery_High_Fault_B21_2 0;
BA_ "GenSigSendType" SG_ 1810 Battery_Low_Fault_B21_1 0;
BA_ "GenSigSendType" SG_ 1810 PS_5V0_Out_Of_Range_4_4 0;
BA_ "GenSigSendType" SG_ 1810 EyeQDDROnBrdThermstorOutRang_4_3 0;
BA_ "GenSigSendType" SG_ 1810 EyeQDDROnBrdThermstorOveTemp_4_1 0;
BA_ "GenSigSendType" SG_ 1810 EyeQ_Temp_Exceeded_3_0 0;
BA_ "GenSigSendType" SG_ 1810 SYSTEM_OVER_TEMPERATURE_2_7 0;
BA_ "GenSigSendType" SG_ 1810 EyeQ_Error_Out_Temp_Fault_1A_6 0;
BA_ "GenSigSendType" SG_ 1810 EyeQErrOutSignalInternFault_1A_5 0;
BA_ "GenSigSendType" SG_ 1810 EyeQ_Camera1_Temp_Fault_1A_4 0;
BA_ "GenSigSendType" SG_ 1810 EyeQVdoErrFlg_ShotOutOfSync_1A_3 0;
BA_ "GenSigSendType" SG_ 1810 EyeQVdoErrFlg_VdiErrShutdwn_1A_2 0;
BA_ "GenSigSendType" SG_ 1810 EyeQVdoErrFlg_HdrVerifiErr_1A_1 0;
BA_ "GenSigSendType" SG_ 1810 EyeQVdoErrFlg_CcftDecisionMismat 0;
BA_ "GenSigSendType" SG_ 1810 EyeQVdoErrFlg_HistogramsMismatch 0;
BA_ "GenSigSendType" SG_ 1810 EyeQVdoErrFlg_FrameCountReadFail 0;
BA_ "GenSigSendType" SG_ 1810 EyeQVdoErrFlgVdiErr_CoreIdFlt 0;
BA_ "GenSigSendType" SG_ 1810 EyeQVdoErrFlgVdiErr_StrtAftStrt 0;
BA_ "GenSigSendType" SG_ 1810 EyeQVdoErrFlgVdiErr_ParityHisFlt 0;
BA_ "GenSigSendType" SG_ 1810 EyeQVdoErrFlgVdiErr_ParityGamma 0;
BA_ "GenSigSendType" SG_ 1810 EyeQVdoErrFlgVdiErr_ParityWeight 0;
BA_ "GenSigSendType" SG_ 1810 EyeQVdoErrFlgVdiErr_ParityFifo 0;
BA_ "GenSigSendType" SG_ 1810 EyeQVdoErrFlgVdiErrFifo_Undflow 0;
BA_ "GenSigSendType" SG_ 1810 EyeQVdoErrFlgVdiErrFifo_Overflow 0;
BA_ "GenSigSendType" SG_ 1810 EyeQVdoErrFlgVdiErr_Timeout_18_5 0;
BA_ "GenSigSendType" SG_ 1810 EyeQVdoErrFlgVdiErr_BuffInvldFmt 0;
BA_ "GenSigSendType" SG_ 1810 EyeQVdoErrFlg_Vdi_ErrNoBuff_18_3 0;
BA_ "GenSigSendType" SG_ 1810 EyeQVdoErrFlgVdi_InternErr18_2 0;
BA_ "GenSigSendType" SG_ 1810 EyeQVdoErrFlgSumNotMatHistgrmErr 0;
BA_ "GenSigSendType" SG_ 1810 EyeQVdoErrFlgZeroHistgrmErr_18_0 0;
BA_ "GenSigSendType" SG_ 1810 EyeQVdoErrFlgRegWrtHilFailErr 0;
BA_ "GenSigSendType" SG_ 1810 EyeQVdoErrFlgErrRegFlagFlt_17_6 0;
BA_ "GenSigSendType" SG_ 1810 EyeQVdoErrFlgInvldVdoHeaderFault 0;
BA_ "GenSigSendType" SG_ 1810 EyeQVdoErrFlgVerifiFailVdoErr 0;
BA_ "GenSigSendType" SG_ 1810 EyeQVdoErrFlgInconstFramVdoErr 0;
BA_ "GenSigSendType" SG_ 1810 EyeQ_Cam1VdoErrFlgLgcVdoErr_17_2 0;
BA_ "GenSigSendType" SG_ 1810 EyeQCam1VdoErrFlgI2CNoOnTmVdoErr 0;
BA_ "GenSigSendType" SG_ 1810 EyeQCam1VdoErrFlgVdiVdoErr_17_0 0;
BA_ "GenSigSendType" SG_ 1810 EyeQ_Cam_Vdo_Flt_16_7 0;
BA_ "GenSigSendType" SG_ 1810 EyeQ_Cam_Ctrl_Flt_16_6 0;
BA_ "GenSigSendType" SG_ 1810 EyeQ_Cam_Mal_Func_16_5 0;
BA_ "GenSigSendType" SG_ 1810 Grab_Release_Failure_16_4 0;
BA_ "GenSigSendType" SG_ 1810 Grab_Acquire_Failure_16_3 0;
BA_ "GenSigSendType" SG_ 1810 Grab_Issue_Failure_16_2 0;
BA_ "GenSigSendType" SG_ 1810 Grab_No_Free_Header_Failure_16_1 0;
BA_ "GenSigSendType" SG_ 1810 Init_I2C_Failure_16_0 0;
BA_ "GenSigSendType" SG_ 1810 Init_Vdi_Failure_15_7 0;
BA_ "GenSigSendType" SG_ 1810 EyeQFatalErrApCamParaCcftCrc13_4 0;
BA_ "GenSigSendType" SG_ 1810 EyeQFatalErrAppI2CTimoutErr_13_2 0;
BA_ "GenSigSendType" SG_ 1810 EyeQFatalErrAppI2CCamSlfRst_13_1 0;
BA_ "GenSigSendType" SG_ 1810 EyeQFatalErrAppI2CVidoGrb_13_0 0;
BA_ "GenSigSendType" SG_ 1810 EYEQ_GEN54ACCSTLEXECUTFAILED_F_3 0;
BA_ "GenSigSendType" SG_ 1810 EYEQ_GEN_26_CODE_CRC_E_1 0;
BA_ "GenSigSendType" SG_ 1810 EyeQ_Core_Dump_Fault_C_5 0;
BA_ "GenSigSendType" SG_ 1810 EyeQ_Init_Timeout_Fault_C_4 0;
BA_ "GenSigSendType" SG_ 1810 EYEQ4_Mode_Fault_C_3 0;
BA_ "GenSigSendType" SG_ 1810 EyeQ_Bist_Memory_Fault_C_2 0;
BA_ "GenSigSendType" SG_ 1810 EyeQ_Core_Fault_C_1 0;
BA_ "GenSigSendType" SG_ 1810 EyeQ_Boot_Fault_C_0 0;
BA_ "GenSigSendType" SG_ 1810 EyeQ_DDR_Fault_B_6 0;
BA_ "GenSigSendType" SG_ 1810 EyeQ_SerialFlashPowerUp_Fail_B_1 0;
BA_ "GenSigSendType" SG_ 1810 EyeQ_SPI_CRC_ERROR_B_0 0;
BA_ "GenSigSendType" SG_ 1810 EYEQ_Spi_Msg_Format_Error_A_6 0;
BA_ "GenSigSendType" SG_ 1810 EyeQ_Spi_Frame_Format_Error_A_5 0;
BA_ "GenSigSendType" SG_ 1810 Spi_Ipc_Comm_Reset_A_4 0;
BA_ "GenSigSendType" SG_ 1810 Spi_version_mismatch_A_3 0;
BA_ "GenSigSendType" SG_ 1810 Host_Spi_Msg_Format_Error_9_7 0;
BA_ "GenSigSendType" SG_ 1810 Host_Spi_Frame_Format_Error_9_6 0;
BA_ "GenSigSendType" SG_ 1810 EyeQ_Application_Checksum_9_3 0;
BA_ "GenSigSendType" SG_ 1810 EyeQAppl_CompltAndComptibl_9_2 0;
BA_ "GenSigSendType" SG_ 1810 EyeQOnBoardThermstorOutRange_4_2 0;
BA_ "GenSigSendType" SG_ 1810 EyeQ_DDR_Over_Temp_4_0 0;
BA_ "GenSigSendType" SG_ 1810 EyeQ_Boot_OverTemp_Fault_3_7 0;
BA_ "GenSigSendType" SG_ 1810 EyeQ_Imager_Over_Temp_3_6 0;
BA_ "GenSigSendType" SG_ 1810 EyeQ_VMP_Over_Temp_3_5 0;
BA_ "GenSigSendType" SG_ 1810 EyeQ_MIPS_Over_Temp_3_4 0;
BA_ "GenSigSendType" SG_ 1810 EyeQOnBoardThermistorOveTemp_3_1 0;
BA_ "GenSigSendType" SG_ 1810 EYEQ_1V0_SUPPLY_OUT_OF_RANGE_0_3 0;
BA_ "GenSigSendType" SG_ 1810 EYEQ_1V1_SUPPLY_OUT_OF_RANGE_0_2 0;
BA_ "GenSigSendType" SG_ 1810 EYEQ_1V8_SUPPLY_OUT_OF_RANGE_0_1 0;
BA_ "GenSigSendType" SG_ 1810 EYEQ_3V3_SUPPLY_OUT_OF_RANGE_0_0 0;
BA_ "SystemSignalLongSymbol" SG_ 1810 Windshield_heater_OPNLD_Err_0000 "Windshield_heater_OPNLD_Error_B3E_0";
BA_ "SystemSignalLongSymbol" SG_ 1810 WWINDSHIELD_HEATER_STG_FAUL_0000 "WWINDSHIELD_HEATER_STG_FAULT_B3E_1";
BA_ "SystemSignalLongSymbol" SG_ 1810 WINDSHIELD_HEATER_OVRLD_FAU_0000 "WINDSHIELD_HEATER_OVRLD_FAULT_B3E_2";
BA_ "SystemSignalLongSymbol" SG_ 1810 WINDSHIELD_HEATER_STB_FAULT_0000 "WINDSHIELD_HEATER_STB_FAULT_B3E_3";
VAL_ 1832 VIS_OBS_classification_13 0 "car" 1 "truck" 2 "bike(motorcycle)" 3 "bicycle" 4 "pedestrian" 5 "generalobject(notimplemented)" 6 "animal(notimplemented)" 7 "uncertain_vehicle" ;
VAL_ 1832 VIS_OBS_laneAssignment_13 -2 "LEFT_NEXT_NEXT" -1 "LEFT_NEXT" 0 "EGO_LANE" 1 "RIGHT_NEXT" 2 "RIGHT_NEXT_NEXT" 3 "UNKNOWN" ;
VAL_ 1832 VIS_OBS_motionStatus_13 0 "Unknown" 1 "moving" 2 "stationary" 3 "Stopped" 4 "Movingslowly" ;
VAL_ 1832 VIS_OBS_motionCategory_13 12 "Oncoming" 11 "Preceding" 10 "Moving" 9 "RTAP" 0 "Undefined" 1 "Passing" 2 "Passingin" 3 "Passingout" 4 "Closecutiin" 5 "Movingin" 6 "Movingout" 7 "Crossing" 8 "LTAP" ;
VAL_ 1832 VIS_OBS_motionOrientation_13 0 "Unknown" 1 "Driftingright" 2 "Crossingright" 3 "Oncomingdriftingright" 4 "Oncoming" 5 "Oncomingdriftingleft" 6 "Crossingleft" 7 "Driftingleft" 8 "Precedinge" ;
VAL_ 1832 VIS_OBS_CIPV_Lost_13 0 "NO_LOSS " 1 "LOST_TARGET_FOV_OUT " 2 "LOST_TARGET_FOV_IN" ;
VAL_ 1832 VIS_OBS_classification_14 0 "car" 1 "truck" 2 "bike(motorcycle)" 3 "bicycle" 4 "pedestrian" 5 "generalobject(notimplemented)" 6 "animal(notimplemented)" 7 "uncertain_vehicle" ;
VAL_ 1832 VIS_OBS_laneAssignment_14 -2 "LEFT_NEXT_NEXT" -1 "LEFT_NEXT" 0 "EGO_LANE" 1 "RIGHT_NEXT" 2 "RIGHT_NEXT_NEXT" 3 "UNKNOWN" ;
VAL_ 1832 VIS_OBS_motionStatus_14 0 "Unknown" 1 "moving" 2 "stationary" 3 "Stopped" 4 "Movingslowly" ;
VAL_ 1832 VIS_OBS_motionCategory_14 12 "Oncoming" 11 "Preceding" 10 "Moving" 9 "RTAP" 0 "Undefined" 1 "Passing" 2 "Passingin" 3 "Passingout" 4 "Closecutiin" 5 "Movingin" 6 "Movingout" 7 "Crossing" 8 "LTAP" ;
VAL_ 1832 VIS_OBS_motionOrientation_14 0 "Unknown" 1 "Driftingright" 2 "Crossingright" 3 "Oncomingdriftingright" 4 "Oncoming" 5 "Oncomingdriftingleft" 6 "Crossingleft" 7 "Driftingleft" 8 "Precedinge" ;
VAL_ 1832 VIS_OBS_classification_15 0 "car" 1 "truck" 2 "bike(motorcycle)" 3 "bicycle" 4 "pedestrian" 5 "generalobject(notimplemented)" 6 "animal(notimplemented)" 7 "uncertain_vehicle" ;
VAL_ 1832 VIS_OBS_laneAssignment_15 -2 "LEFT_NEXT_NEXT" -1 "LEFT_NEXT" 0 "EGO_LANE" 1 "RIGHT_NEXT" 2 "RIGHT_NEXT_NEXT" 3 "UNKNOWN" ;
VAL_ 1832 VIS_OBS_motionStatus_15 0 "Unknown" 1 "moving" 2 "stationary" 3 "Stopped" 4 "Movingslowly" ;
VAL_ 1832 VIS_OBS_motionCategory_15 12 "Oncoming" 11 "Preceding" 10 "Moving" 9 "RTAP" 0 "Undefined" 1 "Passing" 2 "Passingin" 3 "Passingout" 4 "Closecutiin" 5 "Movingin" 6 "Movingout" 7 "Crossing" 8 "LTAP" ;
VAL_ 1832 VIS_OBS_motionOrientation_15 0 "Unknown" 1 "Driftingright" 2 "Crossingright" 3 "Oncomingdriftingright" 4 "Oncoming" 5 "Oncomingdriftingleft" 6 "Crossingleft" 7 "Driftingleft" 8 "Precedinge" ;
VAL_ 1832 VIS_OBS_CIPV_Lost_14 0 "NO_LOSS " 1 "LOST_TARGET_FOV_OUT " 2 "LOST_TARGET_FOV_IN" ;
VAL_ 1832 VIS_OBS_CIPV_Lost_15 0 "NO_LOSS " 1 "LOST_TARGET_FOV_OUT " 2 "LOST_TARGET_FOV_IN" ;
VAL_ 1831 VIS_OBS_classification_10 0 "car" 1 "truck" 2 "bike(motorcycle)" 3 "bicycle" 4 "pedestrian" 5 "generalobject(notimplemented)" 6 "animal(notimplemented)" 7 "uncertain_vehicle" ;
VAL_ 1831 VIS_OBS_laneAssignment_10 -2 "LEFT_NEXT_NEXT" -1 "LEFT_NEXT" 0 "EGO_LANE" 1 "RIGHT_NEXT" 2 "RIGHT_NEXT_NEXT" 3 "UNKNOWN" ;
VAL_ 1831 VIS_OBS_motionStatus_10 0 "Unknown" 1 "moving" 2 "stationary" 3 "Stopped" 4 "Movingslowly" ;
VAL_ 1831 VIS_OBS_motionCategory_10 12 "Oncoming" 11 "Preceding" 10 "Moving" 9 "RTAP" 0 "Undefined" 1 "Passing" 2 "Passingin" 3 "Passingout" 4 "Closecutiin" 5 "Movingin" 6 "Movingout" 7 "Crossing" 8 "LTAP" ;
VAL_ 1831 VIS_OBS_motionOrientation_10 0 "Unknown" 1 "Driftingright" 2 "Crossingright" 3 "Oncomingdriftingright" 4 "Oncoming" 5 "Oncomingdriftingleft" 6 "Crossingleft" 7 "Driftingleft" 8 "Precedinge" ;
VAL_ 1831 VIS_OBS_CIPV_Lost_10 0 "NO_LOSS " 1 "LOST_TARGET_FOV_OUT " 2 "LOST_TARGET_FOV_IN" ;
VAL_ 1831 VIS_OBS_classification_11 0 "car" 1 "truck" 2 "bike(motorcycle)" 3 "bicycle" 4 "pedestrian" 5 "generalobject(notimplemented)" 6 "animal(notimplemented)" 7 "uncertain_vehicle" ;
VAL_ 1831 VIS_OBS_laneAssignment_11 -2 "LEFT_NEXT_NEXT" -1 "LEFT_NEXT" 0 "EGO_LANE" 1 "RIGHT_NEXT" 2 "RIGHT_NEXT_NEXT" 3 "UNKNOWN" ;
VAL_ 1831 VIS_OBS_motionStatus_11 0 "Unknown" 1 "moving" 2 "stationary" 3 "Stopped" 4 "Movingslowly" ;
VAL_ 1831 VIS_OBS_motionCategory_11 12 "Oncoming" 11 "Preceding" 10 "Moving" 9 "RTAP" 0 "Undefined" 1 "Passing" 2 "Passingin" 3 "Passingout" 4 "Closecutiin" 5 "Movingin" 6 "Movingout" 7 "Crossing" 8 "LTAP" ;
VAL_ 1831 VIS_OBS_motionOrientation_11 0 "Unknown" 1 "Driftingright" 2 "Crossingright" 3 "Oncomingdriftingright" 4 "Oncoming" 5 "Oncomingdriftingleft" 6 "Crossingleft" 7 "Driftingleft" 8 "Precedinge" ;
VAL_ 1831 VIS_OBS_classification_12 0 "car" 1 "truck" 2 "bike(motorcycle)" 3 "bicycle" 4 "pedestrian" 5 "generalobject(notimplemented)" 6 "animal(notimplemented)" 7 "uncertain_vehicle" ;
VAL_ 1831 VIS_OBS_laneAssignment_12 -2 "LEFT_NEXT_NEXT" -1 "LEFT_NEXT" 0 "EGO_LANE" 1 "RIGHT_NEXT" 2 "RIGHT_NEXT_NEXT" 3 "UNKNOWN" ;
VAL_ 1831 VIS_OBS_motionStatus_12 0 "Unknown" 1 "moving" 2 "stationary" 3 "Stopped" 4 "Movingslowly" ;
VAL_ 1831 VIS_OBS_motionCategory_12 12 "Oncoming" 11 "Preceding" 10 "Moving" 9 "RTAP" 0 "Undefined" 1 "Passing" 2 "Passingin" 3 "Passingout" 4 "Closecutiin" 5 "Movingin" 6 "Movingout" 7 "Crossing" 8 "LTAP" ;
VAL_ 1831 VIS_OBS_motionOrientation_12 0 "Unknown" 1 "Driftingright" 2 "Crossingright" 3 "Oncomingdriftingright" 4 "Oncoming" 5 "Oncomingdriftingleft" 6 "Crossingleft" 7 "Driftingleft" 8 "Precedinge" ;
VAL_ 1831 VIS_OBS_CIPV_Lost_11 0 "NO_LOSS " 1 "LOST_TARGET_FOV_OUT " 2 "LOST_TARGET_FOV_IN" ;
VAL_ 1831 VIS_OBS_CIPV_Lost_12 0 "NO_LOSS " 1 "LOST_TARGET_FOV_OUT " 2 "LOST_TARGET_FOV_IN" ;
VAL_ 1830 VIS_OBS_classification_7 0 "car" 1 "truck" 2 "bike(motorcycle)" 3 "bicycle" 4 "pedestrian" 5 "generalobject(notimplemented)" 6 "animal(notimplemented)" 7 "uncertain_vehicle" ;
VAL_ 1830 VIS_OBS_laneAssignment_7 -2 "LEFT_NEXT_NEXT" -1 "LEFT_NEXT" 0 "EGO_LANE" 1 "RIGHT_NEXT" 2 "RIGHT_NEXT_NEXT" 3 "UNKNOWN" ;
VAL_ 1830 VIS_OBS_motionStatus_7 0 "Unknown" 1 "moving" 2 "stationary" 3 "Stopped" 4 "Movingslowly" ;
VAL_ 1830 VIS_OBS_motionCategory_7 12 "Oncoming" 11 "Preceding" 10 "Moving" 9 "RTAP" 0 "Undefined" 1 "Passing" 2 "Passingin" 3 "Passingout" 4 "Closecutiin" 5 "Movingin" 6 "Movingout" 7 "Crossing" 8 "LTAP" ;
VAL_ 1830 VIS_OBS_motionOrientation_7 0 "Unknown" 1 "Driftingright" 2 "Crossingright" 3 "Oncomingdriftingright" 4 "Oncoming" 5 "Oncomingdriftingleft" 6 "Crossingleft" 7 "Driftingleft" 8 "Precedinge" ;
VAL_ 1830 VIS_OBS_CIPV_Lost_7 0 "NO_LOSS " 1 "LOST_TARGET_FOV_OUT " 2 "LOST_TARGET_FOV_IN" ;
VAL_ 1830 VIS_OBS_classification_8 0 "car" 1 "truck" 2 "bike(motorcycle)" 3 "bicycle" 4 "pedestrian" 5 "generalobject(notimplemented)" 6 "animal(notimplemented)" 7 "uncertain_vehicle" ;
VAL_ 1830 VIS_OBS_laneAssignment_8 -2 "LEFT_NEXT_NEXT" -1 "LEFT_NEXT" 0 "EGO_LANE" 1 "RIGHT_NEXT" 2 "RIGHT_NEXT_NEXT" 3 "UNKNOWN" ;
VAL_ 1830 VIS_OBS_motionStatus_8 0 "Unknown" 1 "moving" 2 "stationary" 3 "Stopped" 4 "Movingslowly" ;
VAL_ 1830 VIS_OBS_motionCategory_8 12 "Oncoming" 11 "Preceding" 10 "Moving" 9 "RTAP" 0 "Undefined" 1 "Passing" 2 "Passingin" 3 "Passingout" 4 "Closecutiin" 5 "Movingin" 6 "Movingout" 7 "Crossing" 8 "LTAP" ;
VAL_ 1830 VIS_OBS_motionOrientation_8 0 "Unknown" 1 "Driftingright" 2 "Crossingright" 3 "Oncomingdriftingright" 4 "Oncoming" 5 "Oncomingdriftingleft" 6 "Crossingleft" 7 "Driftingleft" 8 "Precedinge" ;
VAL_ 1830 VIS_OBS_classification_9 0 "car" 1 "truck" 2 "bike(motorcycle)" 3 "bicycle" 4 "pedestrian" 5 "generalobject(notimplemented)" 6 "animal(notimplemented)" 7 "uncertain_vehicle" ;
VAL_ 1830 VIS_OBS_laneAssignment_9 -2 "LEFT_NEXT_NEXT" -1 "LEFT_NEXT" 0 "EGO_LANE" 1 "RIGHT_NEXT" 2 "RIGHT_NEXT_NEXT" 3 "UNKNOWN" ;
VAL_ 1830 VIS_OBS_motionStatus_9 0 "Unknown" 1 "moving" 2 "stationary" 3 "Stopped" 4 "Movingslowly" ;
VAL_ 1830 VIS_OBS_motionCategory_9 12 "Oncoming" 11 "Preceding" 10 "Moving" 9 "RTAP" 0 "Undefined" 1 "Passing" 2 "Passingin" 3 "Passingout" 4 "Closecutiin" 5 "Movingin" 6 "Movingout" 7 "Crossing" 8 "LTAP" ;
VAL_ 1830 VIS_OBS_motionOrientation_9 0 "Unknown" 1 "Driftingright" 2 "Crossingright" 3 "Oncomingdriftingright" 4 "Oncoming" 5 "Oncomingdriftingleft" 6 "Crossingleft" 7 "Driftingleft" 8 "Precedinge" ;
VAL_ 1830 VIS_OBS_CIPV_Lost_8 0 "NO_LOSS " 1 "LOST_TARGET_FOV_OUT " 2 "LOST_TARGET_FOV_IN" ;
VAL_ 1830 VIS_OBS_CIPV_Lost_9 0 "NO_LOSS " 1 "LOST_TARGET_FOV_OUT " 2 "LOST_TARGET_FOV_IN" ;
VAL_ 1829 VIS_OBS_classification_4 0 "car" 1 "truck" 2 "bike(motorcycle)" 3 "bicycle" 4 "pedestrian" 5 "generalobject(notimplemented)" 6 "animal(notimplemented)" 7 "uncertain_vehicle" ;
VAL_ 1829 VIS_OBS_laneAssignment_4 -2 "LEFT_NEXT_NEXT" -1 "LEFT_NEXT" 0 "EGO_LANE" 1 "RIGHT_NEXT" 2 "RIGHT_NEXT_NEXT" 3 "UNKNOWN" ;
VAL_ 1829 VIS_OBS_motionStatus_4 0 "Unknown" 1 "moving" 2 "stationary" 3 "Stopped" 4 "Movingslowly" ;
VAL_ 1829 VIS_OBS_motionCategory_4 12 "Oncoming" 11 "Preceding" 10 "Moving" 9 "RTAP" 0 "Undefined" 1 "Passing" 2 "Passingin" 3 "Passingout" 4 "Closecutiin" 5 "Movingin" 6 "Movingout" 7 "Crossing" 8 "LTAP" ;
VAL_ 1829 VIS_OBS_motionOrientation_4 0 "Unknown" 1 "Driftingright" 2 "Crossingright" 3 "Oncomingdriftingright" 4 "Oncoming" 5 "Oncomingdriftingleft" 6 "Crossingleft" 7 "Driftingleft" 8 "Precedinge" ;
VAL_ 1829 VIS_OBS_classification_5 0 "car" 1 "truck" 2 "bike(motorcycle)" 3 "bicycle" 4 "pedestrian" 5 "generalobject(notimplemented)" 6 "animal(notimplemented)" 7 "uncertain_vehicle" ;
VAL_ 1829 VIS_OBS_laneAssignment_5 -2 "LEFT_NEXT_NEXT" -1 "LEFT_NEXT" 0 "EGO_LANE" 1 "RIGHT_NEXT" 2 "RIGHT_NEXT_NEXT" 3 "UNKNOWN" ;
VAL_ 1829 VIS_OBS_motionStatus_5 0 "Unknown" 1 "moving" 2 "stationary" 3 "Stopped" 4 "Movingslowly" ;
VAL_ 1829 VIS_OBS_motionCategory_5 12 "Oncoming" 11 "Preceding" 10 "Moving" 9 "RTAP" 0 "Undefined" 1 "Passing" 2 "Passingin" 3 "Passingout" 4 "Closecutiin" 5 "Movingin" 6 "Movingout" 7 "Crossing" 8 "LTAP" ;
VAL_ 1829 VIS_OBS_motionOrientation_5 0 "Unknown" 1 "Driftingright" 2 "Crossingright" 3 "Oncomingdriftingright" 4 "Oncoming" 5 "Oncomingdriftingleft" 6 "Crossingleft" 7 "Driftingleft" 8 "Precedinge" ;
VAL_ 1829 VIS_OBS_classification_6 0 "car" 1 "truck" 2 "bike(motorcycle)" 3 "bicycle" 4 "pedestrian" 5 "generalobject(notimplemented)" 6 "animal(notimplemented)" 7 "uncertain_vehicle" ;
VAL_ 1829 VIS_OBS_laneAssignment_6 -2 "LEFT_NEXT_NEXT" -1 "LEFT_NEXT" 0 "EGO_LANE" 1 "RIGHT_NEXT" 2 "RIGHT_NEXT_NEXT" 3 "UNKNOWN" ;
VAL_ 1829 VIS_OBS_motionStatus_6 0 "Unknown" 1 "moving" 2 "stationary" 3 "Stopped" 4 "Movingslowly" ;
VAL_ 1829 VIS_OBS_motionCategory_6 12 "Oncoming" 11 "Preceding" 10 "Moving" 9 "RTAP" 0 "Undefined" 1 "Passing" 2 "Passingin" 3 "Passingout" 4 "Closecutiin" 5 "Movingin" 6 "Movingout" 7 "Crossing" 8 "LTAP" ;
VAL_ 1829 VIS_OBS_motionOrientation_6 0 "Unknown" 1 "Driftingright" 2 "Crossingright" 3 "Oncomingdriftingright" 4 "Oncoming" 5 "Oncomingdriftingleft" 6 "Crossingleft" 7 "Driftingleft" 8 "Precedinge" ;
VAL_ 1829 VIS_OBS_CIPV_Lost_4 0 "NO_LOSS " 1 "LOST_TARGET_FOV_OUT " 2 "LOST_TARGET_FOV_IN" ;
VAL_ 1829 VIS_OBS_CIPV_Lost_5 0 "NO_LOSS " 1 "LOST_TARGET_FOV_OUT " 2 "LOST_TARGET_FOV_IN" ;
VAL_ 1829 VIS_OBS_CIPV_Lost_6 0 "NO_LOSS " 1 "LOST_TARGET_FOV_OUT " 2 "LOST_TARGET_FOV_IN" ;

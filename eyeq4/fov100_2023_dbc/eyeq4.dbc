VERSION ""

NS_ :

BS_:

BU_: IFV410 External ASDM

BO_ 1809 Active_Fault_Latched: 64 IFV410
 SG_ IP2_Timeout_For_Fuel_B22_2 : 274|1@1+ (1,0) [0|1] ""  External
 SG_ BCM3_Timeout_B20_1 : 257|1@1+ (1,0) [0|1] ""  External
 SG_ Intrinsic_Parameter_CRCErr_B1f_5 : 253|1@1+ (1,0) [0|1] ""  External
 SG_ Intrinsic_Parameter_Miss_B1f_4 : 252|1@1+ (1,0) [0|1] ""  External
 SG_ EyeQ_GPIO_Toggle_fail_B1e_6 : 246|1@1+ (1,0) [0|1] ""  External
 SG_ EQ_AppMissInputSignalErr_B1b_7 : 223|1@1+ (1,0) [0|1] ""  External
 SG_ EYEQ_43_ROADBOUNDCORRECT_B1b_6 : 222|1@1+ (1,0) [0|1] ""  External
 SG_ EYEQ_35_VD_CORRUPT_OUTPUTS_B10_1 : 129|1@1+ (1,0) [0|1] ""  External
 SG_ EYEQ_36_VD_OVERLAP_FAULT_B10_0 : 128|1@1+ (1,0) [0|1] ""  External
 SG_ EYEQ_37_VD_SANITY_FAULT_Bf_7 : 127|1@1+ (1,0) [0|1] ""  External
 SG_ EYEQ_52_VD_PREDICTION_VALI_Bf_6 : 126|1@1+ (1,0) [0|1] ""  External
 SG_ EYEQ_55_ROAD_LANEWIDTH_VALI_Be_5 : 117|1@1+ (1,0) [0|1] ""  External
 SG_ EYEQ_57_ROAD_HPP_MODEL_VALI_Be_4 : 116|1@1+ (1,0) [0|1] ""  External
 SG_ EYEQ_56_ROAD_PP_VALIDATION_Be_3 : 115|1@1+ (1,0) [0|1] ""  External
 SG_ EYEQ_38_PED_CORRUPT_OUTPUT_B7_3 : 59|1@1+ (1,0) [0|1] ""  External
 SG_ EYEQ_39_PED_OVERLAP_FAULT_B7_2 : 58|1@1+ (1,0) [0|1] ""  External
 SG_ EYEQ_40_PED_SANITY_FAULT_B7_1 : 57|1@1+ (1,0) [0|1] ""  External
 SG_ EYEQ_51_PED_PREDICT_VAL_B7_0 : 56|1@1+ (1,0) [0|1] ""  External
 SG_ AurixInternalMemoryFail_B4_6 : 38|1@1+ (1,0) [0|1] ""  External
 SG_ AurixInternalElectronicFail_B4_5 : 37|1@1+ (1,0) [0|1] ""  External
 SG_ Eyeq_Vision_Object_RFC_B3_3 : 27|1@1+ (1,0) [0|1] ""  External
 SG_ Eyeq_Vision_Object_CRC_B3_2 : 26|1@1+ (1,0) [0|1] ""  External
 SG_ SAS1_Timeout_B24_5 : 293|1@1+ (1,0) [0|1] ""  External
 SG_ SAS1_SteerWheelSpd_Invalid_B32_5 : 405|1@1+ (1,0) [0|1] ""  External
 SG_ SAS1_SteerWheelAng_Invalid_B32_4 : 404|1@1+ (1,0) [0|1] ""  External
 SG_ SAS1_SAS_Sts_Error_B32_7 : 407|1@1+ (1,0) [0|1] ""  External
 SG_ SAS1_RollingCounter_B36_7 : 439|1@1+ (1,0) [0|1] ""  External
 SG_ SAS1_Checksum_B3A_7 : 471|1@1+ (1,0) [0|1] ""  External
 SG_ RSDS_R2_Timeout_B26_7 : 311|1@1+ (1,0) [0|1] ""  External
 SG_ RSDS_R2_RollingCounter_B39_4 : 460|1@1+ (1,0) [0|1] ""  External
 SG_ RSDS_R1_Timeout_B22_7 : 279|1@1+ (1,0) [0|1] ""  External
 SG_ RSDS_R1_RiTarSts_Abnormal_B34_0 : 416|1@1+ (1,0) [0|1] ""  External
 SG_ RSDS_R1_CheckSum_B3D_7 : 495|1@1+ (1,0) [0|1] ""  External
 SG_ RSDS_L2_Timeout_B25_6 : 302|1@1+ (1,0) [0|1] ""  External
 SG_ RSDS_L2_RollingCounter_B39_1 : 457|1@1+ (1,0) [0|1] ""  External
 SG_ RSDS_L1_CheckSum_B3D_1 : 489|1@1+ (1,0) [0|1] ""  External
 SG_ HUT8_TSR_SnvtySet_Invalid_B30_3 : 387|1@1+ (1,0) [0|1] ""  External
 SG_ HUT8_Timeout_B24_7 : 295|1@1+ (1,0) [0|1] ""  External
 SG_ HUT8_IFC_SnvtySet_Abnormal_B2F_5 : 381|1@1+ (1,0) [0|1] ""  External
 SG_ HUT8_FCW_SnvtySet_Abnormal_B33_0 : 408|1@1+ (1,0) [0|1] ""  External
 SG_ HUT11_Timeout_B24_6 : 294|1@1+ (1,0) [0|1] ""  External
 SG_ HUT11_NavSpdLimValue_B28_6 : 326|1@1+ (1,0) [0|1] ""  External
 SG_ HUT11_NavSpdLimUnit_B28_7 : 327|1@1+ (1,0) [0|1] ""  External
 SG_ ECM9_ECM_ACCSwErr_Error_B32_6 : 406|1@1+ (1,0) [0|1] ""  External
 SG_ ECM1_DrivingModeDis_G_B35_7 : 13|1@1+ (1,0) [0|1] ""  External
 SG_ BCM8_WiperSwitchSts_Error_B30_6 : 390|1@1+ (1,0) [0|1] ""  External
 SG_ DCT2_TC_Slip_State_Error_B34_7 : 423|1@1+ (1,0) [0|1] ""  External
 SG_ EPS1_TrqSnsrSts_Abnormal_B31_7 : 399|1@1+ (1,0) [0|1] ""  External
 SG_ DCT3_RatAct_Error_B2e_7 : 375|1@1+ (1,0) [0|1] ""  External
 SG_ ECM2_EngState_Error_B2e_6 : 374|1@1+ (1,0) [0|1] ""  External
 SG_ APS4_Timeout_B26_6 : 310|1@1+ (1,0) [0|1] ""  External
 SG_ HAP_FD1_Timeout_B26_5 : 309|1@1+ (1,0) [0|1] ""  External
 SG_ DCT2_Timeout_B24_4 : 292|1@1+ (1,0) [0|1] ""  External
 SG_ SWP5_Missing_With_Default_B22_6 : 278|1@1+ (1,0) [0|1] ""  External
 SG_ SWP4_Missing_With_Default_B22_5 : 277|1@1+ (1,0) [0|1] ""  External
 SG_ SWP2_Missing_With_Default_B22_4 : 276|1@1+ (1,0) [0|1] ""  External
 SG_ SWP1_Missing_With_Default_B22_3 : 275|1@1+ (1,0) [0|1] ""  External
 SG_ Configure_DID_Missing_B20_0 : 256|1@1+ (1,0) [0|1] ""  External
 SG_ Sun_Rays_Fault_B11_7 : 143|1@1+ (1,0) [0|1] ""  External
 SG_ CAMERA_INTRINSIC_CAL_ERROR_Bf_4 : 124|1@1+ (1,0) [0|1] ""  External
 SG_ EYEQ_MINOR_ERROR_BM_EM_ERR__0001 : 174|1@1+ (1,0) [0|1] ""  External
 SG_ EYEQ_STATIC_CRC_FAULT_B6_1 : 49|1@1+ (1,0) [0|1] ""  External
 SG_ FEE_E_GC_READ_FAULT_B1_4 : 12|1@1+ (1,0) [0|1] ""  External
 SG_ EYEQ_GEN_34_Corrupted_Vehic_0001 : 121|1@1+ (1,0) [0|1] ""  External
 SG_ EYEQ_GEN_11_INPUT_CRC_MISMA_0001 : 120|1@1+ (1,0) [0|1] ""  External
 SG_ EYEQ_GEN_4_YAW_HORIZON_DEVI_0001 : 112|1@1+ (1,0) [0|1] ""  External
 SG_ EYEQ_GEN_18_IMAGER_DATA_ROW_0001 : 111|1@1+ (1,0) [0|1] ""  External
 SG_ EYEQ_GEN_13_OLD_EGODATA_LAT_Be_2 : 114|1@1+ (1,0) [0|1] ""  External
 SG_ AEB_shutdown_9_ROI_DIFF_VC__0001 : 107|1@1+ (1,0) [0|1] ""  External
 SG_ AEB_shutdown_7_POS_DIFF_KAL_0001 : 106|1@1+ (1,0) [0|1] ""  External
 SG_ EYEQ_GEN_50_VMP_SANITY_FAIL_0001 : 216|1@1+ (1,0) [0|1] ""  External
 SG_ EYEQ_FATAL_ERROR_APP_CPS_ST_0001 : 146|1@1+ (1,0) [0|1] ""  External
 SG_ EYEQ_GEN_24_CCFT_DIFF_RESUL_0001 : 227|1@1+ (1,0) [0|1] ""  External
 SG_ EYEQ_53_DECELERATION_DBS_OV_0001 : 226|1@1+ (1,0) [0|1] ""  External
 SG_ EYEQ_44_ROAD_SANITY_CORRECT_0001 : 225|1@1+ (1,0) [0|1] ""  External
 SG_ EYEQ_GEN_21_CAMERA_HEIGHT_L_0001 : 224|1@1+ (1,0) [0|1] ""  External
 SG_ EYEQ_FATAL_ERROR_APP_INVALI_0001 : 221|1@1+ (1,0) [0|1] ""  External
 SG_ EYEQ_45_ROAD_SFCONF_VALIDAT_0001 : 218|1@1+ (1,0) [0|1] ""  External
 SG_ EYEQ_48_ALGO_PITCH_MISMATCH_0001 : 217|1@1+ (1,0) [0|1] ""  External
 SG_ EyeQ_Minor_Error_Bm_Error_F_0001 : 160|1@1+ (1,0) [0|1] ""  External
 SG_ EyeQ_Fatal_Error_App_Init_F_0001 : 150|1@1+ (1,0) [0|1] ""  External
 SG_ EyeQ_Fatal_Error_App_Init_C_0001 : 151|1@1+ (1,0) [0|1] ""  External
 SG_ EyeQ_Fatal_Error_App_Fs_Err_0001 : 148|1@1+ (1,0) [0|1] ""  External
 SG_ EyeQ_Fatal_Error_App_Error__0001 : 147|1@1+ (1,0) [0|1] ""  External
 SG_ EyeQ_Fatal_Error_App_Calibr_0001 : 149|1@1+ (1,0) [0|1] ""  External
 SG_ EYEQ_33_ROAD_LANE_DISQUALIF_0001 : 220|1@1+ (1,0) [0|1] ""  External
 SG_ EYEQ_42_ROAD_PREDICTION_VAL_0001 : 219|1@1+ (1,0) [0|1] ""  External
 SG_ EYEQ_MES_49_Data_Path_Corru_0001 : 215|1@1+ (1,0) [0|1] ""  External
 SG_ EyeQ_Minor_Error_Bm_Em_Err__0023 : 172|1@1+ (1,0) [0|1] ""  External
 SG_ EyeQ_Minor_Error_Bm_Em_Erro_0001 : 161|1@1+ (1,0) [0|1] ""  External
 SG_ EyeQ_Minor_Error_Bm_Em_Err__0024 : 170|1@1+ (1,0) [0|1] ""  External
 SG_ EyeQ_Minor_Error_Bm_Em_Err__0025 : 171|1@1+ (1,0) [0|1] ""  External
 SG_ EyeQ_Minor_Error_Bm_Em_Err__0026 : 168|1@1+ (1,0) [0|1] ""  External
 SG_ EyeQ_Minor_Error_Bm_Em_Err__0027 : 162|1@1+ (1,0) [0|1] ""  External
 SG_ EyeQ_Minor_Error_Bm_Em_Err__0028 : 163|1@1+ (1,0) [0|1] ""  External
 SG_ EyeQ_Minor_Error_Bm_Em_Err__0029 : 164|1@1+ (1,0) [0|1] ""  External
 SG_ EyeQ_Minor_Error_Bm_Em_Err__0030 : 165|1@1+ (1,0) [0|1] ""  External
 SG_ EyeQ_Minor_Error_Bm_Em_Err__0031 : 169|1@1+ (1,0) [0|1] ""  External
 SG_ EyeQ_Minor_Error_Bm_Em_Err__0032 : 167|1@1+ (1,0) [0|1] ""  External
 SG_ EyeQ_Minor_Error_Bm_Em_Err__0033 : 166|1@1+ (1,0) [0|1] ""  External
 SG_ EyeQ_Minor_Error_Bm_Em_Err__0034 : 173|1@1+ (1,0) [0|1] ""  External
 SG_ EyeQ_Fatal_Error_Pv_Verific_0001 : 159|1@1+ (1,0) [0|1] ""  External
 SG_ EyeQ_Fatal_Error_Pv_General_0001 : 158|1@1+ (1,0) [0|1] ""  External
 SG_ EyeQ_Fatal_Error_Pll_Compar_0001 : 157|1@1+ (1,0) [0|1] ""  External
 SG_ EyeQ_Fatal_Error_App_Patter_0001 : 155|1@1+ (1,0) [0|1] ""  External
 SG_ Host_ENET_VersionMismatch_E_0001 : 68|1@1+ (1,0) [0|1] ""  External
 SG_ Host_ENET_Missing_Message_E_0001 : 65|1@1+ (1,0) [0|1] ""  External
 SG_ VISION_OUTOFCALIBRATION_B12_0 : 144|1@1+ (1,0) [0|1] ""  External
 SG_ VCU6_RollingCounter_B39_3 : 459|1@1+ (1,0) [0|1] ""  External
 SG_ VCU6_CheckSum_B3d_3 : 491|1@1+ (1,0) [0|1] ""  External
 SG_ VCU5_Timeout_B28_5 : 325|1@1+ (1,0) [0|1] ""  External
 SG_ VCU5_SysFltLvl_Error_B33_7 : 415|1@1+ (1,0) [0|1] ""  External
 SG_ VCU5_RollingCounter_B39_2 : 458|1@1+ (1,0) [0|1] ""  External
 SG_ VCU5_SysFltLvl_Reserved_B33_6 : 414|1@1+ (1,0) [0|1] ""  External
 SG_ VCU5_CheckSum_B3d_2 : 490|1@1+ (1,0) [0|1] ""  External
 SG_ VCU2_RollingCounter_B39_0 : 456|1@1+ (1,0) [0|1] ""  External
 SG_ VCU2_CheckSum_B3d_0 : 488|1@1+ (1,0) [0|1] ""  External
 SG_ VCU12_RollingCounter_B39_5 : 461|1@1+ (1,0) [0|1] ""  External
 SG_ VCU12_CheckSum_B3d_5 : 493|1@1+ (1,0) [0|1] ""  External
 SG_ VCU_FD4_Timeout_B28_4 : 324|1@1+ (1,0) [0|1] ""  External
 SG_ VCU_FD3_Timeout_B28_3 : 323|1@1+ (1,0) [0|1] ""  External
 SG_ VCU_FD3_GearSts_Invalid_B33_2 : 410|1@1+ (1,0) [0|1] ""  External
 SG_ VCU_FD2_VCU_ACCComIfNoResp_B33_5 : 413|1@1+ (1,0) [0|1] ""  External
 SG_ VCU_FD2_Timeout_B28_2 : 322|1@1+ (1,0) [0|1] ""  External
 SG_ VCU_FD2_MinNegAvlTq_B33_3 : 411|1@1+ (1,0) [0|1] ""  External
 SG_ VCU_FD2_MaxPosAvlTq_B33_4 : 412|1@1+ (1,0) [0|1] ""  External
 SG_ VCU_FD1_Timeout_B28_1 : 321|1@1+ (1,0) [0|1] ""  External
 SG_ VCU_FD1_BrkPedlSts_Error_B2d_5 : 365|1@1+ (1,0) [0|1] ""  External
 SG_ VCU_FD1_APedlPos_Invalid_B2d_7 : 367|1@1+ (1,0) [0|1] ""  External
 SG_ VCAN_Bus_Off_Fault_B21_3 : 267|1@1+ (1,0) [0|1] ""  External
 SG_ Variant_Coding_Mismatch_B21_0 : 264|1@1+ (1,0) [0|1] ""  External
 SG_ TD_Blockage_Test_12_1 : 145|1@1+ (1,0) [0|1] ""  External
 SG_ SWP5_Mismatch_B20_6 : 262|1@1+ (1,0) [0|1] ""  External
 SG_ SWP4_Mismatch_B20_5 : 261|1@1+ (1,0) [0|1] ""  External
 SG_ SWP2_Mismatch_B20_4 : 260|1@1+ (1,0) [0|1] ""  External
 SG_ SWP1_Mismatch_B20_3 : 259|1@1+ (1,0) [0|1] ""  External
 SG_ Splashes_Fault_10_7 : 135|1@1+ (1,0) [0|1] ""  External
 SG_ SelfGlare_Fault_11_5 : 141|1@1+ (1,0) [0|1] ""  External
 SG_ RSDS_R_5_RollingCounter_B36_2 : 434|1@1+ (1,0) [0|1] ""  External
 SG_ RSDS_R_5_Checksum_B3a_2 : 466|1@1+ (1,0) [0|1] ""  External
 SG_ RSDS_R_4_RollingCounter_B36_1 : 433|1@1+ (1,0) [0|1] ""  External
 SG_ RSDS_R_4_Checksum_B3a_1 : 465|1@1+ (1,0) [0|1] ""  External
 SG_ RSDS_R_3_RollingCounter_B36_0 : 432|1@1+ (1,0) [0|1] ""  External
 SG_ RSDS_R_3_Checksum_B3a_0 : 464|1@1+ (1,0) [0|1] ""  External
 SG_ RSDS_FD1_Timeout_B26_3 : 307|1@1+ (1,0) [0|1] ""  External
 SG_ RSDS_FD1_RiTarSts_Abnormal_B32_3 : 403|1@1+ (1,0) [0|1] ""  External
 SG_ RSDS_FD1_LeTarSts_Abnormal_B32_2 : 402|1@1+ (1,0) [0|1] ""  External
 SG_ Rain_Severity_Level_11_4 : 140|1@1+ (1,0) [0|1] ""  External
 SG_ R_PBox1_Timeout_B24_2 : 290|1@1+ (1,0) [0|1] ""  External
 SG_ Partial_Blockage_Fault_10_5 : 133|1@1+ (1,0) [0|1] ""  External
 SG_ PARAMETERS_INVALID_Bc_6 : 102|1@1+ (1,0) [0|1] ""  External
 SG_ Out_Of_Focus_Fault_B11_1 : 137|1@1+ (1,0) [0|1] ""  External
 SG_ NVM_E_REQ_FAILED_B0_7 : 7|1@1+ (1,0) [0|1] ""  External
 SG_ NVM_E_QUEUE_OVERFLOW_FAULT_0_4 : 4|1@1+ (1,0) [0|1] ""  External
 SG_ NVM_E_LOSS_OF_REDUNDANCY_B0_6 : 6|1@1+ (1,0) [0|1] ""  External
 SG_ NVM_E_INTEGRITY_FAILED_FAULT_0_5 : 5|1@1+ (1,0) [0|1] ""  External
 SG_ NBID_CRC_BOOT_REPORTED_B8_0 : 64|1@1+ (1,0) [0|1] ""  External
 SG_ MISSING_CAMERA_CALIBRATION_Bf_5 : 125|1@1+ (1,0) [0|1] ""  External
 SG_ MCU4_RollingCounter_B39_6 : 462|1@1+ (1,0) [0|1] ""  External
 SG_ MCU4_CheckSum_B3d_6 : 494|1@1+ (1,0) [0|1] ""  External
 SG_ MCU_FD1_Timeout_B28_0 : 320|1@1+ (1,0) [0|1] ""  External
 SG_ MCU_FD1_ActTrq_Invalid_B33_1 : 409|1@1+ (1,0) [0|1] ""  External
 SG_ Low_Visibility_Fault_11_6 : 142|1@1+ (1,0) [0|1] ""  External
 SG_ Low_Sun_Fault_11_0 : 136|1@1+ (1,0) [0|1] ""  External
 SG_ KAM_Design_Write_Fail_Fault_Bb_5 : 93|1@1+ (1,0) [0|1] ""  External
 SG_ KAM_Design_Read_Fail_Fault_Bb_4 : 92|1@1+ (1,0) [0|1] ""  External
 SG_ IP2_Timeout_Bb25_2 : 298|1@1+ (1,0) [0|1] ""  External
 SG_ IP2_IP_Error_Bb31_5 : 397|1@1+ (1,0) [0|1] ""  External
 SG_ IP2_ACC_Error_Bb31_6 : 398|1@1+ (1,0) [0|1] ""  External
 SG_ Host_ENET_MessageReception__0001 : 67|1@1+ (1,0) [0|1] ""  External
 SG_ IFC_FD1_0x12B_Mute_B22_1 : 273|1@1+ (1,0) [0|1] ""  External
 SG_ HUT_FD1_TSR_SnvtySet_B30_2 : 386|1@1+ (1,0) [0|1] ""  External
 SG_ HUT_FD1_Timeout_B26_2 : 306|1@1+ (1,0) [0|1] ""  External
 SG_ HUT_FD1_NavSpdLimValue_B30_4 : 388|1@1+ (1,0) [0|1] ""  External
 SG_ HUT_FD1_NavSpdLimUnit_B30_5 : 389|1@1+ (1,0) [0|1] ""  External
 SG_ HUT_FD1_LSSWarnFormSwtReq_B30_1 : 385|1@1+ (1,0) [0|1] ""  External
 SG_ HUT_FD1_IFC_SnvtySet_Abnor_B30_0 : 384|1@1+ (1,0) [0|1] ""  External
 SG_ HUT_FD1_FCW_SnvtySet_Abnor_B30_7 : 391|1@1+ (1,0) [0|1] ""  External
 SG_ HOST_HEATER_PWR_AURIX_B7_6 : 62|1@1+ (1,0) [0|1] ""  External
 SG_ Host_ENET_Missing_Data_Err_B8_2 : 66|1@1+ (1,0) [0|1] ""  External
 SG_ Host_Callibration_CRC_Fault_B8_6 : 70|1@1+ (1,0) [0|1] ""  External
 SG_ GRAB_VIDEO_TIMEOUT_B4_7 : 39|1@1+ (1,0) [0|1] ""  External
 SG_ Full_Blockage_Fault_10_4 : 132|1@1+ (1,0) [0|1] ""  External
 SG_ Frozen_Windshield_Fault_11_3 : 139|1@1+ (1,0) [0|1] ""  External
 SG_ Foggy_Spots_Fault_11_2 : 138|1@1+ (1,0) [0|1] ""  External
 SG_ FET_Fault_Across_cycles_B2_4 : 20|1@1+ (1,0) [0|1] ""  External
 SG_ FET_Fail_Across_Cycles_B2_5 : 21|1@1+ (1,0) [0|1] ""  External
 SG_ FEE_E_WRITE_FAULT_B1_1 : 9|1@1+ (1,0) [0|1] ""  External
 SG_ FEE_E_WRITE_CYCLES_EXHAUST_B2_0 : 16|1@1+ (1,0) [0|1] ""  External
 SG_ FEE_E_UNCONFIG_BLK_EXCEED_B2_2 : 18|1@1+ (1,0) [0|1] ""  External
 SG_ FEE_E_READ_FAULT_B1_2 : 10|1@1+ (1,0) [0|1] ""  External
 SG_ FEE_E_INVALIDATE_FAULT_B1_7 : 15|1@1+ (1,0) [0|1] ""  External
 SG_ FEE_E_GC_WRITE_FAULT_B1_3 : 11|1@1+ (1,0) [0|1] ""  External
 SG_ FEE_E_GC_TRIG_FAULT_B2_1 : 17|1@1+ (1,0) [0|1] ""  External
 SG_ FEE_E_GC_INIT_FAULT_B1_0 : 8|1@1+ (1,0) [0|1] ""  External
 SG_ FEE_E_GC_ERASE_FAULT_B1_6 : 14|1@1+ (1,0) [0|1] ""  External
 SG_ FactoryMode_B20_7 : 263|1@1+ (1,0) [0|1] ""  External
 SG_ F_PBox1_Timeout_B24_3 : 291|1@1+ (1,0) [0|1] ""  External
 SG_ EYQQ_ROAD_INFO_COUNTER_ERROR_2_6 : 22|1@1+ (1,0) [0|1] ""  External
 SG_ EYEQ_VISION_SAFETY_DIAG_RFC_B5_3 : 43|1@1+ (1,0) [0|1] ""  External
 SG_ EYEQ_VISION_SAFETY_DIAG_CRC_B5_2 : 42|1@1+ (1,0) [0|1] ""  External
 SG_ EYEQ_VISION_AEB_INFO_RFC_B5_1 : 41|1@1+ (1,0) [0|1] ""  External
 SG_ EYEQ_VISION_AEB_INFO_CRC_B5_0 : 40|1@1+ (1,0) [0|1] ""  External
 SG_ EYEQ_VIS_OBSTACLES_INFO_RFC_B5_6 : 46|1@1+ (1,0) [0|1] ""  External
 SG_ EYEQ_VIS_OBSTACLES_INFO_CRC_B5_5 : 45|1@1+ (1,0) [0|1] ""  External
 SG_ EYEQ_VIS_FAILSAFESRFCFAULT_B6_4 : 52|1@1+ (1,0) [0|1] ""  External
 SG_ EYEQ_VIS_FAILSAFESCRCFAULT_B6_3 : 51|1@1+ (1,0) [0|1] ""  External
 SG_ EYEQ_STATIC_RFC_FAULT_B6_2 : 50|1@1+ (1,0) [0|1] ""  External
 SG_ EYEQ_DYNAMIC_RFC_FAULT_B6_0 : 48|1@1+ (1,0) [0|1] ""  External
 SG_ EYEQ_DYNAMIC_CRC_FAULT_B5_7 : 47|1@1+ (1,0) [0|1] ""  External
 SG_ EYEQ_ROAD_INFO_CRC_FAULT_B5_4 : 44|1@1+ (1,0) [0|1] ""  External
 SG_ EYEQ_OTA_SWAP_FAULT_B7_5 : 61|1@1+ (1,0) [0|1] ""  External
 SG_ EyeQ_MESP_Coding_failure_B9_1 : 73|1@1+ (1,0) [0|1] ""  External
 SG_ EYEQ_GEN_CR_ERR_FAULT_B2_3 : 19|1@1+ (1,0) [0|1] ""  External
 SG_ EYEQ_GEN_31_AEB_PARAM_FFI_Be_6 : 118|1@1+ (1,0) [0|1] ""  External
 SG_ EYEQ_GEN_29_RFC_ERR_Be_7 : 119|1@1+ (1,0) [0|1] ""  External
 SG_ EyeQ_DDR_RAM_CRC_Bb_7 : 95|1@1+ (1,0) [0|1] ""  External
 SG_ ESP2_VehStandstill_Invalid_B2c_2 : 354|1@1+ (1,0) [0|1] ""  External
 SG_ ESP2_Timeout_B27_4 : 316|1@1+ (1,0) [0|1] ""  External
 SG_ ESP2_RollingCounter_B37_4 : 444|1@1+ (1,0) [0|1] ""  External
 SG_ ESP2_HDCCtrl_Abnormal_B35_5 : 429|1@1+ (1,0) [0|1] ""  External
 SG_ ESP2_DrivingModDis_Abnor_B35_6 : 430|1@1+ (1,0) [0|1] ""  External
 SG_ ESP2_CheckSum_B3b_4 : 476|1@1+ (1,0) [0|1] ""  External
 SG_ ESP2_CDDAvailable_Error_B2c_0 : 352|1@1+ (1,0) [0|1] ""  External
 SG_ ESP2_AWBAvailable_Error_B2d_2 : 362|1@1+ (1,0) [0|1] ""  External
 SG_ ESP2_AEBAvailable_Error_B2c_4 : 356|1@1+ (1,0) [0|1] ""  External
 SG_ ESP2_ABPAvailable_Error_B2c_6 : 358|1@1+ (1,0) [0|1] ""  External
 SG_ ESP2_ABAavailable_Error_B2d_0 : 360|1@1+ (1,0) [0|1] ""  External
 SG_ ESP1_Timeout_B27_3 : 315|1@1+ (1,0) [0|1] ""  External
 SG_ ESP1_RollingCounter_B37_3 : 443|1@1+ (1,0) [0|1] ""  External
 SG_ ESP1_MasterCylBrkPress_B2b_0 : 344|1@1+ (1,0) [0|1] ""  External
 SG_ ESP1_ESPFailSts_Failure_B2b_6 : 350|1@1+ (1,0) [0|1] ""  External
 SG_ ESP1_CheckSum_B3b_3 : 475|1@1+ (1,0) [0|1] ""  External
 SG_ ESP_FD3_Timeout_B27_7 : 319|1@1+ (1,0) [0|1] ""  External
 SG_ ESP_FD3_SwtPosn_Invalid_B2e_1 : 369|1@1+ (1,0) [0|1] ""  External
 SG_ ESP_FD3_RRWheelSpd_Invalid_B2a_7 : 343|1@1+ (1,0) [0|1] ""  External
 SG_ ESP_FD3_RRWhDriveDirection_B29_3 : 331|1@1+ (1,0) [0|1] ""  External
 SG_ ESP_FD3_RLWheelSpd_Invalid_B2a_5 : 341|1@1+ (1,0) [0|1] ""  External
 SG_ ESP_FD3_RLWhDriveDirection_B29_1 : 329|1@1+ (1,0) [0|1] ""  External
 SG_ ESP_FD3_FRWheelSpd_Invalid_B2a_3 : 339|1@1+ (1,0) [0|1] ""  External
 SG_ ESP_FD3_FRWhDriveDirection_B29_7 : 335|1@1+ (1,0) [0|1] ""  External
 SG_ ESP_FD3_FLWheelSpd_Invalid_B2a_1 : 337|1@1+ (1,0) [0|1] ""  External
 SG_ ESP_FD3_FLWhDriveDirection_B29_5 : 333|1@1+ (1,0) [0|1] ""  External
 SG_ ESP_FD3_EPBSts_Error_B2e_5 : 373|1@1+ (1,0) [0|1] ""  External
 SG_ ESP_FD3_EPBErrSts_Error_B2e_3 : 371|1@1+ (1,0) [0|1] ""  External
 SG_ ESP_FD3_EPB1_RollCounter_B38_2 : 450|1@1+ (1,0) [0|1] ""  External
 SG_ ESP_FD3_EPB1_CheckSum_B3c_2 : 482|1@1+ (1,0) [0|1] ""  External
 SG_ ESP_FD3_ABS2_RollCounter_B38_4 : 452|1@1+ (1,0) [0|1] ""  External
 SG_ ESP_FD3_ABS2_CheckSum_B3c_4 : 484|1@1+ (1,0) [0|1] ""  External
 SG_ ESP_FD3_ABS1_RollCounter_B38_3 : 451|1@1+ (1,0) [0|1] ""  External
 SG_ ESP_FD3_ABS1_CheckSum_B3c_3 : 483|1@1+ (1,0) [0|1] ""  External
 SG_ ESP_FD2_VehStandstill_B2c_3 : 355|1@1+ (1,0) [0|1] ""  External
 SG_ ESP_FD2_VehSpd_Missing_B21_5 : 269|1@1+ (1,0) [0|1] ""  External
 SG_ ESP_FD2_VehSpd_Invalid_B2b_5 : 349|1@1+ (1,0) [0|1] ""  External
 SG_ ESP_FD2_Timeout_B27_6 : 318|1@1+ (1,0) [0|1] ""  External
 SG_ ESP_FD2_MasterCylBrkPress_B2b_1 : 345|1@1+ (1,0) [0|1] ""  External
 SG_ ESP_FD2_ESPFailSts_Failure_B2b_7 : 351|1@1+ (1,0) [0|1] ""  External
 SG_ ESP_FD2_ESP2_RollCounter_B38_7 : 455|1@1+ (1,0) [0|1] ""  External
 SG_ ESP_FD2_ESP2_CheckSum_B3c_7 : 487|1@1+ (1,0) [0|1] ""  External
 SG_ ESP_FD2_ESP1_RollCounter_B38_6 : 454|1@1+ (1,0) [0|1] ""  External
 SG_ ESP_FD2_ESP1_CheckSum_B3c_6 : 486|1@1+ (1,0) [0|1] ""  External
 SG_ ESP_FD2_CDDAvailable_Error_B2c_1 : 353|1@1+ (1,0) [0|1] ""  External
 SG_ ESP_FD2_AWBAvailable_Error_B2d_3 : 363|1@1+ (1,0) [0|1] ""  External
 SG_ ESP_FD2_AEBAvailable_Error_B2c_5 : 357|1@1+ (1,0) [0|1] ""  External
 SG_ ESP_FD2_ABSFailSts_Failure_B2b_3 : 347|1@1+ (1,0) [0|1] ""  External
 SG_ ESP_FD2_ABS3_RollCounter_B38_5 : 453|1@1+ (1,0) [0|1] ""  External
 SG_ ESP_FD2_ABS3_CheckSum_B3c_5 : 485|1@1+ (1,0) [0|1] ""  External
 SG_ ESP_FD2_ABPAvailable_Error_B2c_7 : 359|1@1+ (1,0) [0|1] ""  External
 SG_ ESP_FD2_ABAavailable_Error_B2d_1 : 361|1@1+ (1,0) [0|1] ""  External
 SG_ EPS2_Timeout_B26_1 : 305|1@1+ (1,0) [0|1] ""  External
 SG_ EPS2_RollingCounter_B36_6 : 438|1@1+ (1,0) [0|1] ""  External
 SG_ EPS2_LKATrqOvlDlvdSts_Temp_B2f_6 : 382|1@1+ (1,0) [0|1] ""  External
 SG_ EPS2_LKATrqOvlDlvdSts_Perm_B2f_7 : 383|1@1+ (1,0) [0|1] ""  External
 SG_ EPS2_CheckSum_B3a_6 : 470|1@1+ (1,0) [0|1] ""  External
 SG_ EPS1_Timeout_B26_0 : 304|1@1+ (1,0) [0|1] ""  External
 SG_ EPS1_SteerMod_Abnormal_B32_1 : 401|1@1+ (1,0) [0|1] ""  External
 SG_ EPS1_EPSFailSts_Failure_B32_0 : 400|1@1+ (1,0) [0|1] ""  External
 SG_ EPB1_Timeout_B27_5 : 317|1@1+ (1,0) [0|1] ""  External
 SG_ EPB1_SwtPosn_Invalid_B2e_0 : 368|1@1+ (1,0) [0|1] ""  External
 SG_ EPB1_RollingCounter_B37_5 : 445|1@1+ (1,0) [0|1] ""  External
 SG_ EPB1_EPBSts_Error_B2e_4 : 372|1@1+ (1,0) [0|1] ""  External
 SG_ EPB1_EPBErrSts_Error_B2e_2 : 370|1@1+ (1,0) [0|1] ""  External
 SG_ EPB1_CheckSum_B3b_5 : 477|1@1+ (1,0) [0|1] ""  External
 SG_ ECM9_Timeout_B23_6 : 286|1@1+ (1,0) [0|1] ""  External
 SG_ ECM9_RollingCounter_B38_1 : 449|1@1+ (1,0) [0|1] ""  External
 SG_ ECM9_ECMACCInterface_Error_B34_6 : 422|1@1+ (1,0) [0|1] ""  External
 SG_ ECM9_Checksum_B3c_1 : 481|1@1+ (1,0) [0|1] ""  External
 SG_ ECM8_TrqLoss_Invalid_B34_5 : 421|1@1+ (1,0) [0|1] ""  External
 SG_ ECM8_Timeout_B23_5 : 285|1@1+ (1,0) [0|1] ""  External
 SG_ ECM7_Timeout_B23_4 : 284|1@1+ (1,0) [0|1] ""  External
 SG_ ECM4_Timeout_B23_3 : 283|1@1+ (1,0) [0|1] ""  External
 SG_ ECM4_RollingCounter_B38_0 : 448|1@1+ (1,0) [0|1] ""  External
 SG_ ECM4_NetEngTrq_Invalid_B34_3 : 419|1@1+ (1,0) [0|1] ""  External
 SG_ ECM4_DrvEngTrqReq_Invalid_B34_4 : 420|1@1+ (1,0) [0|1] ""  External
 SG_ ECM4_Checksum_B3c_0 : 480|1@1+ (1,0) [0|1] ""  External
 SG_ ECM3_Timeout_B23_2 : 282|1@1+ (1,0) [0|1] ""  External
 SG_ ECM3_MaxEngTrqNorm_Abnorm_B34_2 : 418|1@1+ (1,0) [0|1] ""  External
 SG_ ECM2_Timeout_B23_1 : 281|1@1+ (1,0) [0|1] ""  External
 SG_ ECM2_AccelPedalPosn_Invd_B2d_6 : 366|1@1+ (1,0) [0|1] ""  External
 SG_ ECM1_Timeout_B23_0 : 280|1@1+ (1,0) [0|1] ""  External
 SG_ ECM1_Start_StopSts_Invalid_B34_1 : 417|1@1+ (1,0) [0|1] ""  External
 SG_ ECM1_RollingCounter_B37_7 : 447|1@1+ (1,0) [0|1] ""  External
 SG_ ECM1_Checksum_B3b_7 : 479|1@1+ (1,0) [0|1] ""  External
 SG_ ECM1_BrkPedalSts_Error_B2d_4 : 364|1@1+ (1,0) [0|1] ""  External
 SG_ DCT7_Timeout_B24_1 : 289|1@1+ (1,0) [0|1] ""  External
 SG_ DCT7_DrvFaiMsg_Failure_B35_4 : 428|1@1+ (1,0) [0|1] ""  External
 SG_ DCT5_Timeout_B24_0 : 288|1@1+ (1,0) [0|1] ""  External
 SG_ DCT5_TGS_LEVER_Invalid_B35_3 : 427|1@1+ (1,0) [0|1] ""  External
 SG_ DCT5_TARGET_GEAR_Invalid_B35_2 : 426|1@1+ (1,0) [0|1] ""  External
 SG_ DCT5_ShiftInPrg_Invalid_B35_1 : 425|1@1+ (1,0) [0|1] ""  External
 SG_ DCT5_RollingCounter_B37_6 : 446|1@1+ (1,0) [0|1] ""  External
 SG_ DCT5_CurrentGear_Invalid_B35_0 : 424|1@1+ (1,0) [0|1] ""  External
 SG_ DCT5_CheckSum_B3b_6 : 478|1@1+ (1,0) [0|1] ""  External
 SG_ DCT3_Timeout_B23_7 : 287|1@1+ (1,0) [0|1] ""  External
 SG_ CSA2_Timeout_B25_4 : 300|1@1+ (1,0) [0|1] ""  External
 SG_ CSA2_SteerWheelSpd_Invalid_B31_2 : 394|1@1+ (1,0) [0|1] ""  External
 SG_ CSA2_SteerWheelAng_Invalid_B31_1 : 393|1@1+ (1,0) [0|1] ""  External
 SG_ CSA2_SAS_Sts_Error_B31_4 : 396|1@1+ (1,0) [0|1] ""  External
 SG_ CSA2_Rollingcounter_B36_5 : 437|1@1+ (1,0) [0|1] ""  External
 SG_ CSA2_Checksum_B3a_5 : 469|1@1+ (1,0) [0|1] ""  External
 SG_ CSA2_CC_ACCSwt_Error_B31_3 : 395|1@1+ (1,0) [0|1] ""  External
 SG_ CSA1_Timeout_B25_3 : 299|1@1+ (1,0) [0|1] ""  External
 SG_ CSA1_FrntWiprSwtSts_Error_B31_0 : 392|1@1+ (1,0) [0|1] ""  External
 SG_ Blurred_Image_Fault_B10_6 : 134|1@1+ (1,0) [0|1] ""  External
 SG_ BCM8_WiprReq_Invalid_B2f_4 : 380|1@1+ (1,0) [0|1] ""  External
 SG_ BCM8_Timeout_B25_7 : 303|1@1+ (1,0) [0|1] ""  External
 SG_ BCM1_Timeout_B25_5 : 301|1@1+ (1,0) [0|1] ""  External
 SG_ AEB_shutdown_Invalid_Reason_Bd_1 : 105|1@1+ (1,0) [0|1] ""  External
 SG_ AEB_shutdown_4_DT_ERR_Bd_6 : 110|1@1+ (1,0) [0|1] ""  External
 SG_ AEB_shutdown_6_FCV_FCW_TTC_Bd_4 : 108|1@1+ (1,0) [0|1] ""  External
 SG_ AEB_shutdown_27_FcvSigFfi_Bf_2 : 122|1@1+ (1,0) [0|1] ""  External
 SG_ AEB_shutdown_25_CO_FOF_DIFF_Bd_5 : 109|1@1+ (1,0) [0|1] ""  External
 SG_ AEB_Safety_Violation_B21_7 : 271|1@1+ (1,0) [0|1] ""  External
 SG_ ACC_Safety_Violation_B22_0 : 272|1@1+ (1,0) [0|1] ""  External
 SG_ AC2_Timeout_B26_4 : 308|1@1+ (1,0) [0|1] ""  External
 SG_ AC2_ACAmbTemp_Invalid_B2f_3 : 379|1@1+ (1,0) [0|1] ""  External
 SG_ ABS3_VehSpd_Missing_B21_4 : 268|1@1+ (1,0) [0|1] ""  External
 SG_ ABS3_VehSpd_Invalid_B2b_4 : 348|1@1+ (1,0) [0|1] ""  External
 SG_ ABS3_ABSFailSts_Failure_B2b_2 : 346|1@1+ (1,0) [0|1] ""  External
 SG_ ABS2_RRWheelSpd_Invalid_B2a_6 : 342|1@1+ (1,0) [0|1] ""  External
 SG_ ABS2_RRWhDirection_Invalid_B29_2 : 330|1@1+ (1,0) [0|1] ""  External
 SG_ ABS2_RLWheelSpd_Invalid_B2a_4 : 340|1@1+ (1,0) [0|1] ""  External
 SG_ ABS2_RLWhDirection_Invalid_B29_0 : 328|1@1+ (1,0) [0|1] ""  External
 SG_ ABS1_FRWheelSpd_Invalid_B2a_2 : 338|1@1+ (1,0) [0|1] ""  External
 SG_ ABS1_FRWhDirection_Invalid_B29_6 : 334|1@1+ (1,0) [0|1] ""  External
 SG_ ABS1_FLWheelSpd_Invalid_B2a_0 : 336|1@1+ (1,0) [0|1] ""  External
 SG_ ABS1_FLWhDirection_Invalid_B29_4 : 332|1@1+ (1,0) [0|1] ""  External
 SG_ ABS3_Timeout_B27_2 : 314|1@1+ (1,0) [0|1] ""  External
 SG_ ABS2_Timeout_B27_1 : 313|1@1+ (1,0) [0|1] ""  External
 SG_ ABS3_RollingCounter_B37_2 : 442|1@1+ (1,0) [0|1] ""  External
 SG_ ABS2_RollingCounter_B37_1 : 441|1@1+ (1,0) [0|1] ""  External
 SG_ ABS3_CheckSum_B3b_2 : 474|1@1+ (1,0) [0|1] ""  External
 SG_ ABS2_CheckSum_B3b_1 : 473|1@1+ (1,0) [0|1] ""  External
 SG_ ABS1_Timeout_B27_0 : 312|1@1+ (1,0) [0|1] ""  External
 SG_ ABS1_RollingCounter_B37_0 : 440|1@1+ (1,0) [0|1] ""  External
 SG_ ABS1_CheckSum_B3b_0 : 472|1@1+ (1,0) [0|1] ""  External
 SG_ ABM2_VehYawRate_Missing_B21_6 : 270|1@1+ (1,0) [0|1] ""  External
 SG_ ABM2_VehYawRate_Invalid_B2f_0 : 376|1@1+ (1,0) [0|1] ""  External
 SG_ ABM2_VehLgtAccel_Invalid_B2f_1 : 377|1@1+ (1,0) [0|1] ""  External
 SG_ ABM2_VehLatAccel_Invalid_B2f_2 : 378|1@1+ (1,0) [0|1] ""  External
 SG_ ABM2_Timeout_B25_1 : 297|1@1+ (1,0) [0|1] ""  External
 SG_ ABM2_RollingCounter_B36_4 : 436|1@1+ (1,0) [0|1] ""  External
 SG_ ABM2_CheckSum_B3a_4 : 468|1@1+ (1,0) [0|1] ""  External
 SG_ ABM1_Timeout_B25_0 : 296|1@1+ (1,0) [0|1] ""  External
 SG_ ABM1_RollingCounter_B36_3 : 435|1@1+ (1,0) [0|1] ""  External
 SG_ ABM1_CheckSum_B3a_3 : 467|1@1+ (1,0) [0|1] ""  External
 SG_ Vision_Internal_Error_B1f_6 : 254|1@1+ (1,0) [0|1] ""  External
 SG_ EyeQ_Spi_Msg_Timeout_A_7 : 87|1@1+ (1,0) [0|1] ""  External
 SG_ Host_Spi_CRC_Error_A_2 : 82|1@1+ (1,0) [0|1] ""  External
 SG_ Host_Spi_Tx_Error_A_1 : 81|1@1+ (1,0) [0|1] ""  External
 SG_ Host_spi_msg_timeout_A_0 : 80|1@1+ (1,0) [0|1] ""  External
 SG_ EyeQ_Calibration_Checksum_9_4 : 76|1@1+ (1,0) [0|1] ""  External
 SG_ Imager_2V8_Supply_OutRange_6_7 : 55|1@1+ (1,0) [0|1] ""  External
 SG_ Aurix_1V25_Supply_OutRange_B6_6 : 54|1@1+ (1,0) [0|1] ""  External
 SG_ Imager_1V2_Supply_OutRange_6_5 : 53|1@1+ (1,0) [0|1] ""  External
 SG_ Battery_High_Fault_B21_2 : 266|1@1+ (1,0) [0|1] ""  External
 SG_ Battery_Low_Fault_B21_1 : 265|1@1+ (1,0) [0|1] ""  External
 SG_ PS_5V0_Out_Of_Range_4_4 : 36|1@1+ (1,0) [0|1] ""  External
 SG_ EyeQDDROnBrdThermstorOutRang_4_3 : 35|1@1+ (1,0) [0|1] ""  External
 SG_ EyeQDDROnBrdThermstorOveTemp_4_1 : 33|1@1+ (1,0) [0|1] ""  External
 SG_ EyeQ_Temp_Exceeded_3_0 : 24|1@1+ (1,0) [0|1] ""  External
 SG_ SYSTEM_OVER_TEMPERATURE_2_7 : 23|1@1+ (1,0) [0|1] ""  External
 SG_ EyeQ_Error_Out_Temp_Fault_1A_6 : 214|1@1+ (1,0) [0|1] ""  External
 SG_ EyeQErrOutSignalInternFault_1A_5 : 213|1@1+ (1,0) [0|1] ""  External
 SG_ EyeQ_Camera1_Temp_Fault_1A_4 : 212|1@1+ (1,0) [0|1] ""  External
 SG_ EyeQVdoErrFlg_ShotOutOfSync_1A_3 : 211|1@1+ (1,0) [0|1] ""  External
 SG_ EyeQVdoErrFlg_VdiErrShutdwn_1A_2 : 210|1@1+ (1,0) [0|1] ""  External
 SG_ EyeQVdoErrFlg_HdrVerifiErr_1A_1 : 209|1@1+ (1,0) [0|1] ""  External
 SG_ EyeQVdoErrFlg_CcftDecisionMismat : 208|1@1+ (1,0) [0|1] ""  External
 SG_ EyeQVdoErrFlg_HistogramsMismatch : 207|1@1+ (1,0) [0|1] ""  External
 SG_ EyeQVdoErrFlg_FrameCountReadFail : 206|1@1+ (1,0) [0|1] ""  External
 SG_ EyeQVdoErrFlgVdiErr_CoreIdFlt : 205|1@1+ (1,0) [0|1] ""  External
 SG_ EyeQVdoErrFlgVdiErr_StrtAftStrt : 204|1@1+ (1,0) [0|1] ""  External
 SG_ EyeQVdoErrFlgVdiErr_ParityHisFlt : 203|1@1+ (1,0) [0|1] ""  External
 SG_ EyeQVdoErrFlgVdiErr_ParityGamma : 202|1@1+ (1,0) [0|1] ""  External
 SG_ EyeQVdoErrFlgVdiErr_ParityWeight : 201|1@1+ (1,0) [0|1] ""  External
 SG_ EyeQVdoErrFlgVdiErr_ParityFifo : 200|1@1+ (1,0) [0|1] ""  External
 SG_ EyeQVdoErrFlgVdiErrFifo_Undflow : 199|1@1+ (1,0) [0|1] ""  External
 SG_ EyeQVdoErrFlgVdiErrFifo_Overflow : 198|1@1+ (1,0) [0|1] ""  External
 SG_ EyeQVdoErrFlgVdiErr_Timeout_18_5 : 197|1@1+ (1,0) [0|1] ""  External
 SG_ EyeQVdoErrFlgVdiErr_BuffInvldFmt : 196|1@1+ (1,0) [0|1] ""  External
 SG_ EyeQVdoErrFlg_Vdi_ErrNoBuff_18_3 : 195|1@1+ (1,0) [0|1] ""  External
 SG_ EyeQVdoErrFlgVdi_InternErr18_2 : 194|1@1+ (1,0) [0|1] ""  External
 SG_ EyeQVdoErrFlgSumNotMatHistgrmErr : 193|1@1+ (1,0) [0|1] ""  External
 SG_ EyeQVdoErrFlgZeroHistgrmErr_18_0 : 192|1@1+ (1,0) [0|1] ""  External
 SG_ EyeQVdoErrFlgRegWrtHilFailErr : 191|1@1+ (1,0) [0|1] ""  External
 SG_ EyeQVdoErrFlgErrRegFlagFlt_17_6 : 190|1@1+ (1,0) [0|1] ""  External
 SG_ EyeQVdoErrFlgInvldVdoHeaderFault : 189|1@1+ (1,0) [0|1] ""  External
 SG_ EyeQVdoErrFlgVerifiFailVdoErr : 188|1@1+ (1,0) [0|1] ""  External
 SG_ EyeQVdoErrFlgInconstFramVdoErr : 187|1@1+ (1,0) [0|1] ""  External
 SG_ EyeQ_Cam1VdoErrFlgLgcVdoErr_17_2 : 186|1@1+ (1,0) [0|1] ""  External
 SG_ EyeQCam1VdoErrFlgI2CNoOnTmVdoErr : 185|1@1+ (1,0) [0|1] ""  External
 SG_ EyeQCam1VdoErrFlgVdiVdoErr_17_0 : 184|1@1+ (1,0) [0|1] ""  External
 SG_ EyeQ_Cam_Vdo_Flt_16_7 : 183|1@1+ (1,0) [0|1] ""  External
 SG_ EyeQ_Cam_Ctrl_Flt_16_6 : 182|1@1+ (1,0) [0|1] ""  External
 SG_ EyeQ_Cam_Mal_Func_16_5 : 181|1@1+ (1,0) [0|1] ""  External
 SG_ Grab_Release_Failure_16_4 : 180|1@1+ (1,0) [0|1] ""  External
 SG_ Grab_Acquire_Failure_16_3 : 179|1@1+ (1,0) [0|1] ""  External
 SG_ Grab_Issue_Failure_16_2 : 178|1@1+ (1,0) [0|1] ""  External
 SG_ Grab_No_Free_Header_Failure_16_1 : 177|1@1+ (1,0) [0|1] ""  External
 SG_ Init_I2C_Failure_16_0 : 176|1@1+ (1,0) [0|1] ""  External
 SG_ Init_Vdi_Failure_15_7 : 175|1@1+ (1,0) [0|1] ""  External
 SG_ EyeQFatalErrApCamParaCcftCrc13_4 : 156|1@1+ (1,0) [0|1] ""  External
 SG_ EyeQFatalErrAppI2CTimoutErr_13_2 : 154|1@1+ (1,0) [0|1] ""  External
 SG_ EyeQFatalErrAppI2CCamSlfRst_13_1 : 153|1@1+ (1,0) [0|1] ""  External
 SG_ EyeQFatalErrAppI2CVidoGrb_13_0 : 152|1@1+ (1,0) [0|1] ""  External
 SG_ EYEQ_GEN54ACCSTLEXECUTFAILED_F_3 : 123|1@1+ (1,0) [0|1] ""  External
 SG_ EYEQ_GEN_26_CODE_CRC_E_1 : 113|1@1+ (1,0) [0|1] ""  External
 SG_ EyeQ_Core_Dump_Fault_C_5 : 101|1@1+ (1,0) [0|1] ""  External
 SG_ EyeQ_Init_Timeout_Fault_C_4 : 100|1@1+ (1,0) [0|1] ""  External
 SG_ EYEQ4_Mode_Fault_C_3 : 99|1@1+ (1,0) [0|1] ""  External
 SG_ EyeQ_Bist_Memory_Fault_C_2 : 98|1@1+ (1,0) [0|1] ""  External
 SG_ EyeQ_Core_Fault_C_1 : 97|1@1+ (1,0) [0|1] ""  External
 SG_ EyeQ_Boot_Fault_C_0 : 96|1@1+ (1,0) [0|1] ""  External
 SG_ EyeQ_DDR_Fault_B_6 : 94|1@1+ (1,0) [0|1] ""  External
 SG_ EyeQ_SerialFlashPowerUp_Fail_B_1 : 89|1@1+ (1,0) [0|1] ""  External
 SG_ EyeQ_SPI_CRC_ERROR_B_0 : 88|1@1+ (1,0) [0|1] ""  External
 SG_ EYEQ_Spi_Msg_Format_Error_A_6 : 86|1@1+ (1,0) [0|1] ""  External
 SG_ EyeQ_Spi_Frame_Format_Error_A_5 : 85|1@1+ (1,0) [0|1] ""  External
 SG_ Spi_Ipc_Comm_Reset_A_4 : 84|1@1+ (1,0) [0|1] ""  External
 SG_ Spi_version_mismatch_A_3 : 83|1@1+ (1,0) [0|1] ""  External
 SG_ Host_Spi_Msg_Format_Error_9_7 : 79|1@1+ (1,0) [0|1] ""  External
 SG_ Host_Spi_Frame_Format_Error_9_6 : 78|1@1+ (1,0) [0|1] ""  External
 SG_ EyeQ_Application_Checksum_9_3 : 75|1@1+ (1,0) [0|1] ""  External
 SG_ EyeQAppl_CompltAndComptibl_9_2 : 74|1@1+ (1,0) [0|1] ""  External
 SG_ EyeQOnBoardThermstorOutRange_4_2 : 34|1@1+ (1,0) [0|1] ""  External
 SG_ EyeQ_DDR_Over_Temp_4_0 : 32|1@1+ (1,0) [0|1] ""  External
 SG_ EyeQ_Boot_OverTemp_Fault_3_7 : 31|1@1+ (1,0) [0|1] ""  External
 SG_ EyeQ_Imager_Over_Temp_3_6 : 30|1@1+ (1,0) [0|1] ""  External
 SG_ EyeQ_VMP_Over_Temp_3_5 : 29|1@1+ (1,0) [0|1] ""  External
 SG_ EyeQ_MIPS_Over_Temp_3_4 : 28|1@1+ (1,0) [0|1] ""  External
 SG_ EyeQOnBoardThermistorOveTemp_3_1 : 25|1@1+ (1,0) [0|1] ""  External
 SG_ EYEQ_1V0_SUPPLY_OUT_OF_RANGE_0_3 : 3|1@1+ (1,0) [0|1] ""  External
 SG_ EYEQ_1V1_SUPPLY_OUT_OF_RANGE_0_2 : 2|1@1+ (1,0) [0|1] ""  External
 SG_ EYEQ_1V8_SUPPLY_OUT_OF_RANGE_0_1 : 1|1@1+ (1,0) [0|1] ""  External
 SG_ EYEQ_3V3_SUPPLY_OUT_OF_RANGE_0_0 : 0|1@1+ (1,0) [0|1] ""  External
 SG_ Windshield_heater_OPNLD_Err_0001 : 496|1@1+ (1,0) [0|1] ""  External
 SG_ WWINDSHIELD_HEATER_STG_FAUL_0001 : 497|1@1+ (1,0) [0|1] ""  External
 SG_ WINDSHIELD_HEATER_OVRLD_FAU_0001 : 498|1@1+ (1,0) [0|1] ""  External
 SG_ WINDSHIELD_HEATER_STB_FAULT_0001 : 499|1@1+ (1,0) [0|1] ""  External

BO_ 1808 Active_Fault: 64 IFV410
 SG_ IP2_Timeout_For_Fuel_B22_2 : 274|1@1+ (1,0) [0|1] ""  External
 SG_ BCM3_Timeout_B20_1 : 257|1@1+ (1,0) [0|1] ""  External
 SG_ Intrinsic_Parameter_CRCErr_B1f_5 : 253|1@1+ (1,0) [0|1] ""  External
 SG_ Intrinsic_Parameter_Miss_B1f_4 : 252|1@1+ (1,0) [0|1] ""  External
 SG_ EyeQ_GPIO_Toggle_fail_B1e_6 : 246|1@1+ (1,0) [0|1] ""  External
 SG_ EQ_AppMissInputSignalErr_B1b_7 : 223|1@1+ (1,0) [0|1] ""  External
 SG_ EYEQ_43_ROADBOUNDCORRECT_B1b_6 : 130|1@1+ (1,0) [0|1] ""  External
 SG_ EYEQ_35_VD_CORRUPT_OUTPUTS_B10_1 : 129|1@1+ (1,0) [0|1] ""  External
 SG_ EYEQ_36_VD_OVERLAP_FAULT_B10_0 : 128|1@1+ (1,0) [0|1] ""  External
 SG_ EYEQ_37_VD_SANITY_FAULT_Bf_7 : 71|1@1+ (1,0) [0|1] ""  External
 SG_ EYEQ_52_VD_PREDICTION_VALI_Bf_6 : 126|1@1+ (1,0) [0|1] ""  External
 SG_ EYEQ_55_ROAD_LANEWIDTH_VALI_Be_5 : 63|1@1+ (1,0) [0|1] ""  External
 SG_ EYEQ_57_ROAD_HPP_MODEL_VALI_Be_4 : 116|1@1+ (1,0) [0|1] ""  External
 SG_ EYEQ_56_ROAD_PP_VALIDATION_Be_3 : 115|1@1+ (1,0) [0|1] ""  External
 SG_ EYEQ_38_PED_CORRUPT_OUTPUT_B7_3 : 59|1@1+ (1,0) [0|1] ""  External
 SG_ EYEQ_39_PED_OVERLAP_FAULT_B7_2 : 58|1@1+ (1,0) [0|1] ""  External
 SG_ EYEQ_40_PED_SANITY_FAULT_B7_1 : 57|1@1+ (1,0) [0|1] ""  External
 SG_ EYEQ_51_PED_PREDICT_VAL_B7_0 : 56|1@1+ (1,0) [0|1] ""  External
 SG_ AurixInternalMemoryFail_B4_6 : 38|1@1+ (1,0) [0|1] ""  External
 SG_ AurixInternalElectronicFail_B4_5 : 13|1@1+ (1,0) [0|1] ""  External
 SG_ Eyeq_Vision_Object_RFC_B3_3 : 27|1@1+ (1,0) [0|1] ""  External
 SG_ Eyeq_Vision_Object_CRC_B3_2 : 26|1@1+ (1,0) [0|1] ""  External
 SG_ RSDS_L2_Timeout_B25_6 : 302|1@1+ (1,0) [0|1] ""  External
 SG_ SAS1_Timeout_B24_5 : 293|1@1+ (1,0) [0|1] ""  External
 SG_ SAS1_SteerWheelSpd_Invalid_B32_5 : 405|1@1+ (1,0) [0|1] ""  External
 SG_ SAS1_SteerWheelAng_Invalid_B32_4 : 404|1@1+ (1,0) [0|1] ""  External
 SG_ SAS1_SAS_Sts_Error_B32_7 : 407|1@1+ (1,0) [0|1] ""  External
 SG_ RSDS_R2_Timeout_B26_7 : 311|1@1+ (1,0) [0|1] ""  External
 SG_ RSDS_R1_Timeout_B22_7 : 279|1@1+ (1,0) [0|1] ""  External
 SG_ HUT8_TSR_SnvtySet_Invalid_B30_3 : 387|1@1+ (1,0) [0|1] ""  External
 SG_ HUT8_IFC_SnvtySet_Abnormal_B2F_5 : 381|1@1+ (1,0) [0|1] ""  External
 SG_ HUT8_FCW_SnvtySet_Abnormal_B33_0 : 408|1@1+ (1,0) [0|1] ""  External
 SG_ HUT8_Timeout_B24_7 : 295|1@1+ (1,0) [0|1] ""  External
 SG_ HUT11_Timeout_B24_6 : 294|1@1+ (1,0) [0|1] ""  External
 SG_ HUT11_NavSpdLimValue_B28_6 : 326|1@1+ (1,0) [0|1] ""  External
 SG_ HUT11_NavSpdLimUnit_B28_7 : 327|1@1+ (1,0) [0|1] ""  External
 SG_ ECM9_ECM_ACCSwErr_Error_B32_6 : 406|1@1+ (1,0) [0|1] ""  External
 SG_ BCM8_WiperSwitchSts_Error_B30_6 : 390|1@1+ (1,0) [0|1] ""  External
 SG_ RSDS_R1_RiTarSts_Abnormal_B34_0 : 416|1@1+ (1,0) [0|1] ""  External
 SG_ ECM1_DrivingModeDis_G_B35_7 : 431|1@1+ (1,0) [0|1] ""  External
 SG_ SAS1_RollingCounter_B36_7 : 439|1@1+ (1,0) [0|1] ""  External
 SG_ RSDS_L2_RollingCounter_B39_1 : 457|1@1+ (1,0) [0|1] ""  External
 SG_ RSDS_R2_RollingCounter_B39_4 : 460|1@1+ (1,0) [0|1] ""  External
 SG_ SAS1_Checksum_B3A_7 : 471|1@1+ (1,0) [0|1] ""  External
 SG_ RSDS_L1_CheckSum_B3D_1 : 489|1@1+ (1,0) [0|1] ""  External
 SG_ RSDS_R1_CheckSum_B3D_7 : 495|1@1+ (1,0) [0|1] ""  External
 SG_ DCT2_TC_Slip_State_Error_B34_7 : 423|1@1+ (1,0) [0|1] ""  External
 SG_ EPS1_TrqSnsrSts_Abnormal_B31_7 : 399|1@1+ (1,0) [0|1] ""  External
 SG_ DCT3_RatAct_Error_B2e_7 : 375|1@1+ (1,0) [0|1] ""  External
 SG_ ECM2_EngState_Error_B2e_6 : 374|1@1+ (1,0) [0|1] ""  External
 SG_ APS4_Timeout_B26_6 : 310|1@1+ (1,0) [0|1] ""  External
 SG_ HAP_FD1_Timeout_B26_5 : 309|1@1+ (1,0) [0|1] ""  External
 SG_ DCT2_Timeout_B24_4 : 292|1@1+ (1,0) [0|1] ""  External
 SG_ SWP5_Missing_With_Default_B22_6 : 278|1@1+ (1,0) [0|1] ""  External
 SG_ SWP4_Missing_With_Default_B22_5 : 277|1@1+ (1,0) [0|1] ""  External
 SG_ SWP2_Missing_With_Default_B22_4 : 276|1@1+ (1,0) [0|1] ""  External
 SG_ SWP1_Missing_With_Default_B22_3 : 275|1@1+ (1,0) [0|1] ""  External
 SG_ Configure_DID_Missing_B20_0 : 256|1@1+ (1,0) [0|1] ""  External
 SG_ Sun_Rays_Fault_B11_7 : 143|1@1+ (1,0) [0|1] ""  External
 SG_ CAMERA_INTRINSIC_CAL_ERROR_Bf_4 : 124|1@1+ (1,0) [0|1] ""  External
 SG_ EYEQ_MINOR_ERROR_BM_EM_ERR__0002 : 174|1@1+ (1,0) [0|1] ""  External
 SG_ EYEQ_STATIC_CRC_FAULT_B6_1 : 49|1@1+ (1,0) [0|1] ""  External
 SG_ FEE_E_GC_READ_FAULT_B1_4 : 12|1@1+ (1,0) [0|1] ""  External
 SG_ EYEQ_GEN_34_Corrupted_Vehic_0002 : 121|1@1+ (1,0) [0|1] ""  External
 SG_ EYEQ_GEN_11_INPUT_CRC_MISMA_0002 : 120|1@1+ (1,0) [0|1] ""  External
 SG_ EYEQ_GEN_4_YAW_HORIZON_DEVI_0002 : 112|1@1+ (1,0) [0|1] ""  External
 SG_ EYEQ_GEN_18_IMAGER_DATA_ROW_0002 : 111|1@1+ (1,0) [0|1] ""  External
 SG_ EYEQ_GEN_13_OLD_EGODATA_LAT_Be_2 : 114|1@1+ (1,0) [0|1] ""  External
 SG_ AEB_shutdown_9_ROI_DIFF_VC__0002 : 107|1@1+ (1,0) [0|1] ""  External
 SG_ AEB_shutdown_7_POS_DIFF_KAL_0002 : 106|1@1+ (1,0) [0|1] ""  External
 SG_ EYEQ_GEN_50_VMP_SANITY_FAIL_0002 : 216|1@1+ (1,0) [0|1] ""  External
 SG_ EYEQ_FATAL_ERROR_APP_CPS_ST_0002 : 146|1@1+ (1,0) [0|1] ""  External
 SG_ EYEQ_GEN_24_CCFT_DIFF_RESUL_0002 : 227|1@1+ (1,0) [0|1] ""  External
 SG_ EYEQ_53_DECELERATION_DBS_OV_0002 : 226|1@1+ (1,0) [0|1] ""  External
 SG_ EYEQ_44_ROAD_SANITY_CORRECT_0002 : 225|1@1+ (1,0) [0|1] ""  External
 SG_ EYEQ_GEN_21_CAMERA_HEIGHT_L_0002 : 224|1@1+ (1,0) [0|1] ""  External
 SG_ EYEQ_FATAL_ERROR_APP_INVALI_0002 : 221|1@1+ (1,0) [0|1] ""  External
 SG_ EYEQ_45_ROAD_SFCONF_VALIDAT_0002 : 218|1@1+ (1,0) [0|1] ""  External
 SG_ EYEQ_48_ALGO_PITCH_MISMATCH_0002 : 217|1@1+ (1,0) [0|1] ""  External
 SG_ EyeQ_Minor_Error_Bm_Error_F_0002 : 160|1@1+ (1,0) [0|1] ""  External
 SG_ EyeQ_Fatal_Error_App_Init_F_0002 : 150|1@1+ (1,0) [0|1] ""  External
 SG_ EyeQ_Fatal_Error_App_Init_C_0002 : 151|1@1+ (1,0) [0|1] ""  External
 SG_ EyeQ_Fatal_Error_App_Fs_Err_0002 : 148|1@1+ (1,0) [0|1] ""  External
 SG_ EyeQ_Fatal_Error_App_Error__0002 : 147|1@1+ (1,0) [0|1] ""  External
 SG_ EyeQ_Fatal_Error_App_Calibr_0002 : 149|1@1+ (1,0) [0|1] ""  External
 SG_ EYEQ_33_ROAD_LANE_DISQUALIF_0002 : 220|1@1+ (1,0) [0|1] ""  External
 SG_ EYEQ_42_ROAD_PREDICTION_VAL_0002 : 219|1@1+ (1,0) [0|1] ""  External
 SG_ EYEQ_MES_49_Data_Path_Corru_0002 : 215|1@1+ (1,0) [0|1] ""  External
 SG_ EyeQ_Minor_Error_Bm_Em_Err__0035 : 172|1@1+ (1,0) [0|1] ""  External
 SG_ EyeQ_Minor_Error_Bm_Em_Erro_0002 : 161|1@1+ (1,0) [0|1] ""  External
 SG_ EyeQ_Minor_Error_Bm_Em_Err__0036 : 170|1@1+ (1,0) [0|1] ""  External
 SG_ EyeQ_Minor_Error_Bm_Em_Err__0037 : 171|1@1+ (1,0) [0|1] ""  External
 SG_ EyeQ_Minor_Error_Bm_Em_Err__0038 : 168|1@1+ (1,0) [0|1] ""  External
 SG_ EyeQ_Minor_Error_Bm_Em_Err__0039 : 162|1@1+ (1,0) [0|1] ""  External
 SG_ EyeQ_Minor_Error_Bm_Em_Err__0040 : 163|1@1+ (1,0) [0|1] ""  External
 SG_ EyeQ_Minor_Error_Bm_Em_Err__0041 : 164|1@1+ (1,0) [0|1] ""  External
 SG_ EyeQ_Minor_Error_Bm_Em_Err__0042 : 165|1@1+ (1,0) [0|1] ""  External
 SG_ EyeQ_Minor_Error_Bm_Em_Err__0043 : 169|1@1+ (1,0) [0|1] ""  External
 SG_ EyeQ_Minor_Error_Bm_Em_Err__0044 : 167|1@1+ (1,0) [0|1] ""  External
 SG_ EyeQ_Minor_Error_Bm_Em_Err__0045 : 166|1@1+ (1,0) [0|1] ""  External
 SG_ EyeQ_Minor_Error_Bm_Em_Err__0046 : 173|1@1+ (1,0) [0|1] ""  External
 SG_ EyeQ_Fatal_Error_Pv_Verific_0002 : 159|1@1+ (1,0) [0|1] ""  External
 SG_ EyeQ_Fatal_Error_Pv_General_0002 : 158|1@1+ (1,0) [0|1] ""  External
 SG_ EyeQ_Fatal_Error_Pll_Compar_0002 : 157|1@1+ (1,0) [0|1] ""  External
 SG_ EyeQ_Fatal_Error_App_Patter_0002 : 155|1@1+ (1,0) [0|1] ""  External
 SG_ Host_ENET_VersionMismatch_E_0002 : 68|1@1+ (1,0) [0|1] ""  External
 SG_ Host_ENET_Missing_Message_E_0002 : 65|1@1+ (1,0) [0|1] ""  External
 SG_ VISION_OUTOFCALIBRATION_B12_0 : 144|1@1+ (1,0) [0|1] ""  External
 SG_ VCU6_RollingCounter_B39_3 : 459|1@1+ (1,0) [0|1] ""  External
 SG_ VCU6_CheckSum_B3d_3 : 491|1@1+ (1,0) [0|1] ""  External
 SG_ VCU5_Timeout_B28_5 : 325|1@1+ (1,0) [0|1] ""  External
 SG_ VCU5_SysFltLvl_Error_B33_7 : 415|1@1+ (1,0) [0|1] ""  External
 SG_ VCU5_RollingCounter_B39_2 : 458|1@1+ (1,0) [0|1] ""  External
 SG_ VCU5_SysFltLvl_Reserved_B33_6 : 414|1@1+ (1,0) [0|1] ""  External
 SG_ VCU5_CheckSum_B3d_2 : 490|1@1+ (1,0) [0|1] ""  External
 SG_ VCU2_RollingCounter_B39_0 : 456|1@1+ (1,0) [0|1] ""  External
 SG_ VCU2_CheckSum_B3d_0 : 488|1@1+ (1,0) [0|1] ""  External
 SG_ VCU12_RollingCounter_B39_5 : 461|1@1+ (1,0) [0|1] ""  External
 SG_ VCU12_CheckSum_B3d_5 : 493|1@1+ (1,0) [0|1] ""  External
 SG_ VCU_FD4_Timeout_B28_4 : 324|1@1+ (1,0) [0|1] ""  External
 SG_ VCU_FD3_Timeout_B28_3 : 323|1@1+ (1,0) [0|1] ""  External
 SG_ VCU_FD3_GearSts_Invalid_B33_2 : 410|1@1+ (1,0) [0|1] ""  External
 SG_ VCU_FD2_VCU_ACCComIfNoResp_B33_5 : 413|1@1+ (1,0) [0|1] ""  External
 SG_ VCU_FD2_Timeout_B28_2 : 322|1@1+ (1,0) [0|1] ""  External
 SG_ VCU_FD2_MinNegAvlTq_B33_3 : 411|1@1+ (1,0) [0|1] ""  External
 SG_ VCU_FD2_MaxPosAvlTq_B33_4 : 412|1@1+ (1,0) [0|1] ""  External
 SG_ VCU_FD1_Timeout_B28_1 : 321|1@1+ (1,0) [0|1] ""  External
 SG_ VCU_FD1_BrkPedlSts_Error_B2d_5 : 365|1@1+ (1,0) [0|1] ""  External
 SG_ VCU_FD1_APedlPos_Invalid_B2d_7 : 367|1@1+ (1,0) [0|1] ""  External
 SG_ VCAN_Bus_Off_Fault_B21_3 : 267|1@1+ (1,0) [0|1] ""  External
 SG_ Variant_Coding_Mismatch_B21_0 : 264|1@1+ (1,0) [0|1] ""  External
 SG_ TD_Blockage_Test_12_1 : 145|1@1+ (1,0) [0|1] ""  External
 SG_ SWP5_Mismatch_B20_6 : 262|1@1+ (1,0) [0|1] ""  External
 SG_ SWP4_Mismatch_B20_5 : 261|1@1+ (1,0) [0|1] ""  External
 SG_ SWP2_Mismatch_B20_4 : 260|1@1+ (1,0) [0|1] ""  External
 SG_ SWP1_Mismatch_B20_3 : 259|1@1+ (1,0) [0|1] ""  External
 SG_ Splashes_Fault_10_7 : 135|1@1+ (1,0) [0|1] ""  External
 SG_ SelfGlare_Fault_11_5 : 141|1@1+ (1,0) [0|1] ""  External
 SG_ RSDS_R_5_RollingCounter_B36_2 : 434|1@1+ (1,0) [0|1] ""  External
 SG_ RSDS_R_5_Checksum_B3a_2 : 466|1@1+ (1,0) [0|1] ""  External
 SG_ RSDS_R_4_RollingCounter_B36_1 : 433|1@1+ (1,0) [0|1] ""  External
 SG_ RSDS_R_4_Checksum_B3a_1 : 465|1@1+ (1,0) [0|1] ""  External
 SG_ RSDS_R_3_RollingCounter_B36_0 : 432|1@1+ (1,0) [0|1] ""  External
 SG_ RSDS_R_3_Checksum_B3a_0 : 464|1@1+ (1,0) [0|1] ""  External
 SG_ RSDS_FD1_Timeout_B26_3 : 307|1@1+ (1,0) [0|1] ""  External
 SG_ RSDS_FD1_RiTarSts_Abnormal_B32_3 : 403|1@1+ (1,0) [0|1] ""  External
 SG_ RSDS_FD1_LeTarSts_Abnormal_B32_2 : 402|1@1+ (1,0) [0|1] ""  External
 SG_ Rain_Severity_Level_11_4 : 140|1@1+ (1,0) [0|1] ""  External
 SG_ R_PBox1_Timeout_B24_2 : 290|1@1+ (1,0) [0|1] ""  External
 SG_ Partial_Blockage_Fault_10_5 : 133|1@1+ (1,0) [0|1] ""  External
 SG_ PARAMETERS_INVALID_Bc_6 : 102|1@1+ (1,0) [0|1] ""  External
 SG_ Out_Of_Focus_Fault_B11_1 : 137|1@1+ (1,0) [0|1] ""  External
 SG_ NVM_E_REQ_FAILED_B0_7 : 7|1@1+ (1,0) [0|1] ""  External
 SG_ NVM_E_QUEUE_OVERFLOW_FAULT_0_4 : 4|1@1+ (1,0) [0|1] ""  External
 SG_ NVM_E_LOSS_OF_REDUNDANCY_B0_6 : 6|1@1+ (1,0) [0|1] ""  External
 SG_ NVM_E_INTEGRITY_FAILED_FAULT_0_5 : 5|1@1+ (1,0) [0|1] ""  External
 SG_ NBID_CRC_BOOT_REPORTED_B8_0 : 64|1@1+ (1,0) [0|1] ""  External
 SG_ MISSING_CAMERA_CALIBRATION_Bf_5 : 125|1@1+ (1,0) [0|1] ""  External
 SG_ MCU4_RollingCounter_B39_6 : 462|1@1+ (1,0) [0|1] ""  External
 SG_ MCU4_CheckSum_B3d_6 : 494|1@1+ (1,0) [0|1] ""  External
 SG_ MCU_FD1_Timeout_B28_0 : 320|1@1+ (1,0) [0|1] ""  External
 SG_ MCU_FD1_ActTrq_Invalid_B33_1 : 409|1@1+ (1,0) [0|1] ""  External
 SG_ Low_Visibility_Fault_11_6 : 142|1@1+ (1,0) [0|1] ""  External
 SG_ Low_Sun_Fault_11_0 : 136|1@1+ (1,0) [0|1] ""  External
 SG_ KAM_Design_Write_Fail_Fault_Bb_5 : 93|1@1+ (1,0) [0|1] ""  External
 SG_ KAM_Design_Read_Fail_Fault_Bb_4 : 92|1@1+ (1,0) [0|1] ""  External
 SG_ IP2_Timeout_Bb25_2 : 298|1@1+ (1,0) [0|1] ""  External
 SG_ IP2_IP_Error_Bb31_5 : 397|1@1+ (1,0) [0|1] ""  External
 SG_ IP2_ACC_Error_Bb31_6 : 398|1@1+ (1,0) [0|1] ""  External
 SG_ Host_ENET_MessageReception__0002 : 67|1@1+ (1,0) [0|1] ""  External
 SG_ IFC_FD1_0x12B_Mute_B22_1 : 273|1@1+ (1,0) [0|1] ""  External
 SG_ HUT_FD1_TSR_SnvtySet_B30_2 : 386|1@1+ (1,0) [0|1] ""  External
 SG_ HUT_FD1_Timeout_B26_2 : 306|1@1+ (1,0) [0|1] ""  External
 SG_ HUT_FD1_NavSpdLimValue_B30_4 : 388|1@1+ (1,0) [0|1] ""  External
 SG_ HUT_FD1_NavSpdLimUnit_B30_5 : 389|1@1+ (1,0) [0|1] ""  External
 SG_ HUT_FD1_LSSWarnFormSwtReq_B30_1 : 385|1@1+ (1,0) [0|1] ""  External
 SG_ HUT_FD1_IFC_SnvtySet_Abnor_B30_0 : 384|1@1+ (1,0) [0|1] ""  External
 SG_ HUT_FD1_FCW_SnvtySet_Abnor_B30_7 : 391|1@1+ (1,0) [0|1] ""  External
 SG_ HOST_HEATER_PWR_AURIX_B7_6 : 62|1@1+ (1,0) [0|1] ""  External
 SG_ Host_ENET_Missing_Data_Err_B8_2 : 66|1@1+ (1,0) [0|1] ""  External
 SG_ Host_Callibration_CRC_Fault_B8_6 : 70|1@1+ (1,0) [0|1] ""  External
 SG_ GRAB_VIDEO_TIMEOUT_B4_7 : 39|1@1+ (1,0) [0|1] ""  External
 SG_ Full_Blockage_Fault_10_4 : 132|1@1+ (1,0) [0|1] ""  External
 SG_ Frozen_Windshield_Fault_11_3 : 139|1@1+ (1,0) [0|1] ""  External
 SG_ Foggy_Spots_Fault_11_2 : 138|1@1+ (1,0) [0|1] ""  External
 SG_ FET_Fault_Across_cycles_B2_4 : 20|1@1+ (1,0) [0|1] ""  External
 SG_ FET_Fail_Across_Cycles_B2_5 : 21|1@1+ (1,0) [0|1] ""  External
 SG_ FEE_E_WRITE_FAULT_B1_1 : 9|1@1+ (1,0) [0|1] ""  External
 SG_ FEE_E_WRITE_CYCLES_EXHAUST_B2_0 : 16|1@1+ (1,0) [0|1] ""  External
 SG_ FEE_E_UNCONFIG_BLK_EXCEED_B2_2 : 18|1@1+ (1,0) [0|1] ""  External
 SG_ FEE_E_READ_FAULT_B1_2 : 10|1@1+ (1,0) [0|1] ""  External
 SG_ FEE_E_INVALIDATE_FAULT_B1_7 : 15|1@1+ (1,0) [0|1] ""  External
 SG_ FEE_E_GC_WRITE_FAULT_B1_3 : 11|1@1+ (1,0) [0|1] ""  External
 SG_ FEE_E_GC_TRIG_FAULT_B2_1 : 17|1@1+ (1,0) [0|1] ""  External
 SG_ FEE_E_GC_INIT_FAULT_B1_0 : 8|1@1+ (1,0) [0|1] ""  External
 SG_ FEE_E_GC_ERASE_FAULT_B1_6 : 14|1@1+ (1,0) [0|1] ""  External
 SG_ FactoryMode_B20_7 : 263|1@1+ (1,0) [0|1] ""  External
 SG_ F_PBox1_Timeout_B24_3 : 291|1@1+ (1,0) [0|1] ""  External
 SG_ EYQQ_ROAD_INFO_COUNTER_ERROR_2_6 : 22|1@1+ (1,0) [0|1] ""  External
 SG_ EYEQ_VISION_SAFETY_DIAG_RFC_B5_3 : 43|1@1+ (1,0) [0|1] ""  External
 SG_ EYEQ_VISION_SAFETY_DIAG_CRC_B5_2 : 42|1@1+ (1,0) [0|1] ""  External
 SG_ EYEQ_VISION_AEB_INFO_RFC_B5_1 : 41|1@1+ (1,0) [0|1] ""  External
 SG_ EYEQ_VISION_AEB_INFO_CRC_B5_0 : 40|1@1+ (1,0) [0|1] ""  External
 SG_ EYEQ_VIS_OBSTACLES_INFO_RFC_B5_6 : 46|1@1+ (1,0) [0|1] ""  External
 SG_ EYEQ_VIS_OBSTACLES_INFO_CRC_B5_5 : 45|1@1+ (1,0) [0|1] ""  External
 SG_ EYEQ_VIS_FAILSAFESRFCFAULT_B6_4 : 52|1@1+ (1,0) [0|1] ""  External
 SG_ EYEQ_VIS_FAILSAFESCRCFAULT_B6_3 : 51|1@1+ (1,0) [0|1] ""  External
 SG_ EYEQ_STATIC_RFC_FAULT_B6_2 : 50|1@1+ (1,0) [0|1] ""  External
 SG_ EYEQ_DYNAMIC_RFC_FAULT_B6_0 : 48|1@1+ (1,0) [0|1] ""  External
 SG_ EYEQ_DYNAMIC_CRC_FAULT_B5_7 : 47|1@1+ (1,0) [0|1] ""  External
 SG_ EYEQ_ROAD_INFO_CRC_FAULT_B5_4 : 44|1@1+ (1,0) [0|1] ""  External
 SG_ EYEQ_OTA_SWAP_FAULT_B7_5 : 61|1@1+ (1,0) [0|1] ""  External
 SG_ EyeQ_MESP_Coding_failure_B9_1 : 73|1@1+ (1,0) [0|1] ""  External
 SG_ EYEQ_GEN_CR_ERR_FAULT_B2_3 : 19|1@1+ (1,0) [0|1] ""  External
 SG_ EYEQ_GEN_31_AEB_PARAM_FFI_Be_6 : 118|1@1+ (1,0) [0|1] ""  External
 SG_ EYEQ_GEN_29_RFC_ERR_Be_7 : 119|1@1+ (1,0) [0|1] ""  External
 SG_ EyeQ_DDR_RAM_CRC_Bb_7 : 95|1@1+ (1,0) [0|1] ""  External
 SG_ ESP2_VehStandstill_Invalid_B2c_2 : 354|1@1+ (1,0) [0|1] ""  External
 SG_ ESP2_Timeout_B27_4 : 316|1@1+ (1,0) [0|1] ""  External
 SG_ ESP2_RollingCounter_B37_4 : 444|1@1+ (1,0) [0|1] ""  External
 SG_ ESP2_HDCCtrl_Abnormal_B35_5 : 429|1@1+ (1,0) [0|1] ""  External
 SG_ ESP2_DrivingModDis_Abnor_B35_6 : 430|1@1+ (1,0) [0|1] ""  External
 SG_ ESP2_CheckSum_B3b_4 : 476|1@1+ (1,0) [0|1] ""  External
 SG_ ESP2_CDDAvailable_Error_B2c_0 : 352|1@1+ (1,0) [0|1] ""  External
 SG_ ESP2_AWBAvailable_Error_B2d_2 : 362|1@1+ (1,0) [0|1] ""  External
 SG_ ESP2_AEBAvailable_Error_B2c_4 : 356|1@1+ (1,0) [0|1] ""  External
 SG_ ESP2_ABPAvailable_Error_B2c_6 : 358|1@1+ (1,0) [0|1] ""  External
 SG_ ESP2_ABAavailable_Error_B2d_0 : 360|1@1+ (1,0) [0|1] ""  External
 SG_ ESP1_Timeout_B27_3 : 315|1@1+ (1,0) [0|1] ""  External
 SG_ ESP1_RollingCounter_B37_3 : 443|1@1+ (1,0) [0|1] ""  External
 SG_ ESP1_MasterCylBrkPress_B2b_0 : 344|1@1+ (1,0) [0|1] ""  External
 SG_ ESP1_ESPFailSts_Failure_B2b_6 : 350|1@1+ (1,0) [0|1] ""  External
 SG_ ESP1_CheckSum_B3b_3 : 475|1@1+ (1,0) [0|1] ""  External
 SG_ ESP_FD3_Timeout_B27_7 : 319|1@1+ (1,0) [0|1] ""  External
 SG_ ESP_FD3_SwtPosn_Invalid_B2e_1 : 369|1@1+ (1,0) [0|1] ""  External
 SG_ ESP_FD3_RRWheelSpd_Invalid_B2a_7 : 343|1@1+ (1,0) [0|1] ""  External
 SG_ ESP_FD3_RRWhDriveDirection_B29_3 : 331|1@1+ (1,0) [0|1] ""  External
 SG_ ESP_FD3_RLWheelSpd_Invalid_B2a_5 : 341|1@1+ (1,0) [0|1] ""  External
 SG_ ESP_FD3_RLWhDriveDirection_B29_1 : 329|1@1+ (1,0) [0|1] ""  External
 SG_ ESP_FD3_FRWheelSpd_Invalid_B2a_3 : 339|1@1+ (1,0) [0|1] ""  External
 SG_ ESP_FD3_FRWhDriveDirection_B29_7 : 335|1@1+ (1,0) [0|1] ""  External
 SG_ ESP_FD3_FLWheelSpd_Invalid_B2a_1 : 337|1@1+ (1,0) [0|1] ""  External
 SG_ ESP_FD3_FLWhDriveDirection_B29_5 : 333|1@1+ (1,0) [0|1] ""  External
 SG_ ESP_FD3_EPBSts_Error_B2e_5 : 373|1@1+ (1,0) [0|1] ""  External
 SG_ ESP_FD3_EPBErrSts_Error_B2e_3 : 371|1@1+ (1,0) [0|1] ""  External
 SG_ ESP_FD3_EPB1_RollCounter_B38_2 : 450|1@1+ (1,0) [0|1] ""  External
 SG_ ESP_FD3_EPB1_CheckSum_B3c_2 : 482|1@1+ (1,0) [0|1] ""  External
 SG_ ESP_FD3_ABS2_RollCounter_B38_4 : 452|1@1+ (1,0) [0|1] ""  External
 SG_ ESP_FD3_ABS2_CheckSum_B3c_4 : 484|1@1+ (1,0) [0|1] ""  External
 SG_ ESP_FD3_ABS1_RollCounter_B38_3 : 451|1@1+ (1,0) [0|1] ""  External
 SG_ ESP_FD3_ABS1_CheckSum_B3c_3 : 483|1@1+ (1,0) [0|1] ""  External
 SG_ ESP_FD2_VehStandstill_B2c_3 : 355|1@1+ (1,0) [0|1] ""  External
 SG_ ESP_FD2_VehSpd_Missing_B21_5 : 269|1@1+ (1,0) [0|1] ""  External
 SG_ ESP_FD2_VehSpd_Invalid_B2b_5 : 349|1@1+ (1,0) [0|1] ""  External
 SG_ ESP_FD2_Timeout_B27_6 : 318|1@1+ (1,0) [0|1] ""  External
 SG_ ESP_FD2_MasterCylBrkPress_B2b_1 : 345|1@1+ (1,0) [0|1] ""  External
 SG_ ESP_FD2_ESPFailSts_Failure_B2b_7 : 351|1@1+ (1,0) [0|1] ""  External
 SG_ ESP_FD2_ESP2_RollCounter_B38_7 : 455|1@1+ (1,0) [0|1] ""  External
 SG_ ESP_FD2_ESP2_CheckSum_B3c_7 : 487|1@1+ (1,0) [0|1] ""  External
 SG_ ESP_FD2_ESP1_RollCounter_B38_6 : 454|1@1+ (1,0) [0|1] ""  External
 SG_ ESP_FD2_ESP1_CheckSum_B3c_6 : 486|1@1+ (1,0) [0|1] ""  External
 SG_ ESP_FD2_CDDAvailable_Error_B2c_1 : 353|1@1+ (1,0) [0|1] ""  External
 SG_ ESP_FD2_AWBAvailable_Error_B2d_3 : 363|1@1+ (1,0) [0|1] ""  External
 SG_ ESP_FD2_AEBAvailable_Error_B2c_5 : 357|1@1+ (1,0) [0|1] ""  External
 SG_ ESP_FD2_ABSFailSts_Failure_B2b_3 : 347|1@1+ (1,0) [0|1] ""  External
 SG_ ESP_FD2_ABS3_RollCounter_B38_5 : 453|1@1+ (1,0) [0|1] ""  External
 SG_ ESP_FD2_ABS3_CheckSum_B3c_5 : 485|1@1+ (1,0) [0|1] ""  External
 SG_ ESP_FD2_ABPAvailable_Error_B2c_7 : 359|1@1+ (1,0) [0|1] ""  External
 SG_ ESP_FD2_ABAavailable_Error_B2d_1 : 361|1@1+ (1,0) [0|1] ""  External
 SG_ EPS2_Timeout_B26_1 : 305|1@1+ (1,0) [0|1] ""  External
 SG_ EPS2_RollingCounter_B36_6 : 438|1@1+ (1,0) [0|1] ""  External
 SG_ EPS2_LKATrqOvlDlvdSts_Temp_B2f_6 : 382|1@1+ (1,0) [0|1] ""  External
 SG_ EPS2_LKATrqOvlDlvdSts_Perm_B2f_7 : 383|1@1+ (1,0) [0|1] ""  External
 SG_ EPS2_CheckSum_B3a_6 : 470|1@1+ (1,0) [0|1] ""  External
 SG_ EPS1_Timeout_B26_0 : 304|1@1+ (1,0) [0|1] ""  External
 SG_ EPS1_SteerMod_Abnormal_B32_1 : 401|1@1+ (1,0) [0|1] ""  External
 SG_ EPS1_EPSFailSts_Failure_B32_0 : 400|1@1+ (1,0) [0|1] ""  External
 SG_ EPB1_Timeout_B27_5 : 317|1@1+ (1,0) [0|1] ""  External
 SG_ EPB1_SwtPosn_Invalid_B2e_0 : 368|1@1+ (1,0) [0|1] ""  External
 SG_ EPB1_RollingCounter_B37_5 : 445|1@1+ (1,0) [0|1] ""  External
 SG_ EPB1_EPBSts_Error_B2e_4 : 372|1@1+ (1,0) [0|1] ""  External
 SG_ EPB1_EPBErrSts_Error_B2e_2 : 370|1@1+ (1,0) [0|1] ""  External
 SG_ EPB1_CheckSum_B3b_5 : 477|1@1+ (1,0) [0|1] ""  External
 SG_ ECM9_Timeout_B23_6 : 286|1@1+ (1,0) [0|1] ""  External
 SG_ ECM9_RollingCounter_B38_1 : 449|1@1+ (1,0) [0|1] ""  External
 SG_ ECM9_ECMACCInterface_Error_B34_6 : 422|1@1+ (1,0) [0|1] ""  External
 SG_ ECM9_Checksum_B3c_1 : 481|1@1+ (1,0) [0|1] ""  External
 SG_ ECM8_TrqLoss_Invalid_B34_5 : 421|1@1+ (1,0) [0|1] ""  External
 SG_ ECM8_Timeout_B23_5 : 285|1@1+ (1,0) [0|1] ""  External
 SG_ ECM7_Timeout_B23_4 : 284|1@1+ (1,0) [0|1] ""  External
 SG_ ECM4_Timeout_B23_3 : 283|1@1+ (1,0) [0|1] ""  External
 SG_ ECM4_RollingCounter_B38_0 : 448|1@1+ (1,0) [0|1] ""  External
 SG_ ECM4_NetEngTrq_Invalid_B34_3 : 419|1@1+ (1,0) [0|1] ""  External
 SG_ ECM4_DrvEngTrqReq_Invalid_B34_4 : 420|1@1+ (1,0) [0|1] ""  External
 SG_ ECM4_Checksum_B3c_0 : 480|1@1+ (1,0) [0|1] ""  External
 SG_ ECM3_Timeout_B23_2 : 282|1@1+ (1,0) [0|1] ""  External
 SG_ ECM3_MaxEngTrqNorm_Abnorm_B34_2 : 418|1@1+ (1,0) [0|1] ""  External
 SG_ ECM2_Timeout_B23_1 : 281|1@1+ (1,0) [0|1] ""  External
 SG_ ECM2_AccelPedalPosn_Invd_B2d_6 : 366|1@1+ (1,0) [0|1] ""  External
 SG_ ECM1_Timeout_B23_0 : 280|1@1+ (1,0) [0|1] ""  External
 SG_ ECM1_Start_StopSts_Invalid_B34_1 : 417|1@1+ (1,0) [0|1] ""  External
 SG_ ECM1_RollingCounter_B37_7 : 447|1@1+ (1,0) [0|1] ""  External
 SG_ ECM1_Checksum_B3b_7 : 479|1@1+ (1,0) [0|1] ""  External
 SG_ ECM1_BrkPedalSts_Error_B2d_4 : 364|1@1+ (1,0) [0|1] ""  External
 SG_ DCT7_Timeout_B24_1 : 289|1@1+ (1,0) [0|1] ""  External
 SG_ DCT7_DrvFaiMsg_Failure_B35_4 : 428|1@1+ (1,0) [0|1] ""  External
 SG_ DCT5_Timeout_B24_0 : 288|1@1+ (1,0) [0|1] ""  External
 SG_ DCT5_TGS_LEVER_Invalid_B35_3 : 427|1@1+ (1,0) [0|1] ""  External
 SG_ DCT5_TARGET_GEAR_Invalid_B35_2 : 426|1@1+ (1,0) [0|1] ""  External
 SG_ DCT5_ShiftInPrg_Invalid_B35_1 : 425|1@1+ (1,0) [0|1] ""  External
 SG_ DCT5_RollingCounter_B37_6 : 446|1@1+ (1,0) [0|1] ""  External
 SG_ DCT5_CurrentGear_Invalid_B35_0 : 424|1@1+ (1,0) [0|1] ""  External
 SG_ DCT5_CheckSum_B3b_6 : 478|1@1+ (1,0) [0|1] ""  External
 SG_ DCT3_Timeout_B23_7 : 287|1@1+ (1,0) [0|1] ""  External
 SG_ CSA2_Timeout_B25_4 : 300|1@1+ (1,0) [0|1] ""  External
 SG_ CSA2_SteerWheelSpd_Invalid_B31_2 : 394|1@1+ (1,0) [0|1] ""  External
 SG_ CSA2_SteerWheelAng_Invalid_B31_1 : 393|1@1+ (1,0) [0|1] ""  External
 SG_ CSA2_SAS_Sts_Error_B31_4 : 396|1@1+ (1,0) [0|1] ""  External
 SG_ CSA2_Rollingcounter_B36_5 : 437|1@1+ (1,0) [0|1] ""  External
 SG_ CSA2_Checksum_B3a_5 : 469|1@1+ (1,0) [0|1] ""  External
 SG_ CSA2_CC_ACCSwt_Error_B31_3 : 395|1@1+ (1,0) [0|1] ""  External
 SG_ CSA1_Timeout_B25_3 : 299|1@1+ (1,0) [0|1] ""  External
 SG_ CSA1_FrntWiprSwtSts_Error_B31_0 : 392|1@1+ (1,0) [0|1] ""  External
 SG_ Blurred_Image_Fault_B10_6 : 134|1@1+ (1,0) [0|1] ""  External
 SG_ BCM8_WiprReq_Invalid_B2f_4 : 380|1@1+ (1,0) [0|1] ""  External
 SG_ BCM8_Timeout_B25_7 : 303|1@1+ (1,0) [0|1] ""  External
 SG_ BCM1_Timeout_B25_5 : 301|1@1+ (1,0) [0|1] ""  External
 SG_ AEB_shutdown_Invalid_Reason_Bd_1 : 105|1@1+ (1,0) [0|1] ""  External
 SG_ AEB_shutdown_4_DT_ERR_Bd_6 : 110|1@1+ (1,0) [0|1] ""  External
 SG_ AEB_shutdown_6_FCV_FCW_TTC_Bd_4 : 108|1@1+ (1,0) [0|1] ""  External
 SG_ AEB_shutdown_27_FcvSigFfi_Bf_2 : 122|1@1+ (1,0) [0|1] ""  External
 SG_ AEB_shutdown_25_CO_FOF_DIFF_Bd_5 : 109|1@1+ (1,0) [0|1] ""  External
 SG_ AEB_Safety_Violation_B21_7 : 271|1@1+ (1,0) [0|1] ""  External
 SG_ ACC_Safety_Violation_B22_0 : 272|1@1+ (1,0) [0|1] ""  External
 SG_ AC2_Timeout_B26_4 : 308|1@1+ (1,0) [0|1] ""  External
 SG_ AC2_ACAmbTemp_Invalid_B2f_3 : 379|1@1+ (1,0) [0|1] ""  External
 SG_ ABS3_VehSpd_Missing_B21_4 : 268|1@1+ (1,0) [0|1] ""  External
 SG_ ABS3_VehSpd_Invalid_B2b_4 : 348|1@1+ (1,0) [0|1] ""  External
 SG_ ABS3_ABSFailSts_Failure_B2b_2 : 346|1@1+ (1,0) [0|1] ""  External
 SG_ ABS2_RRWheelSpd_Invalid_B2a_6 : 342|1@1+ (1,0) [0|1] ""  External
 SG_ ABS2_RRWhDirection_Invalid_B29_2 : 330|1@1+ (1,0) [0|1] ""  External
 SG_ ABS2_RLWheelSpd_Invalid_B2a_4 : 340|1@1+ (1,0) [0|1] ""  External
 SG_ ABS2_RLWhDirection_Invalid_B29_0 : 328|1@1+ (1,0) [0|1] ""  External
 SG_ ABS1_FRWheelSpd_Invalid_B2a_2 : 338|1@1+ (1,0) [0|1] ""  External
 SG_ ABS1_FRWhDirection_Invalid_B29_6 : 334|1@1+ (1,0) [0|1] ""  External
 SG_ ABS1_FLWheelSpd_Invalid_B2a_0 : 336|1@1+ (1,0) [0|1] ""  External
 SG_ ABS1_FLWhDirection_Invalid_B29_4 : 332|1@1+ (1,0) [0|1] ""  External
 SG_ ABS3_Timeout_B27_2 : 314|1@1+ (1,0) [0|1] ""  External
 SG_ ABS2_Timeout_B27_1 : 313|1@1+ (1,0) [0|1] ""  External
 SG_ ABS3_RollingCounter_B37_2 : 442|1@1+ (1,0) [0|1] ""  External
 SG_ ABS2_RollingCounter_B37_1 : 441|1@1+ (1,0) [0|1] ""  External
 SG_ ABS3_CheckSum_B3b_2 : 474|1@1+ (1,0) [0|1] ""  External
 SG_ ABS2_CheckSum_B3b_1 : 473|1@1+ (1,0) [0|1] ""  External
 SG_ ABS1_Timeout_B27_0 : 312|1@1+ (1,0) [0|1] ""  External
 SG_ ABS1_RollingCounter_B37_0 : 440|1@1+ (1,0) [0|1] ""  External
 SG_ ABS1_CheckSum_B3b_0 : 472|1@1+ (1,0) [0|1] ""  External
 SG_ ABM2_VehYawRate_Missing_B21_6 : 270|1@1+ (1,0) [0|1] ""  External
 SG_ ABM2_VehYawRate_Invalid_B2f_0 : 376|1@1+ (1,0) [0|1] ""  External
 SG_ ABM2_VehLgtAccel_Invalid_B2f_1 : 377|1@1+ (1,0) [0|1] ""  External
 SG_ ABM2_VehLatAccel_Invalid_B2f_2 : 378|1@1+ (1,0) [0|1] ""  External
 SG_ ABM2_Timeout_B25_1 : 297|1@1+ (1,0) [0|1] ""  External
 SG_ ABM2_RollingCounter_B36_4 : 436|1@1+ (1,0) [0|1] ""  External
 SG_ ABM2_CheckSum_B3a_4 : 468|1@1+ (1,0) [0|1] ""  External
 SG_ ABM1_Timeout_B25_0 : 296|1@1+ (1,0) [0|1] ""  External
 SG_ ABM1_RollingCounter_B36_3 : 435|1@1+ (1,0) [0|1] ""  External
 SG_ ABM1_CheckSum_B3a_3 : 467|1@1+ (1,0) [0|1] ""  External
 SG_ Vision_Internal_Error_B1f_6 : 254|1@1+ (1,0) [0|1] ""  External
 SG_ EyeQ_Spi_Msg_Timeout_A_7 : 87|1@1+ (1,0) [0|1] ""  External
 SG_ Host_Spi_CRC_Error_A_2 : 82|1@1+ (1,0) [0|1] ""  External
 SG_ Host_Spi_Tx_Error_A_1 : 81|1@1+ (1,0) [0|1] ""  External
 SG_ Host_spi_msg_timeout_A_0 : 80|1@1+ (1,0) [0|1] ""  External
 SG_ EyeQ_Calibration_Checksum_9_4 : 76|1@1+ (1,0) [0|1] ""  External
 SG_ Imager_2V8_Supply_OutRange_6_7 : 55|1@1+ (1,0) [0|1] ""  External
 SG_ Aurix_1V25_Supply_OutRange_B6_6 : 54|1@1+ (1,0) [0|1] ""  External
 SG_ Imager_1V2_Supply_OutRange_6_5 : 53|1@1+ (1,0) [0|1] ""  External
 SG_ Battery_High_Fault_B21_2 : 266|1@1+ (1,0) [0|1] ""  External
 SG_ Battery_Low_Fault_B21_1 : 265|1@1+ (1,0) [0|1] ""  External
 SG_ PS_5V0_Out_Of_Range_4_4 : 36|1@1+ (1,0) [0|1] ""  External
 SG_ EyeQDDROnBrdThermstorOutRang_4_3 : 35|1@1+ (1,0) [0|1] ""  External
 SG_ EyeQDDROnBrdThermstorOveTemp_4_1 : 33|1@1+ (1,0) [0|1] ""  External
 SG_ EyeQ_Temp_Exceeded_3_0 : 24|1@1+ (1,0) [0|1] ""  External
 SG_ SYSTEM_OVER_TEMPERATURE_2_7 : 23|1@1+ (1,0) [0|1] ""  External
 SG_ EyeQ_Error_Out_Temp_Fault_1A_6 : 214|1@1+ (1,0) [0|1] ""  External
 SG_ EyeQErrOutSignalInternFault_1A_5 : 213|1@1+ (1,0) [0|1] ""  External
 SG_ EyeQ_Camera1_Temp_Fault_1A_4 : 212|1@1+ (1,0) [0|1] ""  External
 SG_ EyeQVdoErrFlg_ShotOutOfSync_1A_3 : 211|1@1+ (1,0) [0|1] ""  External
 SG_ EyeQVdoErrFlg_VdiErrShutdwn_1A_2 : 210|1@1+ (1,0) [0|1] ""  External
 SG_ EyeQVdoErrFlg_HdrVerifiErr_1A_1 : 209|1@1+ (1,0) [0|1] ""  External
 SG_ EyeQVdoErrFlg_CcftDecisionMismat : 208|1@1+ (1,0) [0|1] ""  External
 SG_ EyeQVdoErrFlg_HistogramsMismatch : 207|1@1+ (1,0) [0|1] ""  External
 SG_ EyeQVdoErrFlg_FrameCountReadFail : 206|1@1+ (1,0) [0|1] ""  External
 SG_ EyeQVdoErrFlgVdiErr_CoreIdFlt : 205|1@1+ (1,0) [0|1] ""  External
 SG_ EyeQVdoErrFlgVdiErr_StrtAftStrt : 204|1@1+ (1,0) [0|1] ""  External
 SG_ EyeQVdoErrFlgVdiErr_ParityHisFlt : 203|1@1+ (1,0) [0|1] ""  External
 SG_ EyeQVdoErrFlgVdiErr_ParityGamma : 202|1@1+ (1,0) [0|1] ""  External
 SG_ EyeQVdoErrFlgVdiErr_ParityWeight : 201|1@1+ (1,0) [0|1] ""  External
 SG_ EyeQVdoErrFlgVdiErr_ParityFifo : 200|1@1+ (1,0) [0|1] ""  External
 SG_ EyeQVdoErrFlgVdiErrFifo_Undflow : 199|1@1+ (1,0) [0|1] ""  External
 SG_ EyeQVdoErrFlgVdiErrFifo_Overflow : 198|1@1+ (1,0) [0|1] ""  External
 SG_ EyeQVdoErrFlgVdiErr_Timeout_18_5 : 197|1@1+ (1,0) [0|1] ""  External
 SG_ EyeQVdoErrFlgVdiErr_BuffInvldFmt : 196|1@1+ (1,0) [0|1] ""  External
 SG_ EyeQVdoErrFlg_Vdi_ErrNoBuff_18_3 : 195|1@1+ (1,0) [0|1] ""  External
 SG_ EyeQVdoErrFlgVdi_InternErr18_2 : 194|1@1+ (1,0) [0|1] ""  External
 SG_ EyeQVdoErrFlgSumNotMatHistgrmErr : 193|1@1+ (1,0) [0|1] ""  External
 SG_ EyeQVdoErrFlgZeroHistgrmErr_18_0 : 192|1@1+ (1,0) [0|1] ""  External
 SG_ EyeQVdoErrFlgRegWrtHilFailErr : 191|1@1+ (1,0) [0|1] ""  External
 SG_ EyeQVdoErrFlgErrRegFlagFlt_17_6 : 190|1@1+ (1,0) [0|1] ""  External
 SG_ EyeQVdoErrFlgInvldVdoHeaderFault : 189|1@1+ (1,0) [0|1] ""  External
 SG_ EyeQVdoErrFlgVerifiFailVdoErr : 188|1@1+ (1,0) [0|1] ""  External
 SG_ EyeQVdoErrFlgInconstFramVdoErr : 187|1@1+ (1,0) [0|1] ""  External
 SG_ EyeQ_Cam1VdoErrFlgLgcVdoErr_17_2 : 186|1@1+ (1,0) [0|1] ""  External
 SG_ EyeQCam1VdoErrFlgI2CNoOnTmVdoErr : 185|1@1+ (1,0) [0|1] ""  External
 SG_ EyeQCam1VdoErrFlgVdiVdoErr_17_0 : 184|1@1+ (1,0) [0|1] ""  External
 SG_ EyeQ_Cam_Vdo_Flt_16_7 : 183|1@1+ (1,0) [0|1] ""  External
 SG_ EyeQ_Cam_Ctrl_Flt_16_6 : 182|1@1+ (1,0) [0|1] ""  External
 SG_ EyeQ_Cam_Mal_Func_16_5 : 181|1@1+ (1,0) [0|1] ""  External
 SG_ Grab_Release_Failure_16_4 : 180|1@1+ (1,0) [0|1] ""  External
 SG_ Grab_Acquire_Failure_16_3 : 179|1@1+ (1,0) [0|1] ""  External
 SG_ Grab_Issue_Failure_16_2 : 178|1@1+ (1,0) [0|1] ""  External
 SG_ Grab_No_Free_Header_Failure_16_1 : 177|1@1+ (1,0) [0|1] ""  External
 SG_ Init_I2C_Failure_16_0 : 176|1@1+ (1,0) [0|1] ""  External
 SG_ Init_Vdi_Failure_15_7 : 175|1@1+ (1,0) [0|1] ""  External
 SG_ EyeQFatalErrApCamParaCcftCrc13_4 : 156|1@1+ (1,0) [0|1] ""  External
 SG_ EyeQFatalErrAppI2CTimoutErr_13_2 : 154|1@1+ (1,0) [0|1] ""  External
 SG_ EyeQFatalErrAppI2CCamSlfRst_13_1 : 153|1@1+ (1,0) [0|1] ""  External
 SG_ EyeQFatalErrAppI2CVidoGrb_13_0 : 152|1@1+ (1,0) [0|1] ""  External
 SG_ EYEQ_GEN54ACCSTLEXECUTFAILED_F_3 : 123|1@1+ (1,0) [0|1] ""  External
 SG_ EYEQ_GEN_26_CODE_CRC_E_1 : 113|1@1+ (1,0) [0|1] ""  External
 SG_ EyeQ_Core_Dump_Fault_C_5 : 101|1@1+ (1,0) [0|1] ""  External
 SG_ EyeQ_Init_Timeout_Fault_C_4 : 100|1@1+ (1,0) [0|1] ""  External
 SG_ EYEQ4_Mode_Fault_C_3 : 99|1@1+ (1,0) [0|1] ""  External
 SG_ EyeQ_Bist_Memory_Fault_C_2 : 98|1@1+ (1,0) [0|1] ""  External
 SG_ EyeQ_Core_Fault_C_1 : 97|1@1+ (1,0) [0|1] ""  External
 SG_ EyeQ_Boot_Fault_C_0 : 96|1@1+ (1,0) [0|1] ""  External
 SG_ EyeQ_DDR_Fault_B_6 : 94|1@1+ (1,0) [0|1] ""  External
 SG_ EyeQ_SerialFlashPowerUp_Fail_B_1 : 89|1@1+ (1,0) [0|1] ""  External
 SG_ EyeQ_SPI_CRC_ERROR_B_0 : 88|1@1+ (1,0) [0|1] ""  External
 SG_ EYEQ_Spi_Msg_Format_Error_A_6 : 86|1@1+ (1,0) [0|1] ""  External
 SG_ EyeQ_Spi_Frame_Format_Error_A_5 : 85|1@1+ (1,0) [0|1] ""  External
 SG_ Spi_Ipc_Comm_Reset_A_4 : 84|1@1+ (1,0) [0|1] ""  External
 SG_ Spi_version_mismatch_A_3 : 83|1@1+ (1,0) [0|1] ""  External
 SG_ Host_Spi_Msg_Format_Error_9_7 : 79|1@1+ (1,0) [0|1] ""  External
 SG_ Host_Spi_Frame_Format_Error_9_6 : 78|1@1+ (1,0) [0|1] ""  External
 SG_ EyeQ_Application_Checksum_9_3 : 75|1@1+ (1,0) [0|1] ""  External
 SG_ EyeQAppl_CompltAndComptibl_9_2 : 74|1@1+ (1,0) [0|1] ""  External
 SG_ EyeQOnBoardThermstorOutRange_4_2 : 34|1@1+ (1,0) [0|1] ""  External
 SG_ EyeQ_DDR_Over_Temp_4_0 : 32|1@1+ (1,0) [0|1] ""  External
 SG_ EyeQ_Boot_OverTemp_Fault_3_7 : 31|1@1+ (1,0) [0|1] ""  External
 SG_ EyeQ_Imager_Over_Temp_3_6 : 30|1@1+ (1,0) [0|1] ""  External
 SG_ EyeQ_VMP_Over_Temp_3_5 : 29|1@1+ (1,0) [0|1] ""  External
 SG_ EyeQ_MIPS_Over_Temp_3_4 : 28|1@1+ (1,0) [0|1] ""  External
 SG_ EyeQOnBoardThermistorOveTemp_3_1 : 25|1@1+ (1,0) [0|1] ""  External
 SG_ EYEQ_1V0_SUPPLY_OUT_OF_RANGE_0_3 : 3|1@1+ (1,0) [0|1] ""  External
 SG_ EYEQ_1V1_SUPPLY_OUT_OF_RANGE_0_2 : 2|1@1+ (1,0) [0|1] ""  External
 SG_ EYEQ_1V8_SUPPLY_OUT_OF_RANGE_0_1 : 1|1@1+ (1,0) [0|1] ""  External
 SG_ EYEQ_3V3_SUPPLY_OUT_OF_RANGE_0_0 : 0|1@1+ (1,0) [0|1] ""  External
 SG_ Windshield_heater_OPNLD_Err_0002 : 496|1@1+ (1,0) [0|1] ""  External
 SG_ WWINDSHIELD_HEATER_STG_FAUL_0002 : 497|1@1+ (1,0) [0|1] ""  External
 SG_ WINDSHIELD_HEATER_OVRLD_FAU_0002 : 498|1@1+ (1,0) [0|1] ""  External
 SG_ WINDSHIELD_HEATER_STB_FAULT_0002 : 499|1@1+ (1,0) [0|1] ""  External

BO_ 1796 HOST_SPI_Debug: 64 IFV410
 SG_ srpInfo_imageIndex : 352|16@1+ (1,0) [0|65535] ""  External
 SG_ visOnlyAEBInfo_imageIndex : 320|16@1+ (1,0) [0|65535] "" Vector__XXX
 SG_ lightObjects_imageIndex : 336|16@1+ (1,0) [0|65535] ""  External
 SG_ eyeqSPIMsgRxBadSeqCtr : 168|8@1+ (1,0) [0|255] "" Vector__XXX
 SG_ eyeqSPIMsgRxBadHdrCtr : 160|8@1+ (1,0) [0|255] "" Vector__XXX
 SG_ eyeqSPIMsg20RxCtr : 144|16@1+ (1,0) [0|65535] "" Vector__XXX
 SG_ System_Reset_Counter : 120|8@1+ (1,0) [0|255] ""  External
 SG_ Software_Reset_Reason : 128|8@1+ (1,0) [0|255] ""  External
 SG_ Hardware_Reset_Reason : 136|8@1+ (1,0) [0|255] ""  External
 SG_ EyeQ_Process_Index : 368|32@1+ (1,0) [0|4294967295] ""  External
 SG_ timeSyncData_imageIndex : 304|16@1+ (1,0) [0|65535] ""  External
 SG_ visSafety_imageIndex : 288|16@1+ (1,0) [0|65535] ""  External
 SG_ visFailsafes_imageIndex : 272|16@1+ (1,0) [0|65535] ""  External
 SG_ visObjects_imageIndex : 256|16@1+ (1,0) [0|65535] ""  External
 SG_ tsrInfo_imageIndex : 240|16@1+ (1,0) [0|65535] ""  External
 SG_ roadInfo_imageIndex : 224|16@1+ (1,0) [0|65535] ""  External
 SG_ eyeqSPIMsgTxCtr : 176|16@1+ (1,0) [0|65535] ""  External
 SG_ SPI_Rolling_Count_Echo : 192|16@1+ (1,0) [0|65535] ""  External
 SG_ SPI_Rolling_Counter : 208|16@1+ (1,0) [0|65535] ""  External
 SG_ EyeqSpiVFPModeFaultCtr : 104|8@1- (1,0) [-128|127] ""  External
 SG_ EyeqSpiCRCErrorCtr : 96|8@1- (1,0) [-128|127] ""  External
 SG_ EyeqSpiCommWatchdogCtr : 112|8@1- (1,0) [-128|127] ""  External
 SG_ EyqSpiMsgTimeoutCtr : 72|8@1- (1,0) [-128|127] ""  External
 SG_ EyqSpiMsgFormatErrorCtr : 88|8@1- (1,0) [-128|127] ""  External
 SG_ EyqSpiFrameFormatErrorCtr : 80|8@1- (1,0) [-128|127] ""  External
 SG_ HostSpMsgTImeoutCtr : 64|8@1- (1,0) [-128|127] ""  External
 SG_ HostSpiTxErrorCtr : 48|8@1- (1,0) [-128|127] ""  External
 SG_ HostSpiCRCErrorCtr : 40|8@1- (1,0) [-128|127] ""  External
 SG_ HostSpiAppRxBadHdrCtr : 56|8@1- (1,0) [-128|127] ""  External
 SG_ HostSpiDllRxBadHdrCtr : 0|8@1- (1,0) [-128|127] ""  External
 SG_ HostSpiDllRxLongFrameCtr : 8|8@1- (1,0) [-128|127] ""  External
 SG_ HostSpiDllRxShortFrameCtr : 16|8@1- (1,0) [-128|127] ""  External
 SG_ HostSpiTpRxBadHdrCtr : 24|8@1- (1,0) [-128|127] ""  External
 SG_ HostSpiTpRxBadSeqCtr : 32|8@1- (1,0) [-128|127] ""  External

BO_ 1797 ADAS_Temperature: 32 IFV410
 SG_ AruixOnBdT : 88|8@1+ (1,-40) [-40|125] "" Vector__XXX
 SG_ vmpTemperature : 48|8@1+ (1,-128) [-128|127] "" Vector__XXX
 SG_ mipsTemperature : 40|8@1+ (1,-128) [-128|127] "" Vector__XXX
 SG_ imagerTemperature : 32|8@1+ (1,-128) [-128|127] "" Vector__XXX
 SG_ ddrTemperature : 56|8@1+ (1,0) [0|255] "" Vector__XXX
 SG_ Temperature_DDR : 24|8@1+ (1,0) [0|255] ""  External
 SG_ Temperature_VMP : 16|8@1+ (1,-40) [-40|125] ""  External
 SG_ Temperature_MIPS : 8|8@1+ (1,-40) [-40|125] ""  External
 SG_ Camera1_temperature : 0|8@1+ (1,-40) [-40|125] ""  External
 SG_ DDROnBdT : 64|8@1+ (1,-40) [-40|125] ""  External
 SG_ EyeQ4OnBdT : 72|8@1+ (1,-40) [-40|125] ""  External
 SG_ EyeQ_ThermSts : 80|8@1+ (1,0) [0|255] ""  External

BO_ 1792 System_Power_Status: 64 IFV410
 SG_ VFP_Sub_State : 24|8@1+ (1,0) [0|255] "" Vector__XXX
 SG_ eyeq_static_calibration_error_e : 232|4@1+ (1,0) [0|15] "" Vector__XXX
 SG_ Status_Vision_Calib_Process : 224|8@1+ (1,0) [0|100] "%"  External
 SG_ VBattState_ECU : 216|4@1+ (1,0) [0|15] ""  External
 SG_ AEB_EDR_Event_Triggered : 466|1@1+ (1,0) [0|1] ""  External
 SG_ HandsOff_EDR_Event_Triggered : 465|1@1+ (1,0) [0|1] ""  External
 SG_ SafeStop_EDR_Event_Triggered : 464|1@1+ (1,0) [0|1] ""  External
 SG_ CIB_Rolling_Counter : 264|8@1+ (1,0) [0|255] ""  External
 SG_ HEATER_OUT_Current_Voltage : 440|8@1+ (0.08,0) [0|20.4] ""  External
 SG_ AURIX_1V2_Current_Voltage : 384|8@1+ (0.08,0) [0|20.4] ""  External
 SG_ HSD_CS_Current_Voltage : 432|8@1+ (0.08,0) [0|20.4] ""  External
 SG_ COMM_EN_Current_Voltage : 424|8@1+ (0.08,0) [0|20.4] ""  External
 SG_ AURIX_5V_Current_Voltage : 416|8@1+ (0.08,0) [0|20.4] ""  External
 SG_ AURIX_1V25_Current_Voltage : 392|8@1+ (0.08,0) [0|20.4] ""  External
 SG_ AURIX_3V3_Current_Voltage : 408|8@1+ (0.08,0) [0|20.4] ""  External
 SG_ LKS_ISLW_Current_Voltage : 448|8@1+ (0.08,0) [0|20.4] ""  External
 SG_ AURIX_2V8_Current_Voltage : 400|8@1+ (0.08,0) [0|20.4] ""  External
 SG_ LKS_PCA_SW_Current_Voltage : 256|8@1+ (0.08,0) [0|20.4] ""  External
 SG_ VBattState_EyeQ4 : 220|4@1+ (1,0) [0|15] ""  External
 SG_ VBattState_Comm : 212|4@1+ (1,0) [0|15] ""  External
 SG_ VBattState_Diag : 208|4@1+ (1,0) [0|15] ""  External
 SG_ VFP_State : 16|8@1+ (1,0) [0|255] ""  External
 SG_ align_current_state : 236|4@1+ (1,0) [0|15] ""  External
 SG_ EYEQ4_Power_Mode_State : 5|3@1+ (1,0) [0|7] ""  External
 SG_ AURIX_EYEQ4_3V3_EN : 176|1@1+ (1,0) [0|1] ""  External
 SG_ AURIX_EYEQ4_PWR_EN : 177|1@1+ (1,0) [0|1] ""  External
 SG_ EYEQ_3V3_Current_Voltage : 40|8@1+ (0.08,0) [0|20.4] "V"  External
 SG_ EYEQ_1V0_Current_Voltage : 48|8@1+ (0.08,0) [0|20.4] "V"  External
 SG_ EYEQ_1V1_Current_Voltage : 56|8@1+ (0.08,0) [0|20.4] "V"  External
 SG_ EYEQ_1V8_Current_Voltage : 64|8@1+ (0.08,0) [0|20.4] "V"  External
 SG_ RawAURIX_EYEQ_3V3_ADC : 72|12@1+ (1,0) [0|4095] ""  External
 SG_ EYEQ4_RESET : 179|1@1+ (1,0) [0|1] ""  External
 SG_ Host_Rx_Valid_EyeQ4_SPI_Msgs : 183|1@1+ (1,0) [0|1] ""  External
 SG_ EyeQ4InitTimeout : 180|1@1+ (1,0) [0|1] ""  External
 SG_ EYEQ4_Diagnostic_Shutdown : 184|1@1+ (1,0) [0|1] ""  External
 SG_ RawAURIX_EYEQ_1V0_ADC : 84|12@1+ (1,0) [0|4095] ""  External
 SG_ EDR_Event_Triggered : 467|1@1+ (1,0) [0|1] ""  External
 SG_ ACC_Rolling_Counter : 272|8@1+ (1,0) [0|255] ""  External
 SG_ Host_Thermal_Shutdown : 186|1@1+ (1,0) [0|1] ""  External
 SG_ EYEQ4_Thermal_Shutdown : 185|1@1+ (1,0) [0|1] ""  External
 SG_ EyeQ4_SPI_Rolling_Count_Err : 182|1@1+ (1,0) [0|1] ""  External
 SG_ EyeQ4_SPI_Lost_Comm : 181|1@1+ (1,0) [0|1] ""  External
 SG_ RawAURIX_EYEQ_1V1_ADC : 96|12@1+ (1,0) [0|4095] ""  External
 SG_ EYEQ4_Reset_Request : 178|1@1+ (1,0) [0|1] ""  External
 SG_ RawAURIX_EYEQ_1V8_ADC : 108|12@1+ (1,0) [0|4095] ""  External
 SG_ EyeQIoSts_EYEQ4_AURIX_BOOT : 0|3@1+ (1,0) [0|7] ""  External
 SG_ EyeQIoSts_EYEQ4_AURIX_CORE_DUMP : 3|1@1+ (1,0) [0|1] ""  External
 SG_ EyeQIoSts_EYEQ4_AURIX_TEMP_EXCED : 4|1@1+ (1,0) [0|1] ""  External
 SG_ EYEQ4_Init_wait_ms : 120|16@1+ (1,0) [0|65535] "usec"  External
 SG_ EYEQ4_Core_Dump_wait_ms : 160|16@1+ (1,0) [0|65535] "usec"  External
 SG_ EYEQ4_Init_Retry_Counter : 136|8@1+ (1,0) [0|255] ""  External
 SG_ EYEQ4_Off_wait_ms : 144|16@1+ (1,0) [0|65535] "usec"  External
 SG_ RawVBAT_AURIX_ADC : 188|12@1+ (1,0) [0|4095] ""  External
 SG_ VBattU : 200|8@1+ (0.08,0) [0|20.4] "V"  External

BO_ 1793 System_Power_Status_Radar: 64 ASDM
 SG_ CanNm_NmState : 8|4@1+ (1,0) [0|15] "" Vector__XXX
 SG_ AURIX_FLASH_MUX_EYEQ4_SWITCH : 2|1@1+ (1,0) [0|1] "" Vector__XXX
 SG_ ProgExFlashInd : 0|2@1+ (1,0) [0|3] "" Vector__XXX
 SG_ VBattState_VRange_RFSRR : 304|3@1+ (1,0) [0|7] ""  External
 SG_ SRR_RFRONT_Power_Mode_State : 256|3@1+ (1,0) [0|7] ""  External
 SG_ AURIX_HSD2_SRR_LF_RF_DEN : 57|1@1+ (1,0) [0|1] ""  External
 SG_ AURIX_HSD2_SRR_RF_IN : 259|1@1+ (1,0) [0|1] ""  External
 SG_ Host_Rx_valid_SRR_RFRONT_CAN_Msg : 260|1@1+ (1,0) [0|1] ""  External
 SG_ SRR_RFRONTInitTimeout : 262|1@1+ (1,0) [0|1] ""  External
 SG_ SRR_RFRONT_Reset_Request : 263|1@1+ (1,0) [0|1] ""  External
 SG_ Com_with_SRR_RFRONT_Is_Dropped : 261|1@1+ (1,0) [0|1] ""  External
 SG_ VBattState_VRange_RRSRR : 368|3@1+ (1,0) [0|7] ""  External
 SG_ AURIX_HSD1_SRR_LR_RR_DEN : 56|1@1+ (1,0) [0|1] ""  External
 SG_ AURIX_HSD1_SRR_RR_IN : 323|1@1+ (1,0) [0|1] ""  External
 SG_ SRR_RFRONT_Init_wait_ms : 264|16@1+ (1,0) [0|65535] "usec"  External
 SG_ SRR_RFRONT_Init_Retry_Counter : 280|8@1+ (1,0) [0|255] ""  External
 SG_ SRR_RREAR_Power_Mode_State : 320|3@1+ (1,0) [0|7] ""  External
 SG_ Host_rx_valid_SRR_RREAR_CAN_Msgs : 324|1@1+ (1,0) [0|1] ""  External
 SG_ SRR_RREARInitTimeout : 326|1@1+ (1,0) [0|1] ""  External
 SG_ SRR_RREAR_Reset_Request : 327|1@1+ (1,0) [0|1] ""  External
 SG_ Com_with_SRR_RREAR_Is_Dropped : 325|1@1+ (1,0) [0|1] ""  External
 SG_ AURIX_HSD3_HEATER_FLR_DEN : 58|1@1+ (1,0) [0|1] ""  External
 SG_ SRR_RFRONT_Off_wait_ms : 288|16@1+ (1,0) [0|65535] "usec"  External
 SG_ SRR_RREAR_Init_wait_ms : 328|16@1+ (1,0) [0|65535] "usec"  External
 SG_ SRR_RREAR_Init_Retry_Counter : 344|8@1+ (1,0) [0|255] ""  External
 SG_ VBattState_VRange_MRR : 112|3@1+ (1,0) [0|7] ""  External
 SG_ MRR_Power_Mode_State : 64|3@1+ (1,0) [0|7] ""  External
 SG_ AURIX_HSD3_FLR_IN : 67|1@1+ (1,0) [0|1] ""  External
 SG_ Host_Rx_Valid_MRR_CAN_Msgs : 68|1@1+ (1,0) [0|1] ""  External
 SG_ SRR_RREAR_Off_wait_ms : 352|16@1+ (1,0) [0|65535] "usec"  External
 SG_ MRR_Init_wait_ms : 72|16@1+ (1,0) [0|65535] "usec"  External
 SG_ MRRInitTimeout : 70|1@1+ (1,0) [0|1] ""  External
 SG_ MRR_Reset_Request : 71|1@1+ (1,0) [0|1] ""  External
 SG_ Com_with_MRR_Is_Dropped : 69|1@1+ (1,0) [0|1] ""  External
 SG_ VBattState_VRange_LFSRR : 176|3@1+ (1,0) [0|7] ""  External
 SG_ AURIX_HSD2_SRR_LF_IN : 131|1@1+ (1,0) [0|1] ""  External
 SG_ Host_Rx_Valid_SRR_LFRONT_CAN_Msg : 132|1@1+ (1,0) [0|1] ""  External
 SG_ MRR_Init_Retry_Counter : 88|8@1+ (1,0) [0|255] ""  External
 SG_ MRR_Off_wait_ms : 96|16@1+ (1,0) [0|65535] "usec"  External
 SG_ SRR_LFRONT_Power_Mode_State : 128|3@1+ (1,0) [0|7] ""  External
 SG_ SRR_LFRONTInitTimeout : 134|1@1+ (1,0) [0|1] ""  External
 SG_ SRR_LFRONT_Reset_Request : 135|1@1+ (1,0) [0|1] ""  External
 SG_ Com_with_SRR_LFRONT_Is_Dropped : 133|1@1+ (1,0) [0|1] ""  External
 SG_ Host_Rx_Valid_SRR_LREAR_CAN_Msgs : 196|1@1+ (1,0) [0|1] ""  External
 SG_ SRR_LREARInitTimeout : 198|1@1+ (1,0) [0|1] ""  External
 SG_ SRR_LFRONT_Init_Retry_Counter : 152|8@1+ (1,0) [0|255] ""  External
 SG_ SRR_LFRONT_Init_wait_ms : 136|16@1+ (1,0) [0|65535] "usec"  External
 SG_ SRR_LFRONT_Off_wait_ms : 160|16@1+ (1,0) [0|65535] "usec"  External
 SG_ VBattState_VRange_LRSRR : 240|3@1+ (1,0) [0|7] ""  External
 SG_ SRR_LREAR_Power_Mode_State : 192|3@1+ (1,0) [0|7] ""  External
 SG_ SRR_LREAR_Reset_Request : 199|1@1+ (1,0) [0|1] ""  External
 SG_ Com_with_SRR_LREAR_Is_Dropped : 197|1@1+ (1,0) [0|1] ""  External
 SG_ SRR_LREAR_Init_Retry_Counter : 216|8@1+ (1,0) [0|255] ""  External
 SG_ SRR_LREAR_Init_wait_ms : 200|16@1+ (1,0) [0|65535] "usec"  External
 SG_ SRR_LREAR_Off_wait_ms : 224|16@1+ (1,0) [0|65535] "usec"  External
 SG_ AURIX_HSD1_SRR_LR_IN : 195|1@1+ (1,0) [0|1] ""  External
 SG_ AURIX_POC_LDO3_CAMPWR_FWC_EN : 3|1@1+ (1,0) [0|1] ""  External
 SG_ SRR_LR_Iout : 400|8@1+ (0.05,0) [0|12.5] "A"  External
 SG_ SRR_RR_Iout : 416|8@1+ (0.05,0) [0|12.5] "A"  External
 SG_ SRR_LF_Iout : 392|8@1+ (0.05,0) [0|12.5] "A"  External
 SG_ SRR_RF_Iout : 408|8@1+ (0.05,0) [0|12.5] "A"  External
 SG_ MRR_Iout : 384|8@1+ (0.05,0) [0|12.5] "A"  External
 SG_ SRR_LF_PWR_Current_Voltage : 432|8@1+ (0.08,0) [0|20.4] "V"  External
 SG_ SRR_RF_PWR_Current_Voltage : 448|8@1+ (0.08,0) [0|20.4] "V"  External
 SG_ SRR_LR_PWR_Current_Voltage : 440|8@1+ (0.08,0) [0|20.4] "V"  External
 SG_ SRR_RR_PWR_Current_Voltage : 456|8@1+ (0.08,0) [0|20.4] "V"  External
 SG_ MRR_PWR_Current_Voltage : 424|8@1+ (0.08,0) [0|20.4] "V"  External

BO_ 1824 VIS_LANE_MSG1: 64 IFV410
 SG_ constructionArea : 0|1@1+ (1,0) [0|1] "N/A"  External
 SG_ ambiguousLineLeft : 1|1@1+ (1,0) [0|1] "N/A"  External
 SG_ ambiguousLineRight : 2|1@1+ (1,0) [0|1] "N/A"  External
 SG_ roadPredictionLeft : 3|6@1+ (1,0) [0|63] "N/A"  External
 SG_ roadPredictionRight : 9|6@1+ (1,0) [0|63] "N/A"  External
 SG_ hostLeftMarker_type : 15|4@1+ (1,0) [0|6] "N/A"  External
 SG_ hostLeftMarker_sfConf : 19|7@1+ (0.01,0) [0|1] "N/A"  External
 SG_ hostLeftMarker_conf : 26|2@1+ (1,0) [0|3] "N/A"  External
 SG_ hostLeftMarker_color : 28|2@1+ (1,0) [0|3] "N/A"  External
 SG_ hostLeftMarker_A0 : 30|11@1+ (0.01,-10) [-10|10] "m"  External
 SG_ hostLeftMarker_A1 : 41|11@1+ (0.0009,-0.9) [-0.9|0.9] "N/A"  External
 SG_ hostLeftMarker_A2 : 52|12@1+ (5E-006,-0.01) [-0.01|0.01] "1/m"  External
 SG_ hostLeftMarker_A3 : 64|12@1+ (1E-007,-0.00017) [-0.00017|0.00017] "1/m^2"  External
 SG_ hostLeftMarker_startRange : 76|9@1+ (0.25,0) [0|128] "m"  External
 SG_ hostLeftMarker_endRange : 85|9@1+ (0.25,0) [0|128] "m"  External
 SG_ hostLeftMarker_width : 94|8@1+ (0.01,0) [0|0.7] "m"  External
 SG_ hostLeftMarker_measuredViewRange : 102|9@1+ (0.25,0) [0|128] "m"  External
 SG_ hostRightMarker_type : 111|4@1+ (1,0) [0|6] "N/A"  External
 SG_ hostRightMarker_sfConf : 115|7@1+ (0.01,0) [0|1] "N/A"  External
 SG_ hostRightMarker_conf : 122|2@1+ (1,0) [0|3] "N/A"  External
 SG_ hostRightMarker_color : 124|2@1+ (1,0) [0|3] "N/A"  External
 SG_ hostRightMarker_A0 : 126|11@1+ (0.01,-10) [-10|10] "m"  External
 SG_ hostRightMarker_A1 : 137|11@1+ (0.0009,-0.9) [-0.9|0.9] "N/A"  External
 SG_ hostRightMarker_A2 : 148|12@1+ (5E-006,-0.01) [-0.01|0.01] "1/m"  External
 SG_ hostRightMarker_A3 : 160|12@1+ (1E-007,-0.00017) [-0.00017|0.00017] "1/m^2"  External
 SG_ hostRightMarker_startRange : 172|9@1+ (0.25,0) [0|128] "m"  External
 SG_ hostRightMarker_endRange : 181|9@1+ (0.25,0) [0|128] "m"  External
 SG_ hostRightMarker_width : 190|8@1+ (0.01,0) [0|0.7] "m"  External
 SG_ hostRightMarker_measuredViewRang : 198|9@1+ (0.25,0) [0|128] "m"  External
 SG_ nextLeftRightMarker_type : 207|4@1+ (1,0) [0|6] "N/A"  External
 SG_ nextLeftRightMarker_sfConf : 211|7@1+ (0.01,0) [0|1] "N/A"  External
 SG_ nextLeftRightMarker_conf : 218|2@1+ (1,0) [0|3] "N/A"  External
 SG_ nextLeftRightMarker_color : 220|2@1+ (1,0) [0|3] "N/A"  External
 SG_ nextLeftRightMarker_A0 : 222|11@1+ (0.01,-10) [-10|10] "m"  External
 SG_ nextLeftRightMarker_A1 : 233|11@1+ (0.0009,-0.9) [-0.9|0.9] "N/A"  External
 SG_ nextLeftRightMarker_A2 : 244|12@1+ (5E-006,-0.01) [-0.01|0.01] "1/m"  External
 SG_ nextLeftRightMarker_A3 : 256|12@1+ (1E-007,-0.00017) [-0.00017|0.00017] "1/m^2"  External
 SG_ nextLeftRightMarker_startRange : 268|9@1+ (0.25,0) [0|128] "m"  External
 SG_ nextLeftRightMarker_endRange : 277|9@1+ (0.25,0) [0|128] "m"  External
 SG_ nextLeftRightMarker_width : 286|8@1+ (0.01,0) [0|0.7] "m"  External
 SG_ nextLeftRightMarker_measuredView : 294|9@1+ (0.25,0) [0|128] "m"  External
 SG_ nextRightLeftMarker_type : 303|4@1+ (1,0) [0|6] "N/A"  External
 SG_ nextRightLeftMarker_sfConf : 307|7@1+ (0.01,0) [0|1] "N/A"  External
 SG_ nextRightLeftMarker_conf : 314|2@1+ (1,0) [0|3] "N/A"  External
 SG_ nextRightLeftMarker_color : 316|2@1+ (1,0) [0|3] "N/A"  External
 SG_ nextRightLeftMarker_A0 : 318|11@1+ (0.01,-10) [-10|10] "m"  External
 SG_ nextRightLeftMarker_A1 : 329|11@1+ (0.0009,-0.9) [-0.9|0.9] "N/A"  External
 SG_ nextRightLeftMarker_A2 : 340|12@1+ (5E-006,-0.01) [-0.01|0.01] "1/m"  External
 SG_ nextRightLeftMarker_A3 : 352|12@1+ (1E-007,-0.00017) [-0.00017|0.00017] "1/m^2"  External
 SG_ nextRightLeftMarker_startRange : 364|9@1+ (0.25,0) [0|128] "m"  External
 SG_ nextRightLeftMarker_endRange : 373|9@1+ (0.25,0) [0|128] "m"  External
 SG_ nextRightLeftMarker_width : 382|8@1+ (0.01,0) [0|0.7] "m"  External
 SG_ nextRightLeftMarker_measuredView : 390|9@1+ (0.25,0) [0|128] "m"  External

BO_ 1825 VIS_LANE_MSG2: 64 IFV410
 SG_ nextLeftLeftMarker_type : 0|4@1+ (1,0) [0|6] "N/A"  External
 SG_ nextLeftLeftMarker_sfConf : 4|7@1+ (0.01,0) [0|1] "N/A"  External
 SG_ nextLeftLeftMarker_conf : 11|2@1+ (1,0) [0|3] "N/A"  External
 SG_ nextLeftLeftMarker_color : 13|2@1+ (1,0) [0|3] "N/A"  External
 SG_ nextLeftLeftMarker_A0 : 15|11@1+ (0.01,-10) [-10|10] "m"  External
 SG_ nextLeftLeftMarker_A1 : 26|11@1+ (0.0009,-0.9) [-0.9|0.9] ""  External
 SG_ nextLeftLeftMarker_A2 : 37|12@1+ (5E-006,-0.01) [-0.01|0.01] "1/m"  External
 SG_ nextLeftLeftMarker_A3 : 49|12@1+ (1E-007,-0.00017) [-0.00017|0.00017] "1/m^2"  External
 SG_ nextLeftLeftMarker_startRange : 61|9@1+ (0.25,0) [0|128] "m"  External
 SG_ nextLeftLeftMarker_endRange : 70|9@1+ (0.25,0) [0|128] "m"  External
 SG_ nextLeftLeftMarker_width : 79|8@1+ (0.01,0) [0|0.7] "m"  External
 SG_ nextLeftLeftMarker_measuredViewR : 87|9@1+ (0.25,0) [0|128] "m"  External
 SG_ nextRightRightMarker_type : 96|4@1+ (1,0) [0|6] "N/A"  External
 SG_ nextRightRightMarker_sfConf : 100|7@1+ (0.01,0) [0|1] "N/A"  External
 SG_ nextRightRightMarker_conf : 107|2@1+ (1,0) [0|3] "N/A"  External
 SG_ nextRightRightMarker_color : 109|2@1+ (1,0) [0|3] "N/A"  External
 SG_ nextRightRightMarker_A0 : 111|11@1+ (0.01,-10) [-10|10] "m"  External
 SG_ nextRightRightMarker_A1 : 122|11@1+ (0.0009,-0.9) [-0.9|0.9] "N/A"  External
 SG_ nextRightRightMarker_A2 : 133|12@1+ (5E-006,-0.01) [-0.01|0.01] "1/m"  External
 SG_ nextRightRightMarker_A3 : 145|12@1+ (1E-007,-0.00017) [-0.00017|0.00017] "1/m^2"  External
 SG_ nextRightRightMarker_startRange : 157|9@1+ (0.25,0) [0|128] "m"  External
 SG_ nextRightRightMarker_endRange : 166|9@1+ (0.25,0) [0|128] "m"  External
 SG_ nextRightRightMarker_width : 175|8@1+ (0.01,0) [0|0.7] "m"  External
 SG_ nextRightRightMarker_measuredVie : 183|9@1+ (0.25,0) [0|128] "m"  External

BO_ 1826 VIS_ROAD_INFO: 64 IFV410
 SG_ laneChange : 0|2@1+ (1,0) [0|3] "N/A"  External
 SG_ drivingSide : 2|2@1+ (1,0) [0|2] "N/A"  External
 SG_ hwExitLeft : 4|1@1+ (1,0) [0|1] "N/A"  External
 SG_ hwExitRight : 5|1@1+ (1,0) [0|1] "N/A"  External
 SG_ hwEntryLeft : 6|1@1+ (1,0) [0|1] "N/A"  External
 SG_ hwEntryRight : 7|1@1+ (1,0) [0|1] "N/A"  External

BO_ 1827 VIS_ROAD_BORDER: 64 IFV410
 SG_ roadBorder_left_A0 : 0|12@1+ (0.01,-16) [-16|15.99] "m�"  External
 SG_ roadBorder_left_A1 : 12|11@1+ (0.0009,-0.9) [-0.9|0.9] ""  External
 SG_ roadBorder_left_A2 : 23|12@1+ (5E-006,-0.01) [-0.01|0.01] "�1/m"  External
 SG_ roadBorder_left_A3 : 35|16@1+ (1E-008,-0.00017) [-0.00017|0.000167] "1/m^2�"  External
 SG_ roadBorder_left_startRange : 51|9@1+ (0.25,0) [0|128] "m"  External
 SG_ roadBorder_left_endRange : 60|9@1+ (0.25,0) [0|128] "m"  External
 SG_ roadBorder_left_Height : 69|9@1+ (0.005,0) [0|2] "m"  External
 SG_ roadBorder_left_Type : 78|3@1+ (1,0) [0|7] "N/A"  External
 SG_ roadBorder_left_sfConf : 81|7@1+ (0.01,0) [0|1] "N/A"  External
 SG_ roadBorder_left_conf : 88|2@1+ (1,0) [0|2] "N/A"  External
 SG_ roadBorder_right_A0 : 90|12@1+ (0.01,-16) [-16|15.99] "m�"  External
 SG_ roadBorder_right_A1 : 102|11@1+ (0.0009,-0.9) [-0.9|0.9] "N/A"  External
 SG_ roadBorder_right_A2 : 113|12@1+ (5E-006,-0.01) [-0.01|0.01] "�1/m"  External
 SG_ roadBorder_right_A3 : 125|16@1+ (1E-008,-0.00017) [-0.00017|0.000167] "1/m^2�"  External
 SG_ roadBorder_right_startRange : 141|9@1+ (0.25,0) [0|128] "m"  External
 SG_ roadBorder_right_endRange : 150|9@1+ (0.25,0) [0|128] "m"  External
 SG_ roadBorder_right_Height : 159|9@1+ (0.005,0) [0|2] "m"  External
 SG_ roadBorder_right_Type : 168|3@1+ (1,0) [0|7] "N/A"  External
 SG_ roadBorder_right_sfConf : 171|7@1+ (0.01,0) [0|1] "N/A"  External
 SG_ roadBorder_right_conf : 178|2@1+ (1,0) [0|2] "N/A"  External

BO_ 1828 VIS_OBS_MSG_1_3: 64 IFV410
 SG_ VIS_OBS_ID_1 : 0|4@1+ (1,0) [0|15] "N/A"  External
 SG_ VIS_OBS_classification_1 : 4|3@1+ (1,0) [0|7] "N/A"  External
 SG_ VIS_OBS_age_1 : 7|32@1+ (1,0) [0|4294967295] "N/A"  External
 SG_ VIS_OBS_brakeLight_Indicator_1 : 39|1@1+ (1,0) [0|1] "N/A"  External
 SG_ VIS_OBS_turnRight_Indicator_1 : 40|1@1+ (1,0) [0|1] "N/A"  External
 SG_ VIS_OBS_turnLeft_Indicator_1 : 41|1@1+ (1,0) [0|1] "N/A"  External
 SG_ VIS_OBS_ttc_const_vel_1 : 42|3@1+ (1,0) [0|7] "s"  External
 SG_ VIS_OBS_laneAssignment_1 : 45|3@1+ (1,-2) [-2|3] "N/A"  External
 SG_ VIS_OBS_motionStatus_1 : 48|3@1+ (1,0) [0|4] "N/A"  External
 SG_ VIS_OBS_motionCategory_1 : 51|4@1+ (1,0) [0|12] "N/A"  External
 SG_ VIS_OBS_motionOrientation_1 : 55|4@1+ (1,0) [0|8] "N/A"  External
 SG_ VIS_OBS_width_1 : 59|9@1+ (0.01,0) [0.4|2.95] "m"  External
 SG_ VIS_OBS_height_1 : 68|9@1+ (0.01,0) [0|4.2] "m"  External
 SG_ VIS_OBS_heading_1 : 77|12@1+ (0.0025,-3.14) [-3.14|3.14] "radians"  External
 SG_ VIS_OBS_latDistance_1 : 89|12@1+ (0.125,-100) [-100|100] "m"  External
 SG_ VIS_OBS_longDistance_1 : 101|12@1+ (0.125,-200) [-200|250] "m"  External
 SG_ VIS_OBS_LatVelocity_1 : 113|13@1+ (0.025,-50) [-50|50] "m/s"  External
 SG_ VIS_OBS_LongVelocity_1 : 126|13@1+ (0.025,-65) [-65|65] "m/s"  External
 SG_ VIS_OBS_LatAcc_1 : 139|12@1+ (0.01,-11) [-11|8] "m/s^2"  External
 SG_ VIS_OBS_LongAcc_1 : 151|12@1+ (0.01,-13) [-13|13] "m/s^2"  External
 SG_ VIS_OBS_RC_counter_316 : 504|8@1+ (1,0) [0|255] "N/A"  External
 SG_ VIS_OBS_messsage_counter_316 : 500|4@1+ (1,0) [0|15] "N/A"  External
 SG_ VIS_OBS_CIPV_Lost_1 : 166|2@1+ (1,0) [0|2] "N/A"  External
 SG_ VIS_OBS_ID_2 : 168|4@1+ (1,0) [0|15] "N/A"  External
 SG_ VIS_OBS_classification_2 : 172|3@1+ (1,0) [0|7] "N/A"  External
 SG_ VIS_OBS_age_2 : 175|32@1+ (1,0) [0|4294967295] "N/A"  External
 SG_ VIS_OBS_brakeLight_Indicator_2 : 207|1@1+ (1,0) [0|1] "N/A"  External
 SG_ VIS_OBS_turnRight_Indicator_2 : 208|1@1+ (1,0) [0|1] "N/A"  External
 SG_ VIS_OBS_turnLeft_Indicator_2 : 209|1@1+ (1,0) [0|1] "N/A"  External
 SG_ VIS_OBS_ttc_const_vel_2 : 210|3@1+ (1,0) [0|7] "s"  External
 SG_ VIS_OBS_laneAssignment_2 : 213|3@1+ (1,-2) [-2|3] "N/A"  External
 SG_ VIS_OBS_motionStatus_2 : 216|3@1+ (1,0) [0|4] "N/A"  External
 SG_ VIS_OBS_motionCategory_2 : 219|4@1+ (1,0) [0|12] "N/A"  External
 SG_ VIS_OBS_motionOrientation_2 : 223|4@1+ (1,0) [0|8] "N/A"  External
 SG_ VIS_OBS_width_2 : 227|9@1+ (0.01,0) [0.4|2.95] "m"  External
 SG_ VIS_OBS_height_2 : 236|9@1+ (0.01,0) [0|4.2] "m"  External
 SG_ VIS_OBS_heading_2 : 245|12@1+ (0.0025,-3.14) [-3.14|3.14] "radians"  External
 SG_ VIS_OBS_latDistance_2 : 257|12@1+ (0.125,-100) [-100|100] "m"  External
 SG_ VIS_OBS_longDistance_2 : 269|12@1+ (0.125,-200) [-200|250] "m"  External
 SG_ VIS_OBS_LatVelocity_2 : 281|13@1+ (0.025,-50) [-50|50] "m/s"  External
 SG_ VIS_OBS_LongVelocity_2 : 294|13@1+ (0.025,-65) [-65|65] "m/s"  External
 SG_ VIS_OBS_LatAcc_2 : 307|12@1+ (0.01,-11) [-11|8] "m/s^2"  External
 SG_ VIS_OBS_LongAcc_2 : 319|12@1+ (0.01,-13) [-13|13] "m/s^2"  External
 SG_ VIS_OBS_ID_3 : 336|4@1+ (1,0) [0|15] "N/A"  External
 SG_ VIS_OBS_classification_3 : 340|3@1+ (1,0) [0|7] "N/A"  External
 SG_ VIS_OBS_age_3 : 343|32@1+ (1,0) [0|4294967295] "N/A"  External
 SG_ VIS_OBS_brakeLight_Indicator_3 : 375|1@1+ (1,0) [0|1] "N/A"  External
 SG_ VIS_OBS_turnRight_Indicator_3 : 376|1@1+ (1,0) [0|1] "N/A"  External
 SG_ VIS_OBS_turnLeft_Indicator_3 : 377|1@1+ (1,0) [0|1] "N/A"  External
 SG_ VIS_OBS_ttc_const_vel_3 : 378|3@1+ (1,0) [0|7] "s"  External
 SG_ VIS_OBS_laneAssignment_3 : 381|3@1+ (1,-2) [-2|3] "N/A"  External
 SG_ VIS_OBS_motionStatus_3 : 384|3@1+ (1,0) [0|4] "N/A"  External
 SG_ VIS_OBS_motionCategory_3 : 387|4@1+ (1,0) [0|12] "N/A"  External
 SG_ VIS_OBS_motionOrientation_3 : 391|4@1+ (1,0) [0|8] "N/A"  External
 SG_ VIS_OBS_width_3 : 395|9@1+ (0.01,0) [0.4|2.95] "m"  External
 SG_ VIS_OBS_height_3 : 404|9@1+ (0.01,0) [0|4.2] "m"  External
 SG_ VIS_OBS_heading_3 : 413|12@1+ (0.0025,-3.14) [-3.14|3.14] "radians"  External
 SG_ VIS_OBS_latDistance_3 : 425|12@1+ (0.125,-100) [-100|100] "m"  External
 SG_ VIS_OBS_longDistance_3 : 437|12@1+ (0.125,-200) [-200|250] "m"  External
 SG_ VIS_OBS_LatVelocity_3 : 449|13@1+ (0.025,-50) [-50|50] "m/s"  External
 SG_ VIS_OBS_LongVelocity_3 : 462|13@1+ (0.025,-65) [-65|65] "m/s"  External
 SG_ VIS_OBS_LatAcc_3 : 475|12@1+ (0.01,-11) [-11|8] "m/s^2"  External
 SG_ VIS_OBS_LongAcc_3 : 487|12@1+ (0.01,-13) [-13|13] "m/s^2"  External
 SG_ VIS_OBS_CIPV_Lost_2 : 334|2@1+ (1,0) [0|2] "N/A"  External
 SG_ VIS_OBS_CIPV_Lost_3 : 332|2@1+ (1,0) [0|2] "N/A"  External

BO_TX_BU_ 1792 : ASDM,IFV410;
BA_DEF_ BO_  "GenMsgSendType" ENUM  "FixedPeriodic","Event","EnabledPeriodic","NotUsed","NotUsed","EventPeriodic","NotUsed","NotUsed","NoMsgSendType";
BA_DEF_ BO_  "GenMsgCycleTime" INT 0 100000;
BA_DEF_ BO_  "GenMsgILSupport" ENUM  "No","Yes";
BA_DEF_ SG_  "GenSigStartValue" INT 0 1000000000;
BA_DEF_ SG_  "UsedOnPgmDBC" ENUM  "No","Yes";
BA_DEF_ SG_  "GenSigSendType" ENUM  "Cyclic","OnWrite","vector_leerstring","OnChange","vector_leerstring","IfActive","vector_leerstring","NoSigSendType";
BA_DEF_ BO_  "VFrameFormat" ENUM  "StandardCAN","ExtendedCAN","reserved","reserved","reserved","reserved","reserved","reserved","reserved","reserved","reserved","reserved","reserved","reserved","StandardCAN_FD","ExtendedCAN_FD";
BA_DEF_ SG_  "SystemSignalLongSymbol" STRING ;
BA_DEF_DEF_  "GenMsgSendType" "NoMsgSendType";
BA_DEF_DEF_  "GenMsgCycleTime" 0;
BA_DEF_DEF_  "GenMsgILSupport" "Yes";
BA_DEF_DEF_  "GenSigStartValue" 0;
BA_DEF_DEF_  "UsedOnPgmDBC" "Yes";
BA_DEF_DEF_  "GenSigSendType" "NoSigSendType";
BA_DEF_DEF_  "VFrameFormat" "StandardCAN";
BA_DEF_DEF_  "SystemSignalLongSymbol" "";
BA_ "GenMsgSendType" BO_ 1809 0;
BA_ "GenMsgCycleTime" BO_ 1809 100;
BA_ "VFrameFormat" BO_ 1809 14;
BA_ "GenMsgCycleTime" BO_ 1808 10;
BA_ "GenMsgSendType" BO_ 1808 0;
BA_ "VFrameFormat" BO_ 1808 14;
BA_ "GenMsgCycleTime" BO_ 1796 25;
BA_ "GenMsgSendType" BO_ 1796 0;
BA_ "VFrameFormat" BO_ 1796 14;
BA_ "GenMsgCycleTime" BO_ 1797 100;
BA_ "GenMsgSendType" BO_ 1797 0;
BA_ "VFrameFormat" BO_ 1797 14;
BA_ "GenMsgCycleTime" BO_ 1792 5;
BA_ "GenMsgSendType" BO_ 1792 0;
BA_ "VFrameFormat" BO_ 1792 14;
BA_ "GenMsgSendType" BO_ 1793 0;
BA_ "GenMsgCycleTime" BO_ 1793 50;
BA_ "VFrameFormat" BO_ 1793 14;
BA_ "GenMsgSendType" BO_ 1824 0;
BA_ "GenMsgCycleTime" BO_ 1824 50;
BA_ "VFrameFormat" BO_ 1824 14;
BA_ "GenMsgSendType" BO_ 1825 0;
BA_ "GenMsgCycleTime" BO_ 1825 50;
BA_ "VFrameFormat" BO_ 1825 14;
BA_ "GenMsgSendType" BO_ 1826 0;
BA_ "GenMsgCycleTime" BO_ 1826 50;
BA_ "VFrameFormat" BO_ 1826 14;
BA_ "GenMsgSendType" BO_ 1827 0;
BA_ "GenMsgCycleTime" BO_ 1827 50;
BA_ "VFrameFormat" BO_ 1827 14;
BA_ "GenMsgSendType" BO_ 1828 0;
BA_ "GenMsgCycleTime" BO_ 1828 50;
BA_ "VFrameFormat" BO_ 1828 14;
BA_ "GenSigSendType" SG_ 1809 DCT3_RatAct_Error_B2e_7 0;
BA_ "GenSigSendType" SG_ 1809 ECM2_EngState_Error_B2e_6 0;
BA_ "SystemSignalLongSymbol" SG_ 1809 EYEQ_MINOR_ERROR_BM_EM_ERR__0001 "EYEQ_MINOR_ERROR_BM_EM_ERR_FAILED_NB_OPERATION_FAULT_B15_6";
BA_ "GenSigSendType" SG_ 1809 EYEQ_STATIC_CRC_FAULT_B6_1 0;
BA_ "GenSigSendType" SG_ 1809 FEE_E_GC_READ_FAULT_B1_4 0;
BA_ "GenSigSendType" SG_ 1809 EYEQ_GEN_34_Corrupted_Vehic_0001 0;
BA_ "SystemSignalLongSymbol" SG_ 1809 EYEQ_GEN_34_Corrupted_Vehic_0001 "EYEQ_GEN_34_Corrupted_Vehicle_Info_Input_Signals_Bf_1";
BA_ "GenSigSendType" SG_ 1809 EYEQ_GEN_11_INPUT_CRC_MISMA_0001 0;
BA_ "SystemSignalLongSymbol" SG_ 1809 EYEQ_GEN_11_INPUT_CRC_MISMA_0001 "EYEQ_GEN_11_INPUT_CRC_MISMATCH_Bf_0";
BA_ "GenSigSendType" SG_ 1809 EYEQ_GEN_4_YAW_HORIZON_DEVI_0001 0;
BA_ "SystemSignalLongSymbol" SG_ 1809 EYEQ_GEN_4_YAW_HORIZON_DEVI_0001 "EYEQ_GEN_4_YAW_HORIZON_DEVIATION_Be_0";
BA_ "GenSigSendType" SG_ 1809 EYEQ_GEN_18_IMAGER_DATA_ROW_0001 0;
BA_ "SystemSignalLongSymbol" SG_ 1809 EYEQ_GEN_18_IMAGER_DATA_ROW_0001 "EYEQ_GEN_18_IMAGER_DATA_ROWS_COLS_Bd_7";
BA_ "GenSigSendType" SG_ 1809 EYEQ_GEN_13_OLD_EGODATA_LAT_Be_2 0;
BA_ "GenSigSendType" SG_ 1809 AEB_shutdown_9_ROI_DIFF_VC__0001 0;
BA_ "SystemSignalLongSymbol" SG_ 1809 AEB_shutdown_9_ROI_DIFF_VC__0001 "AEB_shutdown_9_ROI_DIFF_VC_FCV_Bd_3";
BA_ "GenSigSendType" SG_ 1809 AEB_shutdown_7_POS_DIFF_KAL_0001 0;
BA_ "SystemSignalLongSymbol" SG_ 1809 AEB_shutdown_7_POS_DIFF_KAL_0001 "AEB_shutdown_7_POS_DIFF_KALMAN_VAL_Bd_2";
BA_ "GenSigSendType" SG_ 1809 EYEQ_GEN_50_VMP_SANITY_FAIL_0001 0;
BA_ "SystemSignalLongSymbol" SG_ 1809 EYEQ_GEN_50_VMP_SANITY_FAIL_0001 "EYEQ_GEN_50_VMP_SANITY_FAILED_FAULT_1b_0";
BA_ "GenSigSendType" SG_ 1809 EYEQ_FATAL_ERROR_APP_CPS_ST_0001 0;
BA_ "SystemSignalLongSymbol" SG_ 1809 EYEQ_FATAL_ERROR_APP_CPS_ST_0001 "EYEQ_FATAL_ERROR_APP_CPS_STL_FAILED_FAULT_12_2";
BA_ "GenSigSendType" SG_ 1809 EYEQ_GEN_24_CCFT_DIFF_RESUL_0001 0;
BA_ "SystemSignalLongSymbol" SG_ 1809 EYEQ_GEN_24_CCFT_DIFF_RESUL_0001 "EYEQ_GEN_24_CCFT_DIFF_RESULTS_FAULT_1c_3";
BA_ "SystemSignalLongSymbol" SG_ 1809 EYEQ_53_DECELERATION_DBS_OV_0001 "EYEQ_53_DECELERATION_DBS_OVERLAP_FAULT_B1c_2";
BA_ "SystemSignalLongSymbol" SG_ 1809 EYEQ_44_ROAD_SANITY_CORRECT_0001 "EYEQ_44_ROAD_SANITY_CORRECTION_VALIDATION_FAULT_B1c_1";
BA_ "GenSigSendType" SG_ 1809 EYEQ_GEN_21_CAMERA_HEIGHT_L_0001 0;
BA_ "SystemSignalLongSymbol" SG_ 1809 EYEQ_GEN_21_CAMERA_HEIGHT_L_0001 "EYEQ_GEN_21_CAMERA_HEIGHT_LIMIT_EXCEEDED_FAULT_1c_0";
BA_ "GenSigSendType" SG_ 1809 EYEQ_FATAL_ERROR_APP_INVALI_0001 0;
BA_ "SystemSignalLongSymbol" SG_ 1809 EYEQ_FATAL_ERROR_APP_INVALI_0001 "EYEQ_FATAL_ERROR_APP_INVALID_INTRINSIC_CALIB_FAULT_1b_5";
BA_ "SystemSignalLongSymbol" SG_ 1809 EYEQ_45_ROAD_SFCONF_VALIDAT_0001 "EYEQ_45_ROAD_SFCONF_VALIDATION_B1b_2";
BA_ "SystemSignalLongSymbol" SG_ 1809 EYEQ_48_ALGO_PITCH_MISMATCH_0001 "EYEQ_48_ALGO_PITCH_MISMATCH_B1b_1";
BA_ "GenSigSendType" SG_ 1809 EyeQ_Minor_Error_Bm_Error_F_0001 0;
BA_ "SystemSignalLongSymbol" SG_ 1809 EyeQ_Minor_Error_Bm_Error_F_0001 "EyeQ_Minor_Error_Bm_Error_Fault_14_0";
BA_ "GenSigSendType" SG_ 1809 EyeQ_Fatal_Error_App_Init_F_0001 0;
BA_ "SystemSignalLongSymbol" SG_ 1809 EyeQ_Fatal_Error_App_Init_F_0001 "EyeQ_Fatal_Error_App_Init_Failed_Fault_12_6";
BA_ "GenSigSendType" SG_ 1809 EyeQ_Fatal_Error_App_Init_C_0001 0;
BA_ "SystemSignalLongSymbol" SG_ 1809 EyeQ_Fatal_Error_App_Init_C_0001 "EyeQ_Fatal_Error_App_Init_Camera_Init_Fault_12_7";
BA_ "GenSigSendType" SG_ 1809 EyeQ_Fatal_Error_App_Fs_Err_0001 0;
BA_ "SystemSignalLongSymbol" SG_ 1809 EyeQ_Fatal_Error_App_Fs_Err_0001 "EyeQ_Fatal_Error_App_Fs_Error_Fault_12_4";
BA_ "GenSigSendType" SG_ 1809 EyeQ_Fatal_Error_App_Error__0001 0;
BA_ "SystemSignalLongSymbol" SG_ 1809 EyeQ_Fatal_Error_App_Error__0001 "EyeQ_Fatal_Error_App_Error_Fault_12_3";
BA_ "GenSigSendType" SG_ 1809 EyeQ_Fatal_Error_App_Calibr_0001 0;
BA_ "SystemSignalLongSymbol" SG_ 1809 EyeQ_Fatal_Error_App_Calibr_0001 "EyeQ_Fatal_Error_App_Calibration_Error_Fault_12_5";
BA_ "SystemSignalLongSymbol" SG_ 1809 EYEQ_33_ROAD_LANE_DISQUALIF_0001 "EYEQ_33_ROAD_LANE_DISQUALIFICATINO_FAILED_B1b_4";
BA_ "SystemSignalLongSymbol" SG_ 1809 EYEQ_42_ROAD_PREDICTION_VAL_0001 "EYEQ_42_ROAD_PREDICTION_VALIDATION_B1b_3";
BA_ "SystemSignalLongSymbol" SG_ 1809 EYEQ_MES_49_Data_Path_Corru_0001 "EYEQ_MES_49_Data_Path_Corruption_B1a_7";
BA_ "GenSigSendType" SG_ 1809 EyeQ_Minor_Error_Bm_Em_Err__0023 0;
BA_ "SystemSignalLongSymbol" SG_ 1809 EyeQ_Minor_Error_Bm_Em_Err__0023 "EyeQ_Minor_Error_Bm_Em_Err_Failed_Post_Init_IL_Fault_15_4";
BA_ "GenSigSendType" SG_ 1809 EyeQ_Minor_Error_Bm_Em_Erro_0001 0;
BA_ "SystemSignalLongSymbol" SG_ 1809 EyeQ_Minor_Error_Bm_Em_Erro_0001 "EyeQ_Minor_Error_Bm_Em_Error_Fault_14_1";
BA_ "GenSigSendType" SG_ 1809 EyeQ_Minor_Error_Bm_Em_Err__0024 0;
BA_ "SystemSignalLongSymbol" SG_ 1809 EyeQ_Minor_Error_Bm_Em_Err__0024 "EyeQ_Minor_Error_Bm_Em_Err_Failed_Post_Init_Ep_Fault_15_2";
BA_ "GenSigSendType" SG_ 1809 EyeQ_Minor_Error_Bm_Em_Err__0025 0;
BA_ "SystemSignalLongSymbol" SG_ 1809 EyeQ_Minor_Error_Bm_Em_Err__0025 "EyeQ_Minor_Error_Bm_Em_Err_Failed_Post_Init_Create_Logger_Fault_15_3";
BA_ "GenSigSendType" SG_ 1809 EyeQ_Minor_Error_Bm_Em_Err__0026 0;
BA_ "SystemSignalLongSymbol" SG_ 1809 EyeQ_Minor_Error_Bm_Em_Err__0026 "EyeQ_Minor_Error_Bm_Em_Err_Failed_Open_Blackbox_Fault_15_0";
BA_ "GenSigSendType" SG_ 1809 EyeQ_Minor_Error_Bm_Em_Err__0027 0;
BA_ "SystemSignalLongSymbol" SG_ 1809 EyeQ_Minor_Error_Bm_Em_Err__0027 "EyeQ_Minor_Error_Bm_Em_Err_Failed_Load_Setting_Fault_14_2";
BA_ "GenSigSendType" SG_ 1809 EyeQ_Minor_Error_Bm_Em_Err__0028 0;
BA_ "SystemSignalLongSymbol" SG_ 1809 EyeQ_Minor_Error_Bm_Em_Err__0028 "EyeQ_Minor_Error_Bm_Em_Err_Failed_Load_Registry_Fault_14_3";
BA_ "GenSigSendType" SG_ 1809 EyeQ_Minor_Error_Bm_Em_Err__0029 0;
BA_ "SystemSignalLongSymbol" SG_ 1809 EyeQ_Minor_Error_Bm_Em_Err__0029 "EyeQ_Minor_Error_Bm_Em_Err_Failed_Init_Registry_Fault_14_4";
BA_ "GenSigSendType" SG_ 1809 EyeQ_Minor_Error_Bm_Em_Err__0030 0;
BA_ "SystemSignalLongSymbol" SG_ 1809 EyeQ_Minor_Error_Bm_Em_Err__0030 "EyeQ_Minor_Error_Bm_Em_Err_Failed_Init_Fault_14_5";
BA_ "GenSigSendType" SG_ 1809 EyeQ_Minor_Error_Bm_Em_Err__0031 0;
BA_ "SystemSignalLongSymbol" SG_ 1809 EyeQ_Minor_Error_Bm_Em_Err__0031 "EyeQ_Minor_Error_Bm_Em_Err_Failed_Init_Ep_Fault_15_1";
BA_ "GenSigSendType" SG_ 1809 EyeQ_Minor_Error_Bm_Em_Err__0032 0;
BA_ "SystemSignalLongSymbol" SG_ 1809 EyeQ_Minor_Error_Bm_Em_Err__0032 "EyeQ_Minor_Error_Bm_Em_Err_Failed_Init_Bb_Reg_Fault_14_7";
BA_ "GenSigSendType" SG_ 1809 EyeQ_Minor_Error_Bm_Em_Err__0033 0;
BA_ "SystemSignalLongSymbol" SG_ 1809 EyeQ_Minor_Error_Bm_Em_Err__0033 "EyeQ_Minor_Error_Bm_Em_Err_Failed_Init_Bb_Fault_14_6";
BA_ "GenSigSendType" SG_ 1809 EyeQ_Minor_Error_Bm_Em_Err__0034 0;
BA_ "SystemSignalLongSymbol" SG_ 1809 EyeQ_Minor_Error_Bm_Em_Err__0034 "EyeQ_Minor_Error_Bm_Em_Err_Failed_Check_Reg_Versions_Fault_15_5";
BA_ "GenSigSendType" SG_ 1809 EyeQ_Fatal_Error_Pv_Verific_0001 0;
BA_ "SystemSignalLongSymbol" SG_ 1809 EyeQ_Fatal_Error_Pv_Verific_0001 "EyeQ_Fatal_Error_Pv_Verificattion_Error_Fault_13_7";
BA_ "GenSigSendType" SG_ 1809 EyeQ_Fatal_Error_Pv_General_0001 0;
BA_ "SystemSignalLongSymbol" SG_ 1809 EyeQ_Fatal_Error_Pv_General_0001 "EyeQ_Fatal_Error_Pv_General_Error_Fault_13_6";
BA_ "GenSigSendType" SG_ 1809 EyeQ_Fatal_Error_Pll_Compar_0001 0;
BA_ "SystemSignalLongSymbol" SG_ 1809 EyeQ_Fatal_Error_Pll_Compar_0001 "EyeQ_Fatal_Error_Pll_Comparison_Error_Fault_13_5";
BA_ "GenSigSendType" SG_ 1809 EyeQ_Fatal_Error_App_Patter_0001 0;
BA_ "SystemSignalLongSymbol" SG_ 1809 EyeQ_Fatal_Error_App_Patter_0001 "EyeQ_Fatal_Error_App_Pattern_Test_Fault_13_3";
BA_ "GenSigSendType" SG_ 1809 Host_ENET_VersionMismatch_E_0001 0;
BA_ "SystemSignalLongSymbol" SG_ 1809 Host_ENET_VersionMismatch_E_0001 "Host_ENET_VersionMismatch_Err_B8_4";
BA_ "GenSigSendType" SG_ 1809 Host_ENET_Missing_Message_E_0001 0;
BA_ "SystemSignalLongSymbol" SG_ 1809 Host_ENET_Missing_Message_E_0001 "Host_ENET_Missing_Message_Err_B8_1";
BA_ "GenSigSendType" SG_ 1809 NVM_E_REQ_FAILED_B0_7 0;
BA_ "GenSigSendType" SG_ 1809 NVM_E_QUEUE_OVERFLOW_FAULT_0_4 0;
BA_ "GenSigSendType" SG_ 1809 NVM_E_LOSS_OF_REDUNDANCY_B0_6 0;
BA_ "GenSigSendType" SG_ 1809 NVM_E_INTEGRITY_FAILED_FAULT_0_5 0;
BA_ "GenSigSendType" SG_ 1809 NBID_CRC_BOOT_REPORTED_B8_0 0;
BA_ "GenSigSendType" SG_ 1809 MISSING_CAMERA_CALIBRATION_Bf_5 0;
BA_ "GenSigSendType" SG_ 1809 MCU4_RollingCounter_B39_6 0;
BA_ "GenSigSendType" SG_ 1809 MCU4_CheckSum_B3d_6 0;
BA_ "GenSigSendType" SG_ 1809 MCU_FD1_Timeout_B28_0 0;
BA_ "GenSigSendType" SG_ 1809 MCU_FD1_ActTrq_Invalid_B33_1 0;
BA_ "GenSigSendType" SG_ 1809 Host_ENET_MessageReception__0001 0;
BA_ "SystemSignalLongSymbol" SG_ 1809 Host_ENET_MessageReception__0001 "Host_ENET_MessageReception_Err_B8_3";
BA_ "GenSigSendType" SG_ 1809 IFC_FD1_0x12B_Mute_B22_1 0;
BA_ "GenSigSendType" SG_ 1809 HUT_FD1_TSR_SnvtySet_B30_2 0;
BA_ "GenSigSendType" SG_ 1809 HUT_FD1_Timeout_B26_2 0;
BA_ "GenSigSendType" SG_ 1809 HUT_FD1_NavSpdLimValue_B30_4 0;
BA_ "GenSigSendType" SG_ 1809 HUT_FD1_NavSpdLimUnit_B30_5 0;
BA_ "GenSigSendType" SG_ 1809 HUT_FD1_LSSWarnFormSwtReq_B30_1 0;
BA_ "GenSigSendType" SG_ 1809 HUT_FD1_IFC_SnvtySet_Abnor_B30_0 0;
BA_ "GenSigSendType" SG_ 1809 HUT_FD1_FCW_SnvtySet_Abnor_B30_7 0;
BA_ "GenSigSendType" SG_ 1809 HOST_HEATER_PWR_AURIX_B7_6 0;
BA_ "GenSigSendType" SG_ 1809 Host_ENET_Missing_Data_Err_B8_2 0;
BA_ "GenSigSendType" SG_ 1809 GRAB_VIDEO_TIMEOUT_B4_7 0;
BA_ "GenSigSendType" SG_ 1809 Frozen_Windshield_Fault_11_3 0;
BA_ "GenSigSendType" SG_ 1809 FET_Fault_Across_cycles_B2_4 0;
BA_ "GenSigSendType" SG_ 1809 FEE_E_WRITE_FAULT_B1_1 0;
BA_ "GenSigSendType" SG_ 1809 FEE_E_WRITE_CYCLES_EXHAUST_B2_0 0;
BA_ "GenSigSendType" SG_ 1809 FEE_E_UNCONFIG_BLK_EXCEED_B2_2 0;
BA_ "GenSigSendType" SG_ 1809 FEE_E_READ_FAULT_B1_2 0;
BA_ "GenSigSendType" SG_ 1809 FEE_E_INVALIDATE_FAULT_B1_7 0;
BA_ "GenSigSendType" SG_ 1809 FEE_E_GC_WRITE_FAULT_B1_3 0;
BA_ "GenSigSendType" SG_ 1809 FEE_E_GC_TRIG_FAULT_B2_1 0;
BA_ "GenSigSendType" SG_ 1809 FEE_E_GC_INIT_FAULT_B1_0 0;
BA_ "GenSigSendType" SG_ 1809 FEE_E_GC_ERASE_FAULT_B1_6 0;
BA_ "GenSigSendType" SG_ 1809 FactoryMode_B20_7 0;
BA_ "GenSigSendType" SG_ 1809 F_PBox1_Timeout_B24_3 0;
BA_ "GenSigSendType" SG_ 1809 EYQQ_ROAD_INFO_COUNTER_ERROR_2_6 0;
BA_ "GenSigSendType" SG_ 1809 EYEQ_VISION_SAFETY_DIAG_RFC_B5_3 0;
BA_ "GenSigSendType" SG_ 1809 EYEQ_VISION_SAFETY_DIAG_CRC_B5_2 0;
BA_ "GenSigSendType" SG_ 1809 EYEQ_VISION_AEB_INFO_RFC_B5_1 0;
BA_ "GenSigSendType" SG_ 1809 EYEQ_VISION_AEB_INFO_CRC_B5_0 0;
BA_ "GenSigSendType" SG_ 1809 EYEQ_VIS_OBSTACLES_INFO_RFC_B5_6 0;
BA_ "GenSigSendType" SG_ 1809 EYEQ_VIS_OBSTACLES_INFO_CRC_B5_5 0;
BA_ "GenSigSendType" SG_ 1809 EYEQ_VIS_FAILSAFESRFCFAULT_B6_4 0;
BA_ "GenSigSendType" SG_ 1809 EYEQ_VIS_FAILSAFESCRCFAULT_B6_3 0;
BA_ "GenSigSendType" SG_ 1809 EYEQ_STATIC_RFC_FAULT_B6_2 0;
BA_ "GenSigSendType" SG_ 1809 EYEQ_DYNAMIC_RFC_FAULT_B6_0 0;
BA_ "GenSigSendType" SG_ 1809 EYEQ_DYNAMIC_CRC_FAULT_B5_7 0;
BA_ "GenSigSendType" SG_ 1809 EYEQ_ROAD_INFO_CRC_FAULT_B5_4 0;
BA_ "GenSigSendType" SG_ 1809 EYEQ_OTA_SWAP_FAULT_B7_5 0;
BA_ "GenSigSendType" SG_ 1809 EYEQ_GEN_CR_ERR_FAULT_B2_3 0;
BA_ "GenSigSendType" SG_ 1809 ESP2_VehStandstill_Invalid_B2c_2 0;
BA_ "GenSigSendType" SG_ 1809 ESP2_Timeout_B27_4 0;
BA_ "GenSigSendType" SG_ 1809 ESP2_RollingCounter_B37_4 0;
BA_ "GenSigSendType" SG_ 1809 ESP2_HDCCtrl_Abnormal_B35_5 0;
BA_ "GenSigSendType" SG_ 1809 ESP2_DrivingModDis_Abnor_B35_6 0;
BA_ "GenSigSendType" SG_ 1809 ESP2_CheckSum_B3b_4 0;
BA_ "GenSigSendType" SG_ 1809 ESP2_CDDAvailable_Error_B2c_0 0;
BA_ "GenSigSendType" SG_ 1809 ESP2_AWBAvailable_Error_B2d_2 0;
BA_ "GenSigSendType" SG_ 1809 ESP2_AEBAvailable_Error_B2c_4 0;
BA_ "GenSigSendType" SG_ 1809 ESP2_ABPAvailable_Error_B2c_6 0;
BA_ "GenSigSendType" SG_ 1809 ESP2_ABAavailable_Error_B2d_0 0;
BA_ "GenSigSendType" SG_ 1809 ESP1_Timeout_B27_3 0;
BA_ "GenSigSendType" SG_ 1809 ESP1_RollingCounter_B37_3 0;
BA_ "GenSigSendType" SG_ 1809 ESP1_MasterCylBrkPress_B2b_0 0;
BA_ "GenSigSendType" SG_ 1809 ESP1_ESPFailSts_Failure_B2b_6 0;
BA_ "GenSigSendType" SG_ 1809 ESP1_CheckSum_B3b_3 0;
BA_ "GenSigSendType" SG_ 1809 ESP_FD3_Timeout_B27_7 0;
BA_ "GenSigSendType" SG_ 1809 ESP_FD3_SwtPosn_Invalid_B2e_1 0;
BA_ "GenSigSendType" SG_ 1809 ESP_FD3_RRWheelSpd_Invalid_B2a_7 0;
BA_ "GenSigSendType" SG_ 1809 ESP_FD3_RRWhDriveDirection_B29_3 0;
BA_ "GenSigSendType" SG_ 1809 ESP_FD3_RLWheelSpd_Invalid_B2a_5 0;
BA_ "GenSigSendType" SG_ 1809 ESP_FD3_RLWhDriveDirection_B29_1 0;
BA_ "GenSigSendType" SG_ 1809 ESP_FD3_FRWheelSpd_Invalid_B2a_3 0;
BA_ "GenSigSendType" SG_ 1809 ESP_FD3_FRWhDriveDirection_B29_7 0;
BA_ "GenSigSendType" SG_ 1809 ESP_FD3_FLWheelSpd_Invalid_B2a_1 0;
BA_ "GenSigSendType" SG_ 1809 ESP_FD3_FLWhDriveDirection_B29_5 0;
BA_ "GenSigSendType" SG_ 1809 ESP_FD3_EPBSts_Error_B2e_5 0;
BA_ "GenSigSendType" SG_ 1809 ESP_FD3_EPBErrSts_Error_B2e_3 0;
BA_ "GenSigSendType" SG_ 1809 ESP_FD3_EPB1_RollCounter_B38_2 0;
BA_ "GenSigSendType" SG_ 1809 ESP_FD3_EPB1_CheckSum_B3c_2 0;
BA_ "GenSigSendType" SG_ 1809 ESP_FD3_ABS2_RollCounter_B38_4 0;
BA_ "GenSigSendType" SG_ 1809 ESP_FD3_ABS2_CheckSum_B3c_4 0;
BA_ "GenSigSendType" SG_ 1809 ESP_FD3_ABS1_RollCounter_B38_3 0;
BA_ "GenSigSendType" SG_ 1809 ESP_FD3_ABS1_CheckSum_B3c_3 0;
BA_ "GenSigSendType" SG_ 1809 ESP_FD2_VehStandstill_B2c_3 0;
BA_ "GenSigSendType" SG_ 1809 ESP_FD2_VehSpd_Missing_B21_5 0;
BA_ "GenSigSendType" SG_ 1809 ESP_FD2_VehSpd_Invalid_B2b_5 0;
BA_ "GenSigSendType" SG_ 1809 ESP_FD2_Timeout_B27_6 0;
BA_ "GenSigSendType" SG_ 1809 ESP_FD2_MasterCylBrkPress_B2b_1 0;
BA_ "GenSigSendType" SG_ 1809 ESP_FD2_ESPFailSts_Failure_B2b_7 0;
BA_ "GenSigSendType" SG_ 1809 ESP_FD2_ESP2_RollCounter_B38_7 0;
BA_ "GenSigSendType" SG_ 1809 ESP_FD2_ESP2_CheckSum_B3c_7 0;
BA_ "GenSigSendType" SG_ 1809 ESP_FD2_ESP1_RollCounter_B38_6 0;
BA_ "GenSigSendType" SG_ 1809 ESP_FD2_ESP1_CheckSum_B3c_6 0;
BA_ "GenSigSendType" SG_ 1809 ESP_FD2_CDDAvailable_Error_B2c_1 0;
BA_ "GenSigSendType" SG_ 1809 ESP_FD2_AWBAvailable_Error_B2d_3 0;
BA_ "GenSigSendType" SG_ 1809 ESP_FD2_AEBAvailable_Error_B2c_5 0;
BA_ "GenSigSendType" SG_ 1809 ESP_FD2_ABSFailSts_Failure_B2b_3 0;
BA_ "GenSigSendType" SG_ 1809 ESP_FD2_ABS3_RollCounter_B38_5 0;
BA_ "GenSigSendType" SG_ 1809 ESP_FD2_ABS3_CheckSum_B3c_5 0;
BA_ "GenSigSendType" SG_ 1809 ESP_FD2_ABPAvailable_Error_B2c_7 0;
BA_ "GenSigSendType" SG_ 1809 ESP_FD2_ABAavailable_Error_B2d_1 0;
BA_ "GenSigSendType" SG_ 1809 EPS2_Timeout_B26_1 0;
BA_ "GenSigSendType" SG_ 1809 EPS2_RollingCounter_B36_6 0;
BA_ "GenSigSendType" SG_ 1809 EPS2_LKATrqOvlDlvdSts_Temp_B2f_6 0;
BA_ "GenSigSendType" SG_ 1809 EPS2_LKATrqOvlDlvdSts_Perm_B2f_7 0;
BA_ "GenSigSendType" SG_ 1809 EPS2_CheckSum_B3a_6 0;
BA_ "GenSigSendType" SG_ 1809 EPS1_Timeout_B26_0 0;
BA_ "GenSigSendType" SG_ 1809 EPS1_SteerMod_Abnormal_B32_1 0;
BA_ "GenSigSendType" SG_ 1809 EPS1_EPSFailSts_Failure_B32_0 0;
BA_ "GenSigSendType" SG_ 1809 EPB1_Timeout_B27_5 0;
BA_ "GenSigSendType" SG_ 1809 EPB1_SwtPosn_Invalid_B2e_0 0;
BA_ "GenSigSendType" SG_ 1809 EPB1_RollingCounter_B37_5 0;
BA_ "GenSigSendType" SG_ 1809 EPB1_EPBSts_Error_B2e_4 0;
BA_ "GenSigSendType" SG_ 1809 EPB1_EPBErrSts_Error_B2e_2 0;
BA_ "GenSigSendType" SG_ 1809 EPB1_CheckSum_B3b_5 0;
BA_ "GenSigSendType" SG_ 1809 ECM9_Timeout_B23_6 0;
BA_ "GenSigSendType" SG_ 1809 ECM9_RollingCounter_B38_1 0;
BA_ "GenSigSendType" SG_ 1809 ECM9_ECMACCInterface_Error_B34_6 0;
BA_ "GenSigSendType" SG_ 1809 ECM9_Checksum_B3c_1 0;
BA_ "GenSigSendType" SG_ 1809 ECM8_TrqLoss_Invalid_B34_5 0;
BA_ "GenSigSendType" SG_ 1809 ECM8_Timeout_B23_5 0;
BA_ "GenSigSendType" SG_ 1809 ECM7_Timeout_B23_4 0;
BA_ "GenSigSendType" SG_ 1809 ECM4_Timeout_B23_3 0;
BA_ "GenSigSendType" SG_ 1809 ECM4_RollingCounter_B38_0 0;
BA_ "GenSigSendType" SG_ 1809 ECM4_NetEngTrq_Invalid_B34_3 0;
BA_ "GenSigSendType" SG_ 1809 ECM4_DrvEngTrqReq_Invalid_B34_4 0;
BA_ "GenSigSendType" SG_ 1809 ECM4_Checksum_B3c_0 0;
BA_ "GenSigSendType" SG_ 1809 ECM3_Timeout_B23_2 0;
BA_ "GenSigSendType" SG_ 1809 ECM3_MaxEngTrqNorm_Abnorm_B34_2 0;
BA_ "GenSigSendType" SG_ 1809 ECM2_Timeout_B23_1 0;
BA_ "GenSigSendType" SG_ 1809 ECM2_AccelPedalPosn_Invd_B2d_6 0;
BA_ "GenSigSendType" SG_ 1809 ECM1_Timeout_B23_0 0;
BA_ "GenSigSendType" SG_ 1809 ECM1_Start_StopSts_Invalid_B34_1 0;
BA_ "GenSigSendType" SG_ 1809 ECM1_RollingCounter_B37_7 0;
BA_ "GenSigSendType" SG_ 1809 ECM1_Checksum_B3b_7 0;
BA_ "GenSigSendType" SG_ 1809 ECM1_BrkPedalSts_Error_B2d_4 0;
BA_ "GenSigSendType" SG_ 1809 DCT7_Timeout_B24_1 0;
BA_ "GenSigSendType" SG_ 1809 DCT7_DrvFaiMsg_Failure_B35_4 0;
BA_ "GenSigSendType" SG_ 1809 DCT5_Timeout_B24_0 0;
BA_ "GenSigSendType" SG_ 1809 DCT5_TARGET_GEAR_Invalid_B35_2 0;
BA_ "GenSigSendType" SG_ 1809 DCT5_ShiftInPrg_Invalid_B35_1 0;
BA_ "GenSigSendType" SG_ 1809 DCT5_RollingCounter_B37_6 0;
BA_ "GenSigSendType" SG_ 1809 DCT5_CurrentGear_Invalid_B35_0 0;
BA_ "GenSigSendType" SG_ 1809 DCT5_CheckSum_B3b_6 0;
BA_ "GenSigSendType" SG_ 1809 DCT3_Timeout_B23_7 0;
BA_ "GenSigSendType" SG_ 1809 CSA2_Timeout_B25_4 0;
BA_ "GenSigSendType" SG_ 1809 CSA2_SteerWheelSpd_Invalid_B31_2 0;
BA_ "GenSigSendType" SG_ 1809 CSA2_SteerWheelAng_Invalid_B31_1 0;
BA_ "GenSigSendType" SG_ 1809 CSA2_SAS_Sts_Error_B31_4 0;
BA_ "GenSigSendType" SG_ 1809 CSA2_Rollingcounter_B36_5 0;
BA_ "GenSigSendType" SG_ 1809 CSA2_Checksum_B3a_5 0;
BA_ "GenSigSendType" SG_ 1809 CSA2_CC_ACCSwt_Error_B31_3 0;
BA_ "GenSigSendType" SG_ 1809 CSA1_Timeout_B25_3 0;
BA_ "GenSigSendType" SG_ 1809 CSA1_FrntWiprSwtSts_Error_B31_0 0;
BA_ "GenSigSendType" SG_ 1809 Vision_Internal_Error_B1f_6 0;
BA_ "GenSigSendType" SG_ 1809 EyeQ_Spi_Msg_Timeout_A_7 0;
BA_ "GenSigSendType" SG_ 1809 Host_Spi_CRC_Error_A_2 0;
BA_ "GenSigSendType" SG_ 1809 Host_Spi_Tx_Error_A_1 0;
BA_ "GenSigSendType" SG_ 1809 Host_spi_msg_timeout_A_0 0;
BA_ "GenSigSendType" SG_ 1809 EyeQ_Calibration_Checksum_9_4 0;
BA_ "GenSigSendType" SG_ 1809 Imager_2V8_Supply_OutRange_6_7 0;
BA_ "GenSigSendType" SG_ 1809 Aurix_1V25_Supply_OutRange_B6_6 0;
BA_ "GenSigSendType" SG_ 1809 Imager_1V2_Supply_OutRange_6_5 0;
BA_ "GenSigSendType" SG_ 1809 Battery_High_Fault_B21_2 0;
BA_ "GenSigSendType" SG_ 1809 Battery_Low_Fault_B21_1 0;
BA_ "GenSigSendType" SG_ 1809 PS_5V0_Out_Of_Range_4_4 0;
BA_ "GenSigSendType" SG_ 1809 EyeQDDROnBrdThermstorOutRang_4_3 0;
BA_ "GenSigSendType" SG_ 1809 EyeQDDROnBrdThermstorOveTemp_4_1 0;
BA_ "GenSigSendType" SG_ 1809 EyeQ_Temp_Exceeded_3_0 0;
BA_ "GenSigSendType" SG_ 1809 SYSTEM_OVER_TEMPERATURE_2_7 0;
BA_ "GenSigSendType" SG_ 1809 EyeQ_Error_Out_Temp_Fault_1A_6 0;
BA_ "GenSigSendType" SG_ 1809 EyeQErrOutSignalInternFault_1A_5 0;
BA_ "GenSigSendType" SG_ 1809 EyeQ_Camera1_Temp_Fault_1A_4 0;
BA_ "GenSigSendType" SG_ 1809 EyeQVdoErrFlg_ShotOutOfSync_1A_3 0;
BA_ "GenSigSendType" SG_ 1809 EyeQVdoErrFlg_VdiErrShutdwn_1A_2 0;
BA_ "GenSigSendType" SG_ 1809 EyeQVdoErrFlg_HdrVerifiErr_1A_1 0;
BA_ "GenSigSendType" SG_ 1809 EyeQVdoErrFlg_CcftDecisionMismat 0;
BA_ "GenSigSendType" SG_ 1809 EyeQVdoErrFlg_HistogramsMismatch 0;
BA_ "GenSigSendType" SG_ 1809 EyeQVdoErrFlg_FrameCountReadFail 0;
BA_ "GenSigSendType" SG_ 1809 EyeQVdoErrFlgVdiErr_CoreIdFlt 0;
BA_ "GenSigSendType" SG_ 1809 EyeQVdoErrFlgVdiErr_StrtAftStrt 0;
BA_ "GenSigSendType" SG_ 1809 EyeQVdoErrFlgVdiErr_ParityHisFlt 0;
BA_ "GenSigSendType" SG_ 1809 EyeQVdoErrFlgVdiErr_ParityGamma 0;
BA_ "GenSigSendType" SG_ 1809 EyeQVdoErrFlgVdiErr_ParityWeight 0;
BA_ "GenSigSendType" SG_ 1809 EyeQVdoErrFlgVdiErr_ParityFifo 0;
BA_ "GenSigSendType" SG_ 1809 EyeQVdoErrFlgVdiErrFifo_Undflow 0;
BA_ "GenSigSendType" SG_ 1809 EyeQVdoErrFlgVdiErrFifo_Overflow 0;
BA_ "GenSigSendType" SG_ 1809 EyeQVdoErrFlgVdiErr_Timeout_18_5 0;
BA_ "GenSigSendType" SG_ 1809 EyeQVdoErrFlgVdiErr_BuffInvldFmt 0;
BA_ "GenSigSendType" SG_ 1809 EyeQVdoErrFlg_Vdi_ErrNoBuff_18_3 0;
BA_ "GenSigSendType" SG_ 1809 EyeQVdoErrFlgVdi_InternErr18_2 0;
BA_ "GenSigSendType" SG_ 1809 EyeQVdoErrFlgSumNotMatHistgrmErr 0;
BA_ "GenSigSendType" SG_ 1809 EyeQVdoErrFlgZeroHistgrmErr_18_0 0;
BA_ "GenSigSendType" SG_ 1809 EyeQVdoErrFlgRegWrtHilFailErr 0;
BA_ "GenSigSendType" SG_ 1809 EyeQVdoErrFlgErrRegFlagFlt_17_6 0;
BA_ "GenSigSendType" SG_ 1809 EyeQVdoErrFlgInvldVdoHeaderFault 0;
BA_ "GenSigSendType" SG_ 1809 EyeQVdoErrFlgVerifiFailVdoErr 0;
BA_ "GenSigSendType" SG_ 1809 EyeQVdoErrFlgInconstFramVdoErr 0;
BA_ "GenSigSendType" SG_ 1809 EyeQ_Cam1VdoErrFlgLgcVdoErr_17_2 0;
BA_ "GenSigSendType" SG_ 1809 EyeQCam1VdoErrFlgI2CNoOnTmVdoErr 0;
BA_ "GenSigSendType" SG_ 1809 EyeQCam1VdoErrFlgVdiVdoErr_17_0 0;
BA_ "GenSigSendType" SG_ 1809 EyeQ_Cam_Vdo_Flt_16_7 0;
BA_ "GenSigSendType" SG_ 1809 EyeQ_Cam_Ctrl_Flt_16_6 0;
BA_ "GenSigSendType" SG_ 1809 EyeQ_Cam_Mal_Func_16_5 0;
BA_ "GenSigSendType" SG_ 1809 Grab_Release_Failure_16_4 0;
BA_ "GenSigSendType" SG_ 1809 Grab_Acquire_Failure_16_3 0;
BA_ "GenSigSendType" SG_ 1809 Grab_Issue_Failure_16_2 0;
BA_ "GenSigSendType" SG_ 1809 Grab_No_Free_Header_Failure_16_1 0;
BA_ "GenSigSendType" SG_ 1809 Init_I2C_Failure_16_0 0;
BA_ "GenSigSendType" SG_ 1809 Init_Vdi_Failure_15_7 0;
BA_ "GenSigSendType" SG_ 1809 EyeQFatalErrApCamParaCcftCrc13_4 0;
BA_ "GenSigSendType" SG_ 1809 EyeQFatalErrAppI2CTimoutErr_13_2 0;
BA_ "GenSigSendType" SG_ 1809 EyeQFatalErrAppI2CCamSlfRst_13_1 0;
BA_ "GenSigSendType" SG_ 1809 EyeQFatalErrAppI2CVidoGrb_13_0 0;
BA_ "GenSigSendType" SG_ 1809 EYEQ_GEN54ACCSTLEXECUTFAILED_F_3 0;
BA_ "GenSigSendType" SG_ 1809 EYEQ_GEN_26_CODE_CRC_E_1 0;
BA_ "GenSigSendType" SG_ 1809 EyeQ_Core_Dump_Fault_C_5 0;
BA_ "GenSigSendType" SG_ 1809 EyeQ_Init_Timeout_Fault_C_4 0;
BA_ "GenSigSendType" SG_ 1809 EYEQ4_Mode_Fault_C_3 0;
BA_ "GenSigSendType" SG_ 1809 EyeQ_Bist_Memory_Fault_C_2 0;
BA_ "GenSigSendType" SG_ 1809 EyeQ_Core_Fault_C_1 0;
BA_ "GenSigSendType" SG_ 1809 EyeQ_Boot_Fault_C_0 0;
BA_ "GenSigSendType" SG_ 1809 EyeQ_DDR_Fault_B_6 0;
BA_ "GenSigSendType" SG_ 1809 EyeQ_SerialFlashPowerUp_Fail_B_1 0;
BA_ "GenSigSendType" SG_ 1809 EyeQ_SPI_CRC_ERROR_B_0 0;
BA_ "GenSigSendType" SG_ 1809 EYEQ_Spi_Msg_Format_Error_A_6 0;
BA_ "GenSigSendType" SG_ 1809 EyeQ_Spi_Frame_Format_Error_A_5 0;
BA_ "GenSigSendType" SG_ 1809 Spi_Ipc_Comm_Reset_A_4 0;
BA_ "GenSigSendType" SG_ 1809 Spi_version_mismatch_A_3 0;
BA_ "GenSigSendType" SG_ 1809 Host_Spi_Msg_Format_Error_9_7 0;
BA_ "GenSigSendType" SG_ 1809 Host_Spi_Frame_Format_Error_9_6 0;
BA_ "GenSigSendType" SG_ 1809 EyeQ_Application_Checksum_9_3 0;
BA_ "GenSigSendType" SG_ 1809 EyeQAppl_CompltAndComptibl_9_2 0;
BA_ "GenSigSendType" SG_ 1809 EyeQOnBoardThermstorOutRange_4_2 0;
BA_ "GenSigSendType" SG_ 1809 EyeQ_DDR_Over_Temp_4_0 0;
BA_ "GenSigSendType" SG_ 1809 EyeQ_Boot_OverTemp_Fault_3_7 0;
BA_ "GenSigSendType" SG_ 1809 EyeQ_Imager_Over_Temp_3_6 0;
BA_ "GenSigSendType" SG_ 1809 EyeQ_VMP_Over_Temp_3_5 0;
BA_ "GenSigSendType" SG_ 1809 EyeQ_MIPS_Over_Temp_3_4 0;
BA_ "GenSigSendType" SG_ 1809 EyeQOnBoardThermistorOveTemp_3_1 0;
BA_ "GenSigSendType" SG_ 1809 EYEQ_1V0_SUPPLY_OUT_OF_RANGE_0_3 0;
BA_ "GenSigSendType" SG_ 1809 EYEQ_1V1_SUPPLY_OUT_OF_RANGE_0_2 0;
BA_ "GenSigSendType" SG_ 1809 EYEQ_1V8_SUPPLY_OUT_OF_RANGE_0_1 0;
BA_ "GenSigSendType" SG_ 1809 EYEQ_3V3_SUPPLY_OUT_OF_RANGE_0_0 0;
BA_ "SystemSignalLongSymbol" SG_ 1809 Windshield_heater_OPNLD_Err_0001 "Windshield_heater_OPNLD_Error_B3E_0";
BA_ "SystemSignalLongSymbol" SG_ 1809 WWINDSHIELD_HEATER_STG_FAUL_0001 "WWINDSHIELD_HEATER_STG_FAULT_B3E_1";
BA_ "SystemSignalLongSymbol" SG_ 1809 WINDSHIELD_HEATER_OVRLD_FAU_0001 "WINDSHIELD_HEATER_OVRLD_FAULT_B3E_2";
BA_ "SystemSignalLongSymbol" SG_ 1809 WINDSHIELD_HEATER_STB_FAULT_0001 "WINDSHIELD_HEATER_STB_FAULT_B3E_3";
BA_ "GenSigSendType" SG_ 1808 DCT3_RatAct_Error_B2e_7 0;
BA_ "GenSigSendType" SG_ 1808 ECM2_EngState_Error_B2e_6 0;
BA_ "SystemSignalLongSymbol" SG_ 1808 EYEQ_MINOR_ERROR_BM_EM_ERR__0002 "EYEQ_MINOR_ERROR_BM_EM_ERR_FAILED_NB_OPERATION_FAULT_B15_6";
BA_ "GenSigSendType" SG_ 1808 EYEQ_STATIC_CRC_FAULT_B6_1 0;
BA_ "GenSigSendType" SG_ 1808 FEE_E_GC_READ_FAULT_B1_4 0;
BA_ "GenSigSendType" SG_ 1808 EYEQ_GEN_34_Corrupted_Vehic_0002 0;
BA_ "SystemSignalLongSymbol" SG_ 1808 EYEQ_GEN_34_Corrupted_Vehic_0002 "EYEQ_GEN_34_Corrupted_Vehicle_Info_Input_Signals_Bf_1";
BA_ "GenSigSendType" SG_ 1808 EYEQ_GEN_11_INPUT_CRC_MISMA_0002 0;
BA_ "SystemSignalLongSymbol" SG_ 1808 EYEQ_GEN_11_INPUT_CRC_MISMA_0002 "EYEQ_GEN_11_INPUT_CRC_MISMATCH_Bf_0";
BA_ "GenSigSendType" SG_ 1808 EYEQ_GEN_4_YAW_HORIZON_DEVI_0002 0;
BA_ "SystemSignalLongSymbol" SG_ 1808 EYEQ_GEN_4_YAW_HORIZON_DEVI_0002 "EYEQ_GEN_4_YAW_HORIZON_DEVIATION_Be_0";
BA_ "GenSigSendType" SG_ 1808 EYEQ_GEN_18_IMAGER_DATA_ROW_0002 0;
BA_ "SystemSignalLongSymbol" SG_ 1808 EYEQ_GEN_18_IMAGER_DATA_ROW_0002 "EYEQ_GEN_18_IMAGER_DATA_ROWS_COLS_Bd_7";
BA_ "GenSigSendType" SG_ 1808 EYEQ_GEN_13_OLD_EGODATA_LAT_Be_2 0;
BA_ "GenSigSendType" SG_ 1808 AEB_shutdown_9_ROI_DIFF_VC__0002 0;
BA_ "SystemSignalLongSymbol" SG_ 1808 AEB_shutdown_9_ROI_DIFF_VC__0002 "AEB_shutdown_9_ROI_DIFF_VC_FCV_Bd_3";
BA_ "GenSigSendType" SG_ 1808 AEB_shutdown_7_POS_DIFF_KAL_0002 0;
BA_ "SystemSignalLongSymbol" SG_ 1808 AEB_shutdown_7_POS_DIFF_KAL_0002 "AEB_shutdown_7_POS_DIFF_KALMAN_VAL_Bd_2";
BA_ "GenSigSendType" SG_ 1808 EYEQ_GEN_50_VMP_SANITY_FAIL_0002 0;
BA_ "SystemSignalLongSymbol" SG_ 1808 EYEQ_GEN_50_VMP_SANITY_FAIL_0002 "EYEQ_GEN_50_VMP_SANITY_FAILED_FAULT_1b_0";
BA_ "GenSigSendType" SG_ 1808 EYEQ_FATAL_ERROR_APP_CPS_ST_0002 0;
BA_ "SystemSignalLongSymbol" SG_ 1808 EYEQ_FATAL_ERROR_APP_CPS_ST_0002 "EYEQ_FATAL_ERROR_APP_CPS_STL_FAILED_FAULT_12_2";
BA_ "GenSigSendType" SG_ 1808 EYEQ_GEN_24_CCFT_DIFF_RESUL_0002 0;
BA_ "SystemSignalLongSymbol" SG_ 1808 EYEQ_GEN_24_CCFT_DIFF_RESUL_0002 "EYEQ_GEN_24_CCFT_DIFF_RESULTS_FAULT_1c_3";
BA_ "SystemSignalLongSymbol" SG_ 1808 EYEQ_53_DECELERATION_DBS_OV_0002 "EYEQ_53_DECELERATION_DBS_OVERLAP_FAULT_B1c_2";
BA_ "SystemSignalLongSymbol" SG_ 1808 EYEQ_44_ROAD_SANITY_CORRECT_0002 "EYEQ_44_ROAD_SANITY_CORRECTION_VALIDATION_FAULT_B1c_1";
BA_ "GenSigSendType" SG_ 1808 EYEQ_GEN_21_CAMERA_HEIGHT_L_0002 0;
BA_ "SystemSignalLongSymbol" SG_ 1808 EYEQ_GEN_21_CAMERA_HEIGHT_L_0002 "EYEQ_GEN_21_CAMERA_HEIGHT_LIMIT_EXCEEDED_FAULT_1c_0";
BA_ "GenSigSendType" SG_ 1808 EYEQ_FATAL_ERROR_APP_INVALI_0002 0;
BA_ "SystemSignalLongSymbol" SG_ 1808 EYEQ_FATAL_ERROR_APP_INVALI_0002 "EYEQ_FATAL_ERROR_APP_INVALID_INTRINSIC_CALIB_FAULT_1b_5";
BA_ "SystemSignalLongSymbol" SG_ 1808 EYEQ_45_ROAD_SFCONF_VALIDAT_0002 "EYEQ_45_ROAD_SFCONF_VALIDATION_B1b_2";
BA_ "SystemSignalLongSymbol" SG_ 1808 EYEQ_48_ALGO_PITCH_MISMATCH_0002 "EYEQ_48_ALGO_PITCH_MISMATCH_B1b_1";
BA_ "GenSigSendType" SG_ 1808 EyeQ_Minor_Error_Bm_Error_F_0002 0;
BA_ "SystemSignalLongSymbol" SG_ 1808 EyeQ_Minor_Error_Bm_Error_F_0002 "EyeQ_Minor_Error_Bm_Error_Fault_14_0";
BA_ "GenSigSendType" SG_ 1808 EyeQ_Fatal_Error_App_Init_F_0002 0;
BA_ "SystemSignalLongSymbol" SG_ 1808 EyeQ_Fatal_Error_App_Init_F_0002 "EyeQ_Fatal_Error_App_Init_Failed_Fault_12_6";
BA_ "GenSigSendType" SG_ 1808 EyeQ_Fatal_Error_App_Init_C_0002 0;
BA_ "SystemSignalLongSymbol" SG_ 1808 EyeQ_Fatal_Error_App_Init_C_0002 "EyeQ_Fatal_Error_App_Init_Camera_Init_Fault_12_7";
BA_ "GenSigSendType" SG_ 1808 EyeQ_Fatal_Error_App_Fs_Err_0002 0;
BA_ "SystemSignalLongSymbol" SG_ 1808 EyeQ_Fatal_Error_App_Fs_Err_0002 "EyeQ_Fatal_Error_App_Fs_Error_Fault_12_4";
BA_ "GenSigSendType" SG_ 1808 EyeQ_Fatal_Error_App_Error__0002 0;
BA_ "SystemSignalLongSymbol" SG_ 1808 EyeQ_Fatal_Error_App_Error__0002 "EyeQ_Fatal_Error_App_Error_Fault_12_3";
BA_ "GenSigSendType" SG_ 1808 EyeQ_Fatal_Error_App_Calibr_0002 0;
BA_ "SystemSignalLongSymbol" SG_ 1808 EyeQ_Fatal_Error_App_Calibr_0002 "EyeQ_Fatal_Error_App_Calibration_Error_Fault_12_5";
BA_ "SystemSignalLongSymbol" SG_ 1808 EYEQ_33_ROAD_LANE_DISQUALIF_0002 "EYEQ_33_ROAD_LANE_DISQUALIFICATINO_FAILED_B1b_4";
BA_ "SystemSignalLongSymbol" SG_ 1808 EYEQ_42_ROAD_PREDICTION_VAL_0002 "EYEQ_42_ROAD_PREDICTION_VALIDATION_B1b_3";
BA_ "SystemSignalLongSymbol" SG_ 1808 EYEQ_MES_49_Data_Path_Corru_0002 "EYEQ_MES_49_Data_Path_Corruption_B1a_7";
BA_ "GenSigSendType" SG_ 1808 EyeQ_Minor_Error_Bm_Em_Err__0035 0;
BA_ "SystemSignalLongSymbol" SG_ 1808 EyeQ_Minor_Error_Bm_Em_Err__0035 "EyeQ_Minor_Error_Bm_Em_Err_Failed_Post_Init_IL_Fault_15_4";
BA_ "GenSigSendType" SG_ 1808 EyeQ_Minor_Error_Bm_Em_Erro_0002 0;
BA_ "SystemSignalLongSymbol" SG_ 1808 EyeQ_Minor_Error_Bm_Em_Erro_0002 "EyeQ_Minor_Error_Bm_Em_Error_Fault_14_1";
BA_ "GenSigSendType" SG_ 1808 EyeQ_Minor_Error_Bm_Em_Err__0036 0;
BA_ "SystemSignalLongSymbol" SG_ 1808 EyeQ_Minor_Error_Bm_Em_Err__0036 "EyeQ_Minor_Error_Bm_Em_Err_Failed_Post_Init_Ep_Fault_15_2";
BA_ "GenSigSendType" SG_ 1808 EyeQ_Minor_Error_Bm_Em_Err__0037 0;
BA_ "SystemSignalLongSymbol" SG_ 1808 EyeQ_Minor_Error_Bm_Em_Err__0037 "EyeQ_Minor_Error_Bm_Em_Err_Failed_Post_Init_Create_Logger_Fault_15_3";
BA_ "GenSigSendType" SG_ 1808 EyeQ_Minor_Error_Bm_Em_Err__0038 0;
BA_ "SystemSignalLongSymbol" SG_ 1808 EyeQ_Minor_Error_Bm_Em_Err__0038 "EyeQ_Minor_Error_Bm_Em_Err_Failed_Open_Blackbox_Fault_15_0";
BA_ "GenSigSendType" SG_ 1808 EyeQ_Minor_Error_Bm_Em_Err__0039 0;
BA_ "SystemSignalLongSymbol" SG_ 1808 EyeQ_Minor_Error_Bm_Em_Err__0039 "EyeQ_Minor_Error_Bm_Em_Err_Failed_Load_Setting_Fault_14_2";
BA_ "GenSigSendType" SG_ 1808 EyeQ_Minor_Error_Bm_Em_Err__0040 0;
BA_ "SystemSignalLongSymbol" SG_ 1808 EyeQ_Minor_Error_Bm_Em_Err__0040 "EyeQ_Minor_Error_Bm_Em_Err_Failed_Load_Registry_Fault_14_3";
BA_ "GenSigSendType" SG_ 1808 EyeQ_Minor_Error_Bm_Em_Err__0041 0;
BA_ "SystemSignalLongSymbol" SG_ 1808 EyeQ_Minor_Error_Bm_Em_Err__0041 "EyeQ_Minor_Error_Bm_Em_Err_Failed_Init_Registry_Fault_14_4";
BA_ "GenSigSendType" SG_ 1808 EyeQ_Minor_Error_Bm_Em_Err__0042 0;
BA_ "SystemSignalLongSymbol" SG_ 1808 EyeQ_Minor_Error_Bm_Em_Err__0042 "EyeQ_Minor_Error_Bm_Em_Err_Failed_Init_Fault_14_5";
BA_ "GenSigSendType" SG_ 1808 EyeQ_Minor_Error_Bm_Em_Err__0043 0;
BA_ "SystemSignalLongSymbol" SG_ 1808 EyeQ_Minor_Error_Bm_Em_Err__0043 "EyeQ_Minor_Error_Bm_Em_Err_Failed_Init_Ep_Fault_15_1";
BA_ "GenSigSendType" SG_ 1808 EyeQ_Minor_Error_Bm_Em_Err__0044 0;
BA_ "SystemSignalLongSymbol" SG_ 1808 EyeQ_Minor_Error_Bm_Em_Err__0044 "EyeQ_Minor_Error_Bm_Em_Err_Failed_Init_Bb_Reg_Fault_14_7";
BA_ "GenSigSendType" SG_ 1808 EyeQ_Minor_Error_Bm_Em_Err__0045 0;
BA_ "SystemSignalLongSymbol" SG_ 1808 EyeQ_Minor_Error_Bm_Em_Err__0045 "EyeQ_Minor_Error_Bm_Em_Err_Failed_Init_Bb_Fault_14_6";
BA_ "GenSigSendType" SG_ 1808 EyeQ_Minor_Error_Bm_Em_Err__0046 0;
BA_ "SystemSignalLongSymbol" SG_ 1808 EyeQ_Minor_Error_Bm_Em_Err__0046 "EyeQ_Minor_Error_Bm_Em_Err_Failed_Check_Reg_Versions_Fault_15_5";
BA_ "GenSigSendType" SG_ 1808 EyeQ_Fatal_Error_Pv_Verific_0002 0;
BA_ "SystemSignalLongSymbol" SG_ 1808 EyeQ_Fatal_Error_Pv_Verific_0002 "EyeQ_Fatal_Error_Pv_Verificattion_Error_Fault_13_7";
BA_ "GenSigSendType" SG_ 1808 EyeQ_Fatal_Error_Pv_General_0002 0;
BA_ "SystemSignalLongSymbol" SG_ 1808 EyeQ_Fatal_Error_Pv_General_0002 "EyeQ_Fatal_Error_Pv_General_Error_Fault_13_6";
BA_ "GenSigSendType" SG_ 1808 EyeQ_Fatal_Error_Pll_Compar_0002 0;
BA_ "SystemSignalLongSymbol" SG_ 1808 EyeQ_Fatal_Error_Pll_Compar_0002 "EyeQ_Fatal_Error_Pll_Comparison_Error_Fault_13_5";
BA_ "GenSigSendType" SG_ 1808 EyeQ_Fatal_Error_App_Patter_0002 0;
BA_ "SystemSignalLongSymbol" SG_ 1808 EyeQ_Fatal_Error_App_Patter_0002 "EyeQ_Fatal_Error_App_Pattern_Test_Fault_13_3";
BA_ "GenSigSendType" SG_ 1808 Host_ENET_VersionMismatch_E_0002 0;
BA_ "SystemSignalLongSymbol" SG_ 1808 Host_ENET_VersionMismatch_E_0002 "Host_ENET_VersionMismatch_Err_B8_4";
BA_ "GenSigSendType" SG_ 1808 Host_ENET_Missing_Message_E_0002 0;
BA_ "SystemSignalLongSymbol" SG_ 1808 Host_ENET_Missing_Message_E_0002 "Host_ENET_Missing_Message_Err_B8_1";
BA_ "GenSigSendType" SG_ 1808 NVM_E_REQ_FAILED_B0_7 0;
BA_ "GenSigSendType" SG_ 1808 NVM_E_QUEUE_OVERFLOW_FAULT_0_4 0;
BA_ "GenSigSendType" SG_ 1808 NVM_E_LOSS_OF_REDUNDANCY_B0_6 0;
BA_ "GenSigSendType" SG_ 1808 NVM_E_INTEGRITY_FAILED_FAULT_0_5 0;
BA_ "GenSigSendType" SG_ 1808 NBID_CRC_BOOT_REPORTED_B8_0 0;
BA_ "GenSigSendType" SG_ 1808 MISSING_CAMERA_CALIBRATION_Bf_5 0;
BA_ "GenSigSendType" SG_ 1808 MCU4_RollingCounter_B39_6 0;
BA_ "GenSigSendType" SG_ 1808 MCU4_CheckSum_B3d_6 0;
BA_ "GenSigSendType" SG_ 1808 MCU_FD1_Timeout_B28_0 0;
BA_ "GenSigSendType" SG_ 1808 MCU_FD1_ActTrq_Invalid_B33_1 0;
BA_ "GenSigSendType" SG_ 1808 Host_ENET_MessageReception__0002 0;
BA_ "SystemSignalLongSymbol" SG_ 1808 Host_ENET_MessageReception__0002 "Host_ENET_MessageReception_Err_B8_3";
BA_ "GenSigSendType" SG_ 1808 IFC_FD1_0x12B_Mute_B22_1 0;
BA_ "GenSigSendType" SG_ 1808 HUT_FD1_TSR_SnvtySet_B30_2 0;
BA_ "GenSigSendType" SG_ 1808 HUT_FD1_Timeout_B26_2 0;
BA_ "GenSigSendType" SG_ 1808 HUT_FD1_NavSpdLimValue_B30_4 0;
BA_ "GenSigSendType" SG_ 1808 HUT_FD1_NavSpdLimUnit_B30_5 0;
BA_ "GenSigSendType" SG_ 1808 HUT_FD1_LSSWarnFormSwtReq_B30_1 0;
BA_ "GenSigSendType" SG_ 1808 HUT_FD1_IFC_SnvtySet_Abnor_B30_0 0;
BA_ "GenSigSendType" SG_ 1808 HUT_FD1_FCW_SnvtySet_Abnor_B30_7 0;
BA_ "GenSigSendType" SG_ 1808 HOST_HEATER_PWR_AURIX_B7_6 0;
BA_ "GenSigSendType" SG_ 1808 Host_ENET_Missing_Data_Err_B8_2 0;
BA_ "GenSigSendType" SG_ 1808 GRAB_VIDEO_TIMEOUT_B4_7 0;
BA_ "GenSigSendType" SG_ 1808 Frozen_Windshield_Fault_11_3 0;
BA_ "GenSigSendType" SG_ 1808 FET_Fault_Across_cycles_B2_4 0;
BA_ "GenSigSendType" SG_ 1808 FEE_E_WRITE_FAULT_B1_1 0;
BA_ "GenSigSendType" SG_ 1808 FEE_E_WRITE_CYCLES_EXHAUST_B2_0 0;
BA_ "GenSigSendType" SG_ 1808 FEE_E_UNCONFIG_BLK_EXCEED_B2_2 0;
BA_ "GenSigSendType" SG_ 1808 FEE_E_READ_FAULT_B1_2 0;
BA_ "GenSigSendType" SG_ 1808 FEE_E_INVALIDATE_FAULT_B1_7 0;
BA_ "GenSigSendType" SG_ 1808 FEE_E_GC_WRITE_FAULT_B1_3 0;
BA_ "GenSigSendType" SG_ 1808 FEE_E_GC_TRIG_FAULT_B2_1 0;
BA_ "GenSigSendType" SG_ 1808 FEE_E_GC_INIT_FAULT_B1_0 0;
BA_ "GenSigSendType" SG_ 1808 FEE_E_GC_ERASE_FAULT_B1_6 0;
BA_ "GenSigSendType" SG_ 1808 FactoryMode_B20_7 0;
BA_ "GenSigSendType" SG_ 1808 F_PBox1_Timeout_B24_3 0;
BA_ "GenSigSendType" SG_ 1808 EYQQ_ROAD_INFO_COUNTER_ERROR_2_6 0;
BA_ "GenSigSendType" SG_ 1808 EYEQ_VISION_SAFETY_DIAG_RFC_B5_3 0;
BA_ "GenSigSendType" SG_ 1808 EYEQ_VISION_SAFETY_DIAG_CRC_B5_2 0;
BA_ "GenSigSendType" SG_ 1808 EYEQ_VISION_AEB_INFO_RFC_B5_1 0;
BA_ "GenSigSendType" SG_ 1808 EYEQ_VISION_AEB_INFO_CRC_B5_0 0;
BA_ "GenSigSendType" SG_ 1808 EYEQ_VIS_OBSTACLES_INFO_RFC_B5_6 0;
BA_ "GenSigSendType" SG_ 1808 EYEQ_VIS_OBSTACLES_INFO_CRC_B5_5 0;
BA_ "GenSigSendType" SG_ 1808 EYEQ_VIS_FAILSAFESRFCFAULT_B6_4 0;
BA_ "GenSigSendType" SG_ 1808 EYEQ_VIS_FAILSAFESCRCFAULT_B6_3 0;
BA_ "GenSigSendType" SG_ 1808 EYEQ_STATIC_RFC_FAULT_B6_2 0;
BA_ "GenSigSendType" SG_ 1808 EYEQ_DYNAMIC_RFC_FAULT_B6_0 0;
BA_ "GenSigSendType" SG_ 1808 EYEQ_DYNAMIC_CRC_FAULT_B5_7 0;
BA_ "GenSigSendType" SG_ 1808 EYEQ_ROAD_INFO_CRC_FAULT_B5_4 0;
BA_ "GenSigSendType" SG_ 1808 EYEQ_OTA_SWAP_FAULT_B7_5 0;
BA_ "GenSigSendType" SG_ 1808 EYEQ_GEN_CR_ERR_FAULT_B2_3 0;
BA_ "GenSigSendType" SG_ 1808 ESP2_VehStandstill_Invalid_B2c_2 0;
BA_ "GenSigSendType" SG_ 1808 ESP2_Timeout_B27_4 0;
BA_ "GenSigSendType" SG_ 1808 ESP2_RollingCounter_B37_4 0;
BA_ "GenSigSendType" SG_ 1808 ESP2_HDCCtrl_Abnormal_B35_5 0;
BA_ "GenSigSendType" SG_ 1808 ESP2_DrivingModDis_Abnor_B35_6 0;
BA_ "GenSigSendType" SG_ 1808 ESP2_CheckSum_B3b_4 0;
BA_ "GenSigSendType" SG_ 1808 ESP2_CDDAvailable_Error_B2c_0 0;
BA_ "GenSigSendType" SG_ 1808 ESP2_AWBAvailable_Error_B2d_2 0;
BA_ "GenSigSendType" SG_ 1808 ESP2_AEBAvailable_Error_B2c_4 0;
BA_ "GenSigSendType" SG_ 1808 ESP2_ABPAvailable_Error_B2c_6 0;
BA_ "GenSigSendType" SG_ 1808 ESP2_ABAavailable_Error_B2d_0 0;
BA_ "GenSigSendType" SG_ 1808 ESP1_Timeout_B27_3 0;
BA_ "GenSigSendType" SG_ 1808 ESP1_RollingCounter_B37_3 0;
BA_ "GenSigSendType" SG_ 1808 ESP1_MasterCylBrkPress_B2b_0 0;
BA_ "GenSigSendType" SG_ 1808 ESP1_ESPFailSts_Failure_B2b_6 0;
BA_ "GenSigSendType" SG_ 1808 ESP1_CheckSum_B3b_3 0;
BA_ "GenSigSendType" SG_ 1808 ESP_FD3_Timeout_B27_7 0;
BA_ "GenSigSendType" SG_ 1808 ESP_FD3_SwtPosn_Invalid_B2e_1 0;
BA_ "GenSigSendType" SG_ 1808 ESP_FD3_RRWheelSpd_Invalid_B2a_7 0;
BA_ "GenSigSendType" SG_ 1808 ESP_FD3_RRWhDriveDirection_B29_3 0;
BA_ "GenSigSendType" SG_ 1808 ESP_FD3_RLWheelSpd_Invalid_B2a_5 0;
BA_ "GenSigSendType" SG_ 1808 ESP_FD3_RLWhDriveDirection_B29_1 0;
BA_ "GenSigSendType" SG_ 1808 ESP_FD3_FRWheelSpd_Invalid_B2a_3 0;
BA_ "GenSigSendType" SG_ 1808 ESP_FD3_FRWhDriveDirection_B29_7 0;
BA_ "GenSigSendType" SG_ 1808 ESP_FD3_FLWheelSpd_Invalid_B2a_1 0;
BA_ "GenSigSendType" SG_ 1808 ESP_FD3_FLWhDriveDirection_B29_5 0;
BA_ "GenSigSendType" SG_ 1808 ESP_FD3_EPBSts_Error_B2e_5 0;
BA_ "GenSigSendType" SG_ 1808 ESP_FD3_EPBErrSts_Error_B2e_3 0;
BA_ "GenSigSendType" SG_ 1808 ESP_FD3_EPB1_RollCounter_B38_2 0;
BA_ "GenSigSendType" SG_ 1808 ESP_FD3_EPB1_CheckSum_B3c_2 0;
BA_ "GenSigSendType" SG_ 1808 ESP_FD3_ABS2_RollCounter_B38_4 0;
BA_ "GenSigSendType" SG_ 1808 ESP_FD3_ABS2_CheckSum_B3c_4 0;
BA_ "GenSigSendType" SG_ 1808 ESP_FD3_ABS1_RollCounter_B38_3 0;
BA_ "GenSigSendType" SG_ 1808 ESP_FD3_ABS1_CheckSum_B3c_3 0;
BA_ "GenSigSendType" SG_ 1808 ESP_FD2_VehStandstill_B2c_3 0;
BA_ "GenSigSendType" SG_ 1808 ESP_FD2_VehSpd_Missing_B21_5 0;
BA_ "GenSigSendType" SG_ 1808 ESP_FD2_VehSpd_Invalid_B2b_5 0;
BA_ "GenSigSendType" SG_ 1808 ESP_FD2_Timeout_B27_6 0;
BA_ "GenSigSendType" SG_ 1808 ESP_FD2_MasterCylBrkPress_B2b_1 0;
BA_ "GenSigSendType" SG_ 1808 ESP_FD2_ESPFailSts_Failure_B2b_7 0;
BA_ "GenSigSendType" SG_ 1808 ESP_FD2_ESP2_RollCounter_B38_7 0;
BA_ "GenSigSendType" SG_ 1808 ESP_FD2_ESP2_CheckSum_B3c_7 0;
BA_ "GenSigSendType" SG_ 1808 ESP_FD2_ESP1_RollCounter_B38_6 0;
BA_ "GenSigSendType" SG_ 1808 ESP_FD2_ESP1_CheckSum_B3c_6 0;
BA_ "GenSigSendType" SG_ 1808 ESP_FD2_CDDAvailable_Error_B2c_1 0;
BA_ "GenSigSendType" SG_ 1808 ESP_FD2_AWBAvailable_Error_B2d_3 0;
BA_ "GenSigSendType" SG_ 1808 ESP_FD2_AEBAvailable_Error_B2c_5 0;
BA_ "GenSigSendType" SG_ 1808 ESP_FD2_ABSFailSts_Failure_B2b_3 0;
BA_ "GenSigSendType" SG_ 1808 ESP_FD2_ABS3_RollCounter_B38_5 0;
BA_ "GenSigSendType" SG_ 1808 ESP_FD2_ABS3_CheckSum_B3c_5 0;
BA_ "GenSigSendType" SG_ 1808 ESP_FD2_ABPAvailable_Error_B2c_7 0;
BA_ "GenSigSendType" SG_ 1808 ESP_FD2_ABAavailable_Error_B2d_1 0;
BA_ "GenSigSendType" SG_ 1808 EPS2_Timeout_B26_1 0;
BA_ "GenSigSendType" SG_ 1808 EPS2_RollingCounter_B36_6 0;
BA_ "GenSigSendType" SG_ 1808 EPS2_LKATrqOvlDlvdSts_Temp_B2f_6 0;
BA_ "GenSigSendType" SG_ 1808 EPS2_LKATrqOvlDlvdSts_Perm_B2f_7 0;
BA_ "GenSigSendType" SG_ 1808 EPS2_CheckSum_B3a_6 0;
BA_ "GenSigSendType" SG_ 1808 EPS1_Timeout_B26_0 0;
BA_ "GenSigSendType" SG_ 1808 EPS1_SteerMod_Abnormal_B32_1 0;
BA_ "GenSigSendType" SG_ 1808 EPS1_EPSFailSts_Failure_B32_0 0;
BA_ "GenSigSendType" SG_ 1808 EPB1_Timeout_B27_5 0;
BA_ "GenSigSendType" SG_ 1808 EPB1_SwtPosn_Invalid_B2e_0 0;
BA_ "GenSigSendType" SG_ 1808 EPB1_RollingCounter_B37_5 0;
BA_ "GenSigSendType" SG_ 1808 EPB1_EPBSts_Error_B2e_4 0;
BA_ "GenSigSendType" SG_ 1808 EPB1_EPBErrSts_Error_B2e_2 0;
BA_ "GenSigSendType" SG_ 1808 EPB1_CheckSum_B3b_5 0;
BA_ "GenSigSendType" SG_ 1808 ECM9_Timeout_B23_6 0;
BA_ "GenSigSendType" SG_ 1808 ECM9_RollingCounter_B38_1 0;
BA_ "GenSigSendType" SG_ 1808 ECM9_ECMACCInterface_Error_B34_6 0;
BA_ "GenSigSendType" SG_ 1808 ECM9_Checksum_B3c_1 0;
BA_ "GenSigSendType" SG_ 1808 ECM8_TrqLoss_Invalid_B34_5 0;
BA_ "GenSigSendType" SG_ 1808 ECM8_Timeout_B23_5 0;
BA_ "GenSigSendType" SG_ 1808 ECM7_Timeout_B23_4 0;
BA_ "GenSigSendType" SG_ 1808 ECM4_Timeout_B23_3 0;
BA_ "GenSigSendType" SG_ 1808 ECM4_RollingCounter_B38_0 0;
BA_ "GenSigSendType" SG_ 1808 ECM4_NetEngTrq_Invalid_B34_3 0;
BA_ "GenSigSendType" SG_ 1808 ECM4_DrvEngTrqReq_Invalid_B34_4 0;
BA_ "GenSigSendType" SG_ 1808 ECM4_Checksum_B3c_0 0;
BA_ "GenSigSendType" SG_ 1808 ECM3_Timeout_B23_2 0;
BA_ "GenSigSendType" SG_ 1808 ECM3_MaxEngTrqNorm_Abnorm_B34_2 0;
BA_ "GenSigSendType" SG_ 1808 ECM2_Timeout_B23_1 0;
BA_ "GenSigSendType" SG_ 1808 ECM2_AccelPedalPosn_Invd_B2d_6 0;
BA_ "GenSigSendType" SG_ 1808 ECM1_Timeout_B23_0 0;
BA_ "GenSigSendType" SG_ 1808 ECM1_Start_StopSts_Invalid_B34_1 0;
BA_ "GenSigSendType" SG_ 1808 ECM1_RollingCounter_B37_7 0;
BA_ "GenSigSendType" SG_ 1808 ECM1_Checksum_B3b_7 0;
BA_ "GenSigSendType" SG_ 1808 ECM1_BrkPedalSts_Error_B2d_4 0;
BA_ "GenSigSendType" SG_ 1808 DCT7_Timeout_B24_1 0;
BA_ "GenSigSendType" SG_ 1808 DCT7_DrvFaiMsg_Failure_B35_4 0;
BA_ "GenSigSendType" SG_ 1808 DCT5_Timeout_B24_0 0;
BA_ "GenSigSendType" SG_ 1808 DCT5_TARGET_GEAR_Invalid_B35_2 0;
BA_ "GenSigSendType" SG_ 1808 DCT5_ShiftInPrg_Invalid_B35_1 0;
BA_ "GenSigSendType" SG_ 1808 DCT5_RollingCounter_B37_6 0;
BA_ "GenSigSendType" SG_ 1808 DCT5_CurrentGear_Invalid_B35_0 0;
BA_ "GenSigSendType" SG_ 1808 DCT5_CheckSum_B3b_6 0;
BA_ "GenSigSendType" SG_ 1808 DCT3_Timeout_B23_7 0;
BA_ "GenSigSendType" SG_ 1808 CSA2_Timeout_B25_4 0;
BA_ "GenSigSendType" SG_ 1808 CSA2_SteerWheelSpd_Invalid_B31_2 0;
BA_ "GenSigSendType" SG_ 1808 CSA2_SteerWheelAng_Invalid_B31_1 0;
BA_ "GenSigSendType" SG_ 1808 CSA2_SAS_Sts_Error_B31_4 0;
BA_ "GenSigSendType" SG_ 1808 CSA2_Rollingcounter_B36_5 0;
BA_ "GenSigSendType" SG_ 1808 CSA2_Checksum_B3a_5 0;
BA_ "GenSigSendType" SG_ 1808 CSA2_CC_ACCSwt_Error_B31_3 0;
BA_ "GenSigSendType" SG_ 1808 CSA1_Timeout_B25_3 0;
BA_ "GenSigSendType" SG_ 1808 CSA1_FrntWiprSwtSts_Error_B31_0 0;
BA_ "GenSigSendType" SG_ 1808 Vision_Internal_Error_B1f_6 0;
BA_ "GenSigSendType" SG_ 1808 EyeQ_Spi_Msg_Timeout_A_7 0;
BA_ "GenSigSendType" SG_ 1808 Host_Spi_CRC_Error_A_2 0;
BA_ "GenSigSendType" SG_ 1808 Host_Spi_Tx_Error_A_1 0;
BA_ "GenSigSendType" SG_ 1808 Host_spi_msg_timeout_A_0 0;
BA_ "GenSigSendType" SG_ 1808 EyeQ_Calibration_Checksum_9_4 0;
BA_ "GenSigSendType" SG_ 1808 Imager_2V8_Supply_OutRange_6_7 0;
BA_ "GenSigSendType" SG_ 1808 Aurix_1V25_Supply_OutRange_B6_6 0;
BA_ "GenSigSendType" SG_ 1808 Imager_1V2_Supply_OutRange_6_5 0;
BA_ "GenSigSendType" SG_ 1808 Battery_High_Fault_B21_2 0;
BA_ "GenSigSendType" SG_ 1808 Battery_Low_Fault_B21_1 0;
BA_ "GenSigSendType" SG_ 1808 PS_5V0_Out_Of_Range_4_4 0;
BA_ "GenSigSendType" SG_ 1808 EyeQDDROnBrdThermstorOutRang_4_3 0;
BA_ "GenSigSendType" SG_ 1808 EyeQDDROnBrdThermstorOveTemp_4_1 0;
BA_ "GenSigSendType" SG_ 1808 EyeQ_Temp_Exceeded_3_0 0;
BA_ "GenSigSendType" SG_ 1808 SYSTEM_OVER_TEMPERATURE_2_7 0;
BA_ "GenSigSendType" SG_ 1808 EyeQ_Error_Out_Temp_Fault_1A_6 0;
BA_ "GenSigSendType" SG_ 1808 EyeQErrOutSignalInternFault_1A_5 0;
BA_ "GenSigSendType" SG_ 1808 EyeQ_Camera1_Temp_Fault_1A_4 0;
BA_ "GenSigSendType" SG_ 1808 EyeQVdoErrFlg_ShotOutOfSync_1A_3 0;
BA_ "GenSigSendType" SG_ 1808 EyeQVdoErrFlg_VdiErrShutdwn_1A_2 0;
BA_ "GenSigSendType" SG_ 1808 EyeQVdoErrFlg_HdrVerifiErr_1A_1 0;
BA_ "GenSigSendType" SG_ 1808 EyeQVdoErrFlg_CcftDecisionMismat 0;
BA_ "GenSigSendType" SG_ 1808 EyeQVdoErrFlg_HistogramsMismatch 0;
BA_ "GenSigSendType" SG_ 1808 EyeQVdoErrFlg_FrameCountReadFail 0;
BA_ "GenSigSendType" SG_ 1808 EyeQVdoErrFlgVdiErr_CoreIdFlt 0;
BA_ "GenSigSendType" SG_ 1808 EyeQVdoErrFlgVdiErr_StrtAftStrt 0;
BA_ "GenSigSendType" SG_ 1808 EyeQVdoErrFlgVdiErr_ParityHisFlt 0;
BA_ "GenSigSendType" SG_ 1808 EyeQVdoErrFlgVdiErr_ParityGamma 0;
BA_ "GenSigSendType" SG_ 1808 EyeQVdoErrFlgVdiErr_ParityWeight 0;
BA_ "GenSigSendType" SG_ 1808 EyeQVdoErrFlgVdiErr_ParityFifo 0;
BA_ "GenSigSendType" SG_ 1808 EyeQVdoErrFlgVdiErrFifo_Undflow 0;
BA_ "GenSigSendType" SG_ 1808 EyeQVdoErrFlgVdiErrFifo_Overflow 0;
BA_ "GenSigSendType" SG_ 1808 EyeQVdoErrFlgVdiErr_Timeout_18_5 0;
BA_ "GenSigSendType" SG_ 1808 EyeQVdoErrFlgVdiErr_BuffInvldFmt 0;
BA_ "GenSigSendType" SG_ 1808 EyeQVdoErrFlg_Vdi_ErrNoBuff_18_3 0;
BA_ "GenSigSendType" SG_ 1808 EyeQVdoErrFlgVdi_InternErr18_2 0;
BA_ "GenSigSendType" SG_ 1808 EyeQVdoErrFlgSumNotMatHistgrmErr 0;
BA_ "GenSigSendType" SG_ 1808 EyeQVdoErrFlgZeroHistgrmErr_18_0 0;
BA_ "GenSigSendType" SG_ 1808 EyeQVdoErrFlgRegWrtHilFailErr 0;
BA_ "GenSigSendType" SG_ 1808 EyeQVdoErrFlgErrRegFlagFlt_17_6 0;
BA_ "GenSigSendType" SG_ 1808 EyeQVdoErrFlgInvldVdoHeaderFault 0;
BA_ "GenSigSendType" SG_ 1808 EyeQVdoErrFlgVerifiFailVdoErr 0;
BA_ "GenSigSendType" SG_ 1808 EyeQVdoErrFlgInconstFramVdoErr 0;
BA_ "GenSigSendType" SG_ 1808 EyeQ_Cam1VdoErrFlgLgcVdoErr_17_2 0;
BA_ "GenSigSendType" SG_ 1808 EyeQCam1VdoErrFlgI2CNoOnTmVdoErr 0;
BA_ "GenSigSendType" SG_ 1808 EyeQCam1VdoErrFlgVdiVdoErr_17_0 0;
BA_ "GenSigSendType" SG_ 1808 EyeQ_Cam_Vdo_Flt_16_7 0;
BA_ "GenSigSendType" SG_ 1808 EyeQ_Cam_Ctrl_Flt_16_6 0;
BA_ "GenSigSendType" SG_ 1808 EyeQ_Cam_Mal_Func_16_5 0;
BA_ "GenSigSendType" SG_ 1808 Grab_Release_Failure_16_4 0;
BA_ "GenSigSendType" SG_ 1808 Grab_Acquire_Failure_16_3 0;
BA_ "GenSigSendType" SG_ 1808 Grab_Issue_Failure_16_2 0;
BA_ "GenSigSendType" SG_ 1808 Grab_No_Free_Header_Failure_16_1 0;
BA_ "GenSigSendType" SG_ 1808 Init_I2C_Failure_16_0 0;
BA_ "GenSigSendType" SG_ 1808 Init_Vdi_Failure_15_7 0;
BA_ "GenSigSendType" SG_ 1808 EyeQFatalErrApCamParaCcftCrc13_4 0;
BA_ "GenSigSendType" SG_ 1808 EyeQFatalErrAppI2CTimoutErr_13_2 0;
BA_ "GenSigSendType" SG_ 1808 EyeQFatalErrAppI2CCamSlfRst_13_1 0;
BA_ "GenSigSendType" SG_ 1808 EyeQFatalErrAppI2CVidoGrb_13_0 0;
BA_ "GenSigSendType" SG_ 1808 EYEQ_GEN54ACCSTLEXECUTFAILED_F_3 0;
BA_ "GenSigSendType" SG_ 1808 EYEQ_GEN_26_CODE_CRC_E_1 0;
BA_ "GenSigSendType" SG_ 1808 EyeQ_Core_Dump_Fault_C_5 0;
BA_ "GenSigSendType" SG_ 1808 EyeQ_Init_Timeout_Fault_C_4 0;
BA_ "GenSigSendType" SG_ 1808 EYEQ4_Mode_Fault_C_3 0;
BA_ "GenSigSendType" SG_ 1808 EyeQ_Bist_Memory_Fault_C_2 0;
BA_ "GenSigSendType" SG_ 1808 EyeQ_Core_Fault_C_1 0;
BA_ "GenSigSendType" SG_ 1808 EyeQ_Boot_Fault_C_0 0;
BA_ "GenSigSendType" SG_ 1808 EyeQ_DDR_Fault_B_6 0;
BA_ "GenSigSendType" SG_ 1808 EyeQ_SerialFlashPowerUp_Fail_B_1 0;
BA_ "GenSigSendType" SG_ 1808 EyeQ_SPI_CRC_ERROR_B_0 0;
BA_ "GenSigSendType" SG_ 1808 EYEQ_Spi_Msg_Format_Error_A_6 0;
BA_ "GenSigSendType" SG_ 1808 EyeQ_Spi_Frame_Format_Error_A_5 0;
BA_ "GenSigSendType" SG_ 1808 Spi_Ipc_Comm_Reset_A_4 0;
BA_ "GenSigSendType" SG_ 1808 Spi_version_mismatch_A_3 0;
BA_ "GenSigSendType" SG_ 1808 Host_Spi_Msg_Format_Error_9_7 0;
BA_ "GenSigSendType" SG_ 1808 Host_Spi_Frame_Format_Error_9_6 0;
BA_ "GenSigSendType" SG_ 1808 EyeQ_Application_Checksum_9_3 0;
BA_ "GenSigSendType" SG_ 1808 EyeQAppl_CompltAndComptibl_9_2 0;
BA_ "GenSigSendType" SG_ 1808 EyeQOnBoardThermstorOutRange_4_2 0;
BA_ "GenSigSendType" SG_ 1808 EyeQ_DDR_Over_Temp_4_0 0;
BA_ "GenSigSendType" SG_ 1808 EyeQ_Boot_OverTemp_Fault_3_7 0;
BA_ "GenSigSendType" SG_ 1808 EyeQ_Imager_Over_Temp_3_6 0;
BA_ "GenSigSendType" SG_ 1808 EyeQ_VMP_Over_Temp_3_5 0;
BA_ "GenSigSendType" SG_ 1808 EyeQ_MIPS_Over_Temp_3_4 0;
BA_ "GenSigSendType" SG_ 1808 EyeQOnBoardThermistorOveTemp_3_1 0;
BA_ "GenSigSendType" SG_ 1808 EYEQ_1V0_SUPPLY_OUT_OF_RANGE_0_3 0;
BA_ "GenSigSendType" SG_ 1808 EYEQ_1V1_SUPPLY_OUT_OF_RANGE_0_2 0;
BA_ "GenSigSendType" SG_ 1808 EYEQ_1V8_SUPPLY_OUT_OF_RANGE_0_1 0;
BA_ "GenSigSendType" SG_ 1808 EYEQ_3V3_SUPPLY_OUT_OF_RANGE_0_0 0;
BA_ "SystemSignalLongSymbol" SG_ 1808 Windshield_heater_OPNLD_Err_0002 "Windshield_heater_OPNLD_Error_B3E_0";
BA_ "SystemSignalLongSymbol" SG_ 1808 WWINDSHIELD_HEATER_STG_FAUL_0002 "WWINDSHIELD_HEATER_STG_FAULT_B3E_1";
BA_ "SystemSignalLongSymbol" SG_ 1808 WINDSHIELD_HEATER_OVRLD_FAU_0002 "WINDSHIELD_HEATER_OVRLD_FAULT_B3E_2";
BA_ "SystemSignalLongSymbol" SG_ 1808 WINDSHIELD_HEATER_STB_FAULT_0002 "WINDSHIELD_HEATER_STB_FAULT_B3E_3";
BA_ "GenSigSendType" SG_ 1796 EyeqSpiVFPModeFaultCtr 0;
BA_ "GenSigSendType" SG_ 1796 EyeqSpiCRCErrorCtr 0;
BA_ "GenSigSendType" SG_ 1796 EyeqSpiCommWatchdogCtr 0;
BA_ "GenSigSendType" SG_ 1796 EyqSpiMsgTimeoutCtr 0;
BA_ "GenSigSendType" SG_ 1796 EyqSpiMsgFormatErrorCtr 0;
BA_ "GenSigSendType" SG_ 1796 EyqSpiFrameFormatErrorCtr 0;
BA_ "GenSigSendType" SG_ 1796 HostSpMsgTImeoutCtr 0;
BA_ "GenSigSendType" SG_ 1796 HostSpiTxErrorCtr 0;
BA_ "GenSigSendType" SG_ 1796 HostSpiCRCErrorCtr 0;
BA_ "GenSigSendType" SG_ 1796 HostSpiAppRxBadHdrCtr 0;
BA_ "GenSigSendType" SG_ 1796 HostSpiDllRxBadHdrCtr 0;
BA_ "GenSigSendType" SG_ 1796 HostSpiDllRxLongFrameCtr 0;
BA_ "GenSigSendType" SG_ 1796 HostSpiDllRxShortFrameCtr 0;
BA_ "GenSigSendType" SG_ 1796 HostSpiTpRxBadHdrCtr 0;
BA_ "GenSigSendType" SG_ 1796 HostSpiTpRxBadSeqCtr 0;
BA_ "GenSigSendType" SG_ 1797 AruixOnBdT 0;
BA_ "GenSigStartValue" SG_ 1797 AruixOnBdT 40;
BA_ "GenSigSendType" SG_ 1797 vmpTemperature 0;
BA_ "GenSigStartValue" SG_ 1797 vmpTemperature 128;
BA_ "GenSigSendType" SG_ 1797 mipsTemperature 0;
BA_ "GenSigStartValue" SG_ 1797 mipsTemperature 128;
BA_ "GenSigSendType" SG_ 1797 imagerTemperature 0;
BA_ "GenSigStartValue" SG_ 1797 imagerTemperature 128;
BA_ "GenSigSendType" SG_ 1797 ddrTemperature 0;
BA_ "GenSigSendType" SG_ 1797 Temperature_DDR 0;
BA_ "GenSigSendType" SG_ 1797 Temperature_VMP 0;
BA_ "GenSigStartValue" SG_ 1797 Temperature_VMP 40;
BA_ "GenSigSendType" SG_ 1797 Temperature_MIPS 0;
BA_ "GenSigStartValue" SG_ 1797 Temperature_MIPS 40;
BA_ "GenSigSendType" SG_ 1797 Camera1_temperature 0;
BA_ "GenSigStartValue" SG_ 1797 Camera1_temperature 40;
BA_ "GenSigStartValue" SG_ 1797 DDROnBdT 40;
BA_ "GenSigSendType" SG_ 1797 DDROnBdT 0;
BA_ "GenSigStartValue" SG_ 1797 EyeQ4OnBdT 40;
BA_ "GenSigSendType" SG_ 1797 EyeQ4OnBdT 0;
BA_ "GenSigSendType" SG_ 1797 EyeQ_ThermSts 0;
BA_ "GenSigSendType" SG_ 1792 VFP_Sub_State 0;
BA_ "GenSigSendType" SG_ 1792 Status_Vision_Calib_Process 0;
BA_ "GenSigSendType" SG_ 1792 VBattState_ECU 0;
BA_ "GenSigSendType" SG_ 1792 HEATER_OUT_Current_Voltage 0;
BA_ "GenSigSendType" SG_ 1792 AURIX_1V2_Current_Voltage 0;
BA_ "GenSigSendType" SG_ 1792 HSD_CS_Current_Voltage 0;
BA_ "GenSigSendType" SG_ 1792 COMM_EN_Current_Voltage 0;
BA_ "GenSigSendType" SG_ 1792 AURIX_5V_Current_Voltage 0;
BA_ "GenSigSendType" SG_ 1792 AURIX_1V25_Current_Voltage 0;
BA_ "GenSigSendType" SG_ 1792 AURIX_3V3_Current_Voltage 0;
BA_ "GenSigSendType" SG_ 1792 LKS_ISLW_Current_Voltage 0;
BA_ "GenSigSendType" SG_ 1792 AURIX_2V8_Current_Voltage 0;
BA_ "GenSigSendType" SG_ 1792 LKS_PCA_SW_Current_Voltage 0;
BA_ "GenSigSendType" SG_ 1792 VBattState_EyeQ4 0;
BA_ "GenSigSendType" SG_ 1792 VBattState_Comm 0;
BA_ "GenSigSendType" SG_ 1792 VBattState_Diag 0;
BA_ "GenSigSendType" SG_ 1792 VFP_State 0;
BA_ "GenSigSendType" SG_ 1792 align_current_state 0;
BA_ "GenSigSendType" SG_ 1792 EYEQ4_Power_Mode_State 0;
BA_ "GenSigSendType" SG_ 1792 AURIX_EYEQ4_3V3_EN 0;
BA_ "GenSigSendType" SG_ 1792 AURIX_EYEQ4_PWR_EN 0;
BA_ "GenSigSendType" SG_ 1792 EYEQ_3V3_Current_Voltage 0;
BA_ "GenSigSendType" SG_ 1792 EYEQ_1V0_Current_Voltage 0;
BA_ "GenSigSendType" SG_ 1792 EYEQ_1V1_Current_Voltage 0;
BA_ "GenSigSendType" SG_ 1792 EYEQ_1V8_Current_Voltage 0;
BA_ "GenSigSendType" SG_ 1792 RawAURIX_EYEQ_3V3_ADC 0;
BA_ "GenSigSendType" SG_ 1792 EYEQ4_RESET 0;
BA_ "GenSigSendType" SG_ 1792 Host_Rx_Valid_EyeQ4_SPI_Msgs 0;
BA_ "GenSigSendType" SG_ 1792 EyeQ4InitTimeout 0;
BA_ "GenSigSendType" SG_ 1792 EYEQ4_Diagnostic_Shutdown 0;
BA_ "GenSigSendType" SG_ 1792 RawAURIX_EYEQ_1V0_ADC 0;
BA_ "GenSigSendType" SG_ 1792 EYEQ4_Thermal_Shutdown 0;
BA_ "GenSigSendType" SG_ 1792 EyeQ4_SPI_Rolling_Count_Err 0;
BA_ "GenSigSendType" SG_ 1792 EyeQ4_SPI_Lost_Comm 0;
BA_ "GenSigSendType" SG_ 1792 RawAURIX_EYEQ_1V1_ADC 0;
BA_ "GenSigSendType" SG_ 1792 EYEQ4_Reset_Request 0;
BA_ "GenSigSendType" SG_ 1792 RawAURIX_EYEQ_1V8_ADC 0;
BA_ "GenSigSendType" SG_ 1792 EyeQIoSts_EYEQ4_AURIX_BOOT 0;
BA_ "GenSigSendType" SG_ 1792 EyeQIoSts_EYEQ4_AURIX_CORE_DUMP 0;
BA_ "GenSigSendType" SG_ 1792 EyeQIoSts_EYEQ4_AURIX_TEMP_EXCED 0;
BA_ "GenSigSendType" SG_ 1792 EYEQ4_Init_wait_ms 0;
BA_ "GenSigSendType" SG_ 1792 EYEQ4_Core_Dump_wait_ms 0;
BA_ "GenSigSendType" SG_ 1792 EYEQ4_Init_Retry_Counter 0;
BA_ "GenSigSendType" SG_ 1792 EYEQ4_Off_wait_ms 0;
BA_ "GenSigSendType" SG_ 1792 RawVBAT_AURIX_ADC 0;
BA_ "GenSigSendType" SG_ 1792 VBattU 0;
BA_ "GenSigSendType" SG_ 1793 CanNm_NmState 0;
BA_ "GenSigStartValue" SG_ 1793 ProgExFlashInd 2;
BA_ "GenSigSendType" SG_ 1793 VBattState_VRange_RFSRR 0;
BA_ "GenSigSendType" SG_ 1793 SRR_RFRONT_Power_Mode_State 0;
BA_ "GenSigSendType" SG_ 1793 AURIX_HSD2_SRR_LF_RF_DEN 0;
BA_ "GenSigSendType" SG_ 1793 AURIX_HSD2_SRR_RF_IN 0;
BA_ "GenSigSendType" SG_ 1793 Host_Rx_valid_SRR_RFRONT_CAN_Msg 0;
BA_ "GenSigSendType" SG_ 1793 SRR_RFRONTInitTimeout 0;
BA_ "GenSigSendType" SG_ 1793 SRR_RFRONT_Reset_Request 0;
BA_ "GenSigSendType" SG_ 1793 Com_with_SRR_RFRONT_Is_Dropped 0;
BA_ "GenSigSendType" SG_ 1793 VBattState_VRange_RRSRR 0;
BA_ "GenSigSendType" SG_ 1793 AURIX_HSD1_SRR_LR_RR_DEN 0;
BA_ "GenSigSendType" SG_ 1793 AURIX_HSD1_SRR_RR_IN 0;
BA_ "GenSigSendType" SG_ 1793 SRR_RFRONT_Init_wait_ms 0;
BA_ "GenSigSendType" SG_ 1793 SRR_RFRONT_Init_Retry_Counter 0;
BA_ "GenSigSendType" SG_ 1793 SRR_RREAR_Power_Mode_State 0;
BA_ "GenSigSendType" SG_ 1793 Host_rx_valid_SRR_RREAR_CAN_Msgs 0;
BA_ "GenSigSendType" SG_ 1793 SRR_RREARInitTimeout 0;
BA_ "GenSigSendType" SG_ 1793 SRR_RREAR_Reset_Request 0;
BA_ "GenSigSendType" SG_ 1793 Com_with_SRR_RREAR_Is_Dropped 0;
BA_ "GenSigSendType" SG_ 1793 AURIX_HSD3_HEATER_FLR_DEN 0;
BA_ "GenSigSendType" SG_ 1793 SRR_RFRONT_Off_wait_ms 0;
BA_ "GenSigSendType" SG_ 1793 SRR_RREAR_Init_wait_ms 0;
BA_ "GenSigSendType" SG_ 1793 SRR_RREAR_Init_Retry_Counter 0;
BA_ "GenSigSendType" SG_ 1793 VBattState_VRange_MRR 0;
BA_ "GenSigSendType" SG_ 1793 MRR_Power_Mode_State 0;
BA_ "GenSigSendType" SG_ 1793 AURIX_HSD3_FLR_IN 0;
BA_ "GenSigSendType" SG_ 1793 Host_Rx_Valid_MRR_CAN_Msgs 0;
BA_ "GenSigSendType" SG_ 1793 SRR_RREAR_Off_wait_ms 0;
BA_ "GenSigSendType" SG_ 1793 MRR_Init_wait_ms 0;
BA_ "GenSigSendType" SG_ 1793 MRRInitTimeout 0;
BA_ "GenSigSendType" SG_ 1793 MRR_Reset_Request 0;
BA_ "GenSigSendType" SG_ 1793 Com_with_MRR_Is_Dropped 0;
BA_ "GenSigSendType" SG_ 1793 VBattState_VRange_LFSRR 0;
BA_ "GenSigSendType" SG_ 1793 AURIX_HSD2_SRR_LF_IN 0;
BA_ "GenSigSendType" SG_ 1793 Host_Rx_Valid_SRR_LFRONT_CAN_Msg 0;
BA_ "GenSigSendType" SG_ 1793 MRR_Init_Retry_Counter 0;
BA_ "GenSigSendType" SG_ 1793 MRR_Off_wait_ms 0;
BA_ "GenSigSendType" SG_ 1793 SRR_LFRONT_Power_Mode_State 0;
BA_ "GenSigSendType" SG_ 1793 SRR_LFRONTInitTimeout 0;
BA_ "GenSigSendType" SG_ 1793 SRR_LFRONT_Reset_Request 0;
BA_ "GenSigSendType" SG_ 1793 Com_with_SRR_LFRONT_Is_Dropped 0;
BA_ "GenSigSendType" SG_ 1793 Host_Rx_Valid_SRR_LREAR_CAN_Msgs 0;
BA_ "GenSigSendType" SG_ 1793 SRR_LREARInitTimeout 0;
BA_ "GenSigSendType" SG_ 1793 SRR_LFRONT_Init_Retry_Counter 0;
BA_ "GenSigSendType" SG_ 1793 SRR_LFRONT_Init_wait_ms 0;
BA_ "GenSigSendType" SG_ 1793 SRR_LFRONT_Off_wait_ms 0;
BA_ "GenSigSendType" SG_ 1793 VBattState_VRange_LRSRR 0;
BA_ "GenSigSendType" SG_ 1793 SRR_LREAR_Power_Mode_State 0;
BA_ "GenSigSendType" SG_ 1793 SRR_LREAR_Reset_Request 0;
BA_ "GenSigSendType" SG_ 1793 Com_with_SRR_LREAR_Is_Dropped 0;
BA_ "GenSigSendType" SG_ 1793 SRR_LREAR_Init_Retry_Counter 0;
BA_ "GenSigSendType" SG_ 1793 SRR_LREAR_Init_wait_ms 0;
BA_ "GenSigSendType" SG_ 1793 SRR_LREAR_Off_wait_ms 0;
BA_ "GenSigSendType" SG_ 1793 AURIX_HSD1_SRR_LR_IN 0;
BA_ "GenSigSendType" SG_ 1793 AURIX_POC_LDO3_CAMPWR_FWC_EN 0;
BA_ "GenSigSendType" SG_ 1793 SRR_LR_Iout 0;
BA_ "GenSigSendType" SG_ 1793 SRR_RR_Iout 0;
BA_ "GenSigSendType" SG_ 1793 SRR_LF_Iout 0;
BA_ "GenSigSendType" SG_ 1793 SRR_RF_Iout 0;
BA_ "GenSigSendType" SG_ 1793 MRR_Iout 0;
BA_ "GenSigSendType" SG_ 1793 SRR_LF_PWR_Current_Voltage 0;
BA_ "GenSigSendType" SG_ 1793 SRR_RF_PWR_Current_Voltage 0;
BA_ "GenSigSendType" SG_ 1793 SRR_LR_PWR_Current_Voltage 0;
BA_ "GenSigSendType" SG_ 1793 SRR_RR_PWR_Current_Voltage 0;
BA_ "GenSigSendType" SG_ 1793 MRR_PWR_Current_Voltage 0;
BA_ "SystemSignalLongSymbol" SG_ 1824 hostRightMarker_measuredViewRang "hostRightMarker_measuredViewRange";
BA_ "SystemSignalLongSymbol" SG_ 1824 nextLeftRightMarker_measuredView "nextLeftRightMarker_measuredViewRange";
BA_ "SystemSignalLongSymbol" SG_ 1824 nextRightLeftMarker_measuredView "nextRightLeftMarker_measuredViewRange";
BA_ "SystemSignalLongSymbol" SG_ 1825 nextLeftLeftMarker_measuredViewR "nextLeftLeftMarker_measuredViewRange";
BA_ "SystemSignalLongSymbol" SG_ 1825 nextRightRightMarker_measuredVie "nextRightRightMarker_measuredViewRange";
VAL_ 1792 eyeq_static_calibration_error_e 9 "DES_BAD_PARAMS_TARGET_HORIZON" 8 "DES_BAD_PARAMS_TARGET_Yaw" 7 "DES_BAD_PARAMS_SQUARE_SIDE_SIZE�" 6 "DES_BAD_PARAMS_DISTANCE" 5 "DES_PARAMS_LOAD_FAILED" 4 "DES_FOE_OUT_OF_TOLERANCE" 3 "DES_Roll_ANGLE_TOO_LARGE" 2 "DES_NO_TARGET_FOUND" 1 "DES_SUCCESS" 0 "DES_VISION_CALIB_UNKNOWN" ;
VAL_ 1792 VBattState_ECU 8 "WAIT NORM FROM OVER" 7 "WAIT NORM FROM UNDER" 6 "WAIT NORM FROM HI" 5 "WAIT NORM FROM LO" 4 "OVER_V" 3 "UNDER_V" 2 "HI_V" 1 "LO_V" 0 "NORM_V" ;
VAL_ 1792 VBattState_EyeQ4 4 "OVER_V" 3 "UNDER_V" 2 "HI_V" 1 "LO_V" 0 "NORM_V" ;
VAL_ 1792 VBattState_Comm 8 "WAIT NORM FROM OVER" 7 "WAIT NORM FROM UNDER" 6 "WAIT NORM FROM HI" 5 "WAIT NORM FROM LO" 4 "OVER_V" 3 "UNDER_V" 2 "HI_V" 1 "LO_V" 0 "NORM_V" ;
VAL_ 1792 VBattState_Diag 8 "WAIT NORM FROM OVER" 7 "WAIT NORM FROM UNDER" 6 "WAIT NORM FROM HI" 5 "WAIT NORM FROM LO" 4 "OVER_V" 3 "UNDER_V" 2 "HI_V" 1 "LO_V" 0 "NORM_V" ;
VAL_ 1792 VFP_State 3 "Boot" 134 "PENDING_INIT_DV" 0 "Unknown" 1 "Pending" 2 "Running_Vision" 34 "Running_SPC" 130 "Pending_SPC" 133 "Pending_TAC" 146 "Pending_Vision" 170 "Running_Diagnosetics" 172 "Running_TAC" ;
VAL_ 1792 align_current_state 4 "eVISION_APP_MODE" 3 "eWAIT_ALIGN_MSG" 2 "eWAIT_ALIGN_STATE" 1 "eVISION_UNALIGNED" 0 "eALIGNED_IDLE" ;
VAL_ 1792 EYEQ4_Power_Mode_State 5 "EYEQ4_OFF" 4 "EYEQ4_CORE_DUMP" 3 "EYEQ4_TAC" 2 "EYEQ4_STANDBY" 1 "EYEQ4_NORM" 0 "EYEQ4_INIT" ;
VAL_ 1792 AURIX_EYEQ4_3V3_EN 1 "Enabled" 0 "Disabled" ;
VAL_ 1792 AURIX_EYEQ4_PWR_EN 1 "Enabled" 0 "Disabled" ;
VAL_ 1792 EYEQ4_RESET 1 "Asserting reset" 0 "Released from reset" ;
VAL_ 1824 roadPredictionLeft 1 "None" 2 "Occluded" 4 "Other_Side" 8 "Override" 16 "Dist_Based_Extrapolation" 32 "Headway_Oriented" ;
VAL_ 1824 roadPredictionRight 1 "None" 2 "Occluded" 4 "Other_Side" 8 "Override" 16 "Dist_Based_Extrapolation" 32 "Headway_Oriented" ;
VAL_ 1824 hostLeftMarker_type 0 "DASHED" 1 "SOLID" 2 "UNDECIDED" 3 "DLM" 4 "BOTTS" 5 "DECEL" 6 "INVALID" ;
VAL_ 1824 hostLeftMarker_color 0 "Unknown" 1 "White" 2 "Yellow" 3 "Blue" ;
VAL_ 1824 hostRightMarker_type 0 "DASHED" 1 "SOLID" 2 "UNDECIDED" 3 "DLM" 4 "BOTTS" 5 "DECEL" 6 "INVALID" ;
VAL_ 1824 hostRightMarker_color 0 "Unknown" 1 "White" 2 "Yellow" 3 "Blue" ;
VAL_ 1824 nextLeftRightMarker_type 0 "DASHED" 1 "SOLID" 2 "UNDECIDED" 3 "DLM" 4 "BOTTS" 5 "DECEL" 6 "INVALID" ;
VAL_ 1824 nextLeftRightMarker_color 0 "Unknown" 1 "White" 2 "Yellow" 3 "Blue" ;
VAL_ 1824 nextRightLeftMarker_type 0 "DASHED" 1 "SOLID" 2 "UNDECIDED" 3 "DLM" 4 "BOTTS" 5 "DECEL" 6 "INVALID" ;
VAL_ 1824 nextRightLeftMarker_color 0 "Unknown" 1 "White" 2 "Yellow" 3 "Blue" ;
VAL_ 1825 nextLeftLeftMarker_type 0 "DASHED" 1 "SOLID" 2 "UNDECIDED" 3 "DLM" 4 "BOTTS" 5 "DECEL" 6 "INVALID" ;
VAL_ 1825 nextLeftLeftMarker_color 0 "Unknown" 1 "White" 2 "Yellow" 3 "Blue" ;
VAL_ 1825 nextRightRightMarker_type 0 "DASHED" 1 "SOLID" 2 "UNDECIDED" 3 "DLM" 4 "BOTTS" 5 "DECEL" 6 "INVALID" ;
VAL_ 1825 nextRightRightMarker_color 0 "Unknown" 1 "White" 2 "Yellow" 3 "Blue" ;
VAL_ 1826 laneChange 0 "Nolanechange" 1 "Lanechangetotheleft" 2 "Lanechangetotheright" ;
VAL_ 1826 drivingSide 0 "RightSide" 1 "LeftSide" ;
VAL_ 1827 roadBorder_left_Type 0 "Roadedge" 1 "Curb" 2 "Barrier" 3 "ConesPoles" 4 "ParkedCars" ;
VAL_ 1827 roadBorder_right_Type 0 "Roadedge" 1 "Curb" 2 "Barrier" 3 "ConesPoles" 4 "ParkedCars" ;
VAL_ 1828 VIS_OBS_classification_1 0 "car" 1 "truck" 2 "bike(motorcycle)" 3 "bicycle" 4 "pedestrian" 5 "generalobject(notimplemented)" 6 "animal(notimplemented)" 7 "uncertain_vehicle" ;
VAL_ 1828 VIS_OBS_laneAssignment_1 -2 "LEFT_NEXT_NEXT" -1 "LEFT_NEXT" 0 "EGO_LANE" 1 "RIGHT_NEXT" 2 "RIGHT_NEXT_NEXT" 3 "UNKNOWN" ;
VAL_ 1828 VIS_OBS_motionStatus_1 0 "Unknown" 1 "moving" 2 "stationary" 3 "Stopped" 4 "Movingslowly" ;
VAL_ 1828 VIS_OBS_motionCategory_1 12 "Oncoming" 11 "Preceding" 10 "Moving" 9 "RTAP" 0 "Undefined" 1 "Passing" 2 "Passingin" 3 "Passingout" 4 "Closecutiin" 5 "Movingin" 6 "Movingout" 7 "Crossing" 8 "LTAP" ;
VAL_ 1828 VIS_OBS_motionOrientation_1 0 "Unknown" 1 "Driftingright" 2 "Crossingright" 3 "Oncomingdriftingright" 4 "Oncoming" 5 "Oncomingdriftingleft" 6 "Crossingleft" 7 "Driftingleft" 8 "Precedinge" ;
VAL_ 1828 VIS_OBS_CIPV_Lost_1 0 "NO_LOSS " 1 "LOST_TARGET_FOV_OUT " 2 "LOST_TARGET_FOV_IN" ;
VAL_ 1828 VIS_OBS_classification_2 0 "car" 1 "truck" 2 "bike(motorcycle)" 3 "bicycle" 4 "pedestrian" 5 "generalobject(notimplemented)" 6 "animal(notimplemented)" 7 "uncertain_vehicle" ;
VAL_ 1828 VIS_OBS_laneAssignment_2 -2 "LEFT_NEXT_NEXT" -1 "LEFT_NEXT" 0 "EGO_LANE" 1 "RIGHT_NEXT" 2 "RIGHT_NEXT_NEXT" 3 "UNKNOWN" ;
VAL_ 1828 VIS_OBS_motionStatus_2 0 "Unknown" 1 "moving" 2 "stationary" 3 "Stopped" 4 "Movingslowly" ;
VAL_ 1828 VIS_OBS_motionCategory_2 12 "Oncoming" 11 "Preceding" 10 "Moving" 9 "RTAP" 0 "Undefined" 1 "Passing" 2 "Passingin" 3 "Passingout" 4 "Closecutiin" 5 "Movingin" 6 "Movingout" 7 "Crossing" 8 "LTAP" ;
VAL_ 1828 VIS_OBS_motionOrientation_2 0 "Unknown" 1 "Driftingright" 2 "Crossingright" 3 "Oncomingdriftingright" 4 "Oncoming" 5 "Oncomingdriftingleft" 6 "Crossingleft" 7 "Driftingleft" 8 "Precedinge" ;
VAL_ 1828 VIS_OBS_classification_3 0 "car" 1 "truck" 2 "bike(motorcycle)" 3 "bicycle" 4 "pedestrian" 5 "generalobject(notimplemented)" 6 "animal(notimplemented)" 7 "uncertain_vehicle" ;
VAL_ 1828 VIS_OBS_laneAssignment_3 -2 "LEFT_NEXT_NEXT" -1 "LEFT_NEXT" 0 "EGO_LANE" 1 "RIGHT_NEXT" 2 "RIGHT_NEXT_NEXT" 3 "UNKNOWN" ;
VAL_ 1828 VIS_OBS_motionStatus_3 0 "Unknown" 1 "moving" 2 "stationary" 3 "Stopped" 4 "Movingslowly" ;
VAL_ 1828 VIS_OBS_motionCategory_3 12 "Oncoming" 11 "Preceding" 10 "Moving" 9 "RTAP" 0 "Undefined" 1 "Passing" 2 "Passingin" 3 "Passingout" 4 "Closecutiin" 5 "Movingin" 6 "Movingout" 7 "Crossing" 8 "LTAP" ;
VAL_ 1828 VIS_OBS_motionOrientation_3 0 "Unknown" 1 "Driftingright" 2 "Crossingright" 3 "Oncomingdriftingright" 4 "Oncoming" 5 "Oncomingdriftingleft" 6 "Crossingleft" 7 "Driftingleft" 8 "Precedinge" ;
VAL_ 1828 VIS_OBS_CIPV_Lost_2 0 "NO_LOSS " 1 "LOST_TARGET_FOV_OUT " 2 "LOST_TARGET_FOV_IN" ;
VAL_ 1828 VIS_OBS_CIPV_Lost_3 0 "NO_LOSS " 1 "LOST_TARGET_FOV_OUT " 2 "LOST_TARGET_FOV_IN" ;
SIG_GROUP_ 1792 IFV410_Special 1 : AURIX_5V_Current_Voltage AURIX_3V3_Current_Voltage AURIX_1V25_Current_Voltage AURIX_1V2_Current_Voltage EDR_Event_Triggered AEB_EDR_Event_Triggered HandsOff_EDR_Event_Triggered SafeStop_EDR_Event_Triggered HEATER_OUT_Current_Voltage HSD_CS_Current_Voltage COMM_EN_Current_Voltage LKS_ISLW_Current_Voltage AURIX_2V8_Current_Voltage;
SIG_GROUP_ 1792 Common 1 : eyeq_static_calibration_error_e Status_Vision_Calib_Process VBattState_ECU CIB_Rolling_Counter VBattState_EyeQ4 VBattState_Comm VBattState_Diag ACC_Rolling_Counter Host_Rx_Valid_EyeQ4_SPI_Msgs Host_Thermal_Shutdown VBattU LKS_PCA_SW_Current_Voltage RawVBAT_AURIX_ADC RawAURIX_EYEQ_3V3_ADC RawAURIX_EYEQ_1V8_ADC RawAURIX_EYEQ_1V1_ADC RawAURIX_EYEQ_1V0_ADC EYEQ4_Off_wait_ms EYEQ4_Init_Retry_Counter EYEQ4_Core_Dump_wait_ms EYEQ4_Init_wait_ms EyeQIoSts_EYEQ4_AURIX_TEMP_EXCED EyeQIoSts_EYEQ4_AURIX_CORE_DUMP EyeQIoSts_EYEQ4_AURIX_BOOT EYEQ4_Reset_Request EyeQ4_SPI_Lost_Comm EyeQ4_SPI_Rolling_Count_Err EYEQ4_Thermal_Shutdown EYEQ4_Diagnostic_Shutdown EyeQ4InitTimeout EYEQ4_RESET EYEQ_1V8_Current_Voltage EYEQ_1V1_Current_Voltage EYEQ_1V0_Current_Voltage EYEQ_3V3_Current_Voltage AURIX_EYEQ4_PWR_EN AURIX_EYEQ4_3V3_EN EYEQ4_Power_Mode_State align_current_state VFP_State;

VERSION ""

NS_ :

BS_:

BU_: IFV410 External ASDM

BO_ 1840 VIS_TSR_SIGN_MSG1: 64 IFV410
 SG_ VIS_TSR_SIGN_6_Height : 488|8@1+ (0.125,-16) [-16|15.875] "N/A"  External
 SG_ VIS_TSR_SIGN_5_Height : 416|8@1+ (0.125,-16) [-16|15.875] "N/A"  External
 SG_ VIS_TSR_SIGN_4_Height : 344|8@1+ (0.125,-16) [-16|15.875] "N/A"  External
 SG_ VIS_TSR_SIGN_3_Height : 272|8@1+ (0.125,-16) [-16|15.875] "N/A"  External
 SG_ VIS_TSR_SIGN_2_Height : 200|8@1+ (0.125,-16) [-16|15.875] "N/A"  External
 SG_ VIS_TSR_SIGN_1_Height : 128|8@1+ (0.125,-16) [-16|15.875] "N/A"  External
 SG_ VIS_TSR_SIGN_0_Height : 56|8@1+ (0.125,-16) [-16|15.875] "N/A"  External
 SG_ VIS_TSR_SIGN_0_ID : 8|5@1+ (1,0) [0|19] "N/A"  External
 SG_ VIS_TSR_SIGN_0_Type : 13|9@1+ (1,0) [0|414] "N/A"  External
 SG_ VIS_TSR_SIGN_0_SupplementalType1 : 40|8@1+ (1,0) [0|255] "N/A"  External
 SG_ VIS_TSR_SIGN_0_SupplementalType2 : 48|8@1+ (1,0) [0|255] "N/A"  External
 SG_ VIS_TSR_SIGN_0_LatPosition : 22|9@1+ (0.25,-63) [-63|63] "N/A"  External
 SG_ VIS_TSR_SIGN_0_LongPosition : 31|9@1+ (0.25,0) [0|127] "N/A"  External
 SG_ VIS_TSR_SIGN_0_RelevantDecision : 72|4@1+ (1,0) [0|10] "N/A"  External
 SG_ VIS_TSR_SIGN_0_Conf : 64|5@1+ (0.0625,0) [0|1] "N/A"  External
 SG_ VIS_TSR_SIGN_1_ID : 80|5@1+ (1,0) [0|19] "N/A"  External
 SG_ VIS_TSR_SIGN_1_Type : 85|9@1+ (1,0) [0|414] "N/A"  External
 SG_ VIS_TSR_SIGN_1_SupplementalType1 : 112|8@1+ (1,0) [0|255] "N/A"  External
 SG_ VIS_TSR_SIGN_1_SupplementalType2 : 120|8@1+ (1,0) [0|255] "N/A"  External
 SG_ VIS_TSR_SIGN_1_LatPosition : 94|9@1+ (0.25,-63) [-63|63] "N/A"  External
 SG_ VIS_TSR_SIGN_1_LongPosition : 103|9@1+ (0.25,0) [0|127] "N/A"  External
 SG_ VIS_TSR_SIGN_1_RelevantDecision : 144|4@1+ (1,0) [0|10] "N/A"  External
 SG_ VIS_TSR_SIGN_1_Conf : 136|5@1+ (0.0625,0) [0|1] "N/A"  External
 SG_ VIS_TSR_SIGN_2_ID : 152|5@1+ (1,0) [0|19] "N/A"  External
 SG_ VIS_TSR_SIGN_2_Type : 157|9@1+ (1,0) [0|414] "N/A"  External
 SG_ VIS_TSR_SIGN_2_SupplementalType1 : 184|8@1+ (1,0) [0|255] "N/A"  External
 SG_ VIS_TSR_SIGN_2_SupplementalType2 : 192|8@1+ (1,0) [0|255] "N/A"  External
 SG_ VIS_TSR_SIGN_2_LatPosition : 166|9@1+ (0.25,-63) [-63|63] "N/A"  External
 SG_ VIS_TSR_SIGN_2_LongPosition : 175|9@1+ (0.25,0) [0|127] "N/A"  External
 SG_ VIS_TSR_SIGN_2_RelevantDecision : 216|4@1+ (1,0) [0|10] "N/A"  External
 SG_ VIS_TSR_SIGN_2_Conf : 208|5@1+ (0.0625,0) [0|1] "N/A"  External
 SG_ VIS_TSR_SIGN_3_ID : 224|5@1+ (1,0) [0|19] "N/A"  External
 SG_ VIS_TSR_SIGN_3_Type : 229|9@1+ (1,0) [0|414] "N/A"  External
 SG_ VIS_TSR_SIGN_3_SupplementalType1 : 256|8@1+ (1,0) [0|255] "N/A"  External
 SG_ VIS_TSR_SIGN_3_SupplementalType2 : 264|8@1+ (1,0) [0|255] "N/A"  External
 SG_ VIS_TSR_SIGN_3_LatPosition : 238|9@1+ (0.25,-63) [-63|63] "N/A"  External
 SG_ VIS_TSR_SIGN_3_LongPosition : 247|9@1+ (0.25,0) [0|127] "N/A"  External
 SG_ VIS_TSR_SIGN_3_RelevantDecision : 288|4@1+ (1,0) [0|10] "N/A"  External
 SG_ VIS_TSR_SIGN_3_Conf : 280|5@1+ (0.0625,0) [0|1] "N/A"  External
 SG_ VIS_TSR_SIGN_4_ID : 296|5@1+ (1,0) [0|19] "N/A"  External
 SG_ VIS_TSR_SIGN_4_Type : 301|9@1+ (1,0) [0|414] "N/A"  External
 SG_ VIS_TSR_SIGN_4_SupplementalType1 : 328|8@1+ (1,0) [0|255] "N/A"  External
 SG_ VIS_TSR_SIGN_4_SupplementalType2 : 336|8@1+ (1,0) [0|255] "N/A"  External
 SG_ VIS_TSR_SIGN_4_LatPosition : 310|9@1+ (0.25,-63) [-63|63] "N/A"  External
 SG_ VIS_TSR_SIGN_4_LongPosition : 319|9@1+ (0.25,0) [0|127] "N/A"  External
 SG_ VIS_TSR_SIGN_4_RelevantDecision : 360|4@1+ (1,0) [0|10] "N/A"  External
 SG_ VIS_TSR_SIGN_4_Conf : 352|5@1+ (0.0625,0) [0|1] "N/A"  External
 SG_ VIS_TSR_SIGN_5_ID : 368|5@1+ (1,0) [0|19] "N/A"  External
 SG_ VIS_TSR_SIGN_5_Type : 373|9@1+ (1,0) [0|414] "N/A"  External
 SG_ VIS_TSR_SIGN_5_SupplementalType1 : 400|8@1+ (1,0) [0|255] "N/A"  External
 SG_ VIS_TSR_SIGN_5_SupplementalType2 : 408|8@1+ (1,0) [0|255] "N/A"  External
 SG_ VIS_TSR_SIGN_5_LatPosition : 382|9@1+ (0.25,-63) [-63|63] "N/A"  External
 SG_ VIS_TSR_SIGN_5_LongPosition : 391|9@1+ (0.25,0) [0|127] "N/A"  External
 SG_ VIS_TSR_SIGN_5_RelevantDecision : 432|4@1+ (1,0) [0|10] "N/A"  External
 SG_ VIS_TSR_SIGN_5_Conf : 424|5@1+ (0.0625,0) [0|1] "N/A"  External
 SG_ VIS_TSR_SIGN_6_ID : 440|5@1+ (1,0) [0|19] "N/A"  External
 SG_ VIS_TSR_SIGN_6_Type : 445|9@1+ (1,0) [0|414] "N/A"  External
 SG_ VIS_TSR_SIGN_6_SupplementalType1 : 472|8@1+ (1,0) [0|255] "N/A"  External
 SG_ VIS_TSR_SIGN_6_SupplementalType2 : 480|8@1+ (1,0) [0|255] "N/A"  External
 SG_ VIS_TSR_SIGN_6_LatPosition : 454|9@1+ (0.25,-63) [-63|63] "N/A"  External
 SG_ VIS_TSR_SIGN_6_LongPosition : 463|9@1+ (0.25,0) [0|127] "N/A"  External
 SG_ VIS_TSR_SIGN_6_RelevantDecision : 504|4@1+ (1,0) [0|10] "N/A"  External
 SG_ VIS_TSR_SIGN_6_Conf : 496|5@1+ (0.0625,0) [0|1] "N/A"  External

BO_ 1841 VIS_TSR_SIGN_MSG2: 64 IFV410
 SG_ VIS_TSR_SIGN_13_Height : 488|8@1+ (0.125,-16) [-16|15.875] "N/A"  External
 SG_ VIS_TSR_SIGN_12_Height : 416|8@1+ (0.125,-16) [-16|15.875] "N/A"  External
 SG_ VIS_TSR_SIGN_11_Height : 344|8@1+ (0.125,-16) [-16|15.875] "N/A"  External
 SG_ VIS_TSR_SIGN_10_Height : 272|8@1+ (0.125,-16) [-16|15.875] "N/A"  External
 SG_ VIS_TSR_SIGN_9_Height : 200|8@1+ (0.125,-16) [-16|15.875] "N/A"  External
 SG_ VIS_TSR_SIGN_8_Height : 128|8@1+ (0.125,-16) [-16|15.875] "N/A"  External
 SG_ VIS_TSR_SIGN_7_Height : 56|8@1+ (0.125,-16) [-16|15.875] "N/A"  External
 SG_ VIS_TSR_SIGN_7_ID : 8|5@1+ (1,0) [0|19] "N/A"  External
 SG_ VIS_TSR_SIGN_7_Type : 13|9@1+ (1,0) [0|414] "N/A"  External
 SG_ VIS_TSR_SIGN_7_SupplementalType1 : 40|8@1+ (1,0) [0|255] "N/A"  External
 SG_ VIS_TSR_SIGN_7_SupplementalType2 : 48|8@1+ (1,0) [0|255] "N/A"  External
 SG_ VIS_TSR_SIGN_7_LatPosition : 22|9@1+ (0.25,-63) [-63|63] "N/A"  External
 SG_ VIS_TSR_SIGN_7_LongPosition : 31|9@1+ (0.25,0) [0|127] "N/A"  External
 SG_ VIS_TSR_SIGN_7_RelevantDecision : 72|4@1+ (1,0) [0|10] "N/A"  External
 SG_ VIS_TSR_SIGN_7_Conf : 64|5@1+ (0.0625,0) [0|1] "N/A"  External
 SG_ VIS_TSR_SIGN_8_ID : 80|5@1+ (1,0) [0|19] "N/A"  External
 SG_ VIS_TSR_SIGN_8_Type : 85|9@1+ (1,0) [0|414] "N/A"  External
 SG_ VIS_TSR_SIGN_8_SupplementalType1 : 112|8@1+ (1,0) [0|255] "N/A"  External
 SG_ VIS_TSR_SIGN_8_SupplementalType2 : 120|8@1+ (1,0) [0|255] "N/A"  External
 SG_ VIS_TSR_SIGN_8_LatPosition : 94|9@1+ (0.25,-63) [-63|63] "N/A"  External
 SG_ VIS_TSR_SIGN_8_LongPosition : 103|9@1+ (0.25,0) [0|127] "N/A"  External
 SG_ VIS_TSR_SIGN_8_RelevantDecision : 144|4@1+ (1,0) [0|10] "N/A"  External
 SG_ VIS_TSR_SIGN_8_Conf : 136|5@1+ (0.0625,0) [0|1] "N/A"  External
 SG_ VIS_TSR_SIGN_9_ID : 152|5@1+ (1,0) [0|19] "N/A"  External
 SG_ VIS_TSR_SIGN_9_Type : 157|9@1+ (1,0) [0|414] "N/A"  External
 SG_ VIS_TSR_SIGN_9_SupplementalType1 : 184|8@1+ (1,0) [0|255] "N/A"  External
 SG_ VIS_TSR_SIGN_9_SupplementalType2 : 192|8@1+ (1,0) [0|255] "N/A"  External
 SG_ VIS_TSR_SIGN_9_LatPosition : 166|9@1+ (0.25,-63) [-63|63] "N/A"  External
 SG_ VIS_TSR_SIGN_9_LongPosition : 175|9@1+ (0.25,0) [0|127] "N/A"  External
 SG_ VIS_TSR_SIGN_9_RelevantDecision : 216|4@1+ (1,0) [0|10] "N/A"  External
 SG_ VIS_TSR_SIGN_9_Conf : 208|5@1+ (0.0625,0) [0|1] "N/A"  External
 SG_ VIS_TSR_SIGN_10_ID : 224|5@1+ (1,0) [0|19] "N/A"  External
 SG_ VIS_TSR_SIGN_10_Type : 229|9@1+ (1,0) [0|414] "N/A"  External
 SG_ VIS_TSR_SIGN_10_SupplementalType : 256|8@1+ (1,0) [0|255] "N/A"  External
 SG_ VIS_TSR_SIGN_10_Supplementa_0000 : 264|8@1+ (1,0) [0|255] "N/A"  External
 SG_ VIS_TSR_SIGN_10_LatPosition : 238|9@1+ (0.25,-63) [-63|63] "N/A"  External
 SG_ VIS_TSR_SIGN_10_LongPosition : 247|9@1+ (0.25,0) [0|127] "N/A"  External
 SG_ VIS_TSR_SIGN_10_RelevantDecision : 288|4@1+ (1,0) [0|10] "N/A"  External
 SG_ VIS_TSR_SIGN_10_Conf : 280|5@1+ (0.0625,0) [0|1] "N/A"  External
 SG_ VIS_TSR_SIGN_11_ID : 296|5@1+ (1,0) [0|19] "N/A"  External
 SG_ VIS_TSR_SIGN_11_Type : 301|9@1+ (1,0) [0|414] "N/A"  External
 SG_ VIS_TSR_SIGN_11_SupplementalType : 328|8@1+ (1,0) [0|255] "N/A"  External
 SG_ VIS_TSR_SIGN_11_Supplementa_0000 : 336|8@1+ (1,0) [0|255] "N/A"  External
 SG_ VIS_TSR_SIGN_11_LatPosition : 310|9@1+ (0.25,-63) [-63|63] "N/A"  External
 SG_ VIS_TSR_SIGN_11_LongPosition : 319|9@1+ (0.25,0) [0|127] "N/A"  External
 SG_ VIS_TSR_SIGN_11_RelevantDecision : 360|4@1+ (1,0) [0|10] "N/A"  External
 SG_ VIS_TSR_SIGN_11_Conf : 352|5@1+ (0.0625,0) [0|1] "N/A"  External
 SG_ VIS_TSR_SIGN_12_ID : 368|5@1+ (1,0) [0|19] "N/A"  External
 SG_ VIS_TSR_SIGN_12_Type : 373|9@1+ (1,0) [0|414] "N/A"  External
 SG_ VIS_TSR_SIGN_12_SupplementalType : 400|8@1+ (1,0) [0|255] "N/A"  External
 SG_ VIS_TSR_SIGN_12_Supplementa_0000 : 408|8@1+ (1,0) [0|255] "N/A"  External
 SG_ VIS_TSR_SIGN_12_LatPosition : 382|9@1+ (0.25,-63) [-63|63] "N/A"  External
 SG_ VIS_TSR_SIGN_12_LongPosition : 391|9@1+ (0.25,0) [0|127] "N/A"  External
 SG_ VIS_TSR_SIGN_12_RelevantDecision : 432|4@1+ (1,0) [0|10] "N/A"  External
 SG_ VIS_TSR_SIGN_12_Conf : 424|5@1+ (0.0625,0) [0|1] "N/A"  External
 SG_ VIS_TSR_SIGN_13_ID : 440|5@1+ (1,0) [0|19] "N/A"  External
 SG_ VIS_TSR_SIGN_13_Type : 445|9@1+ (1,0) [0|414] "N/A"  External
 SG_ VIS_TSR_SIGN_13_SupplementalType : 472|8@1+ (1,0) [0|255] "N/A"  External
 SG_ VIS_TSR_SIGN_13_Supplementa_0000 : 480|8@1+ (1,0) [0|255] "N/A"  External
 SG_ VIS_TSR_SIGN_13_LatPosition : 454|9@1+ (0.25,-63) [-63|63] "N/A"  External
 SG_ VIS_TSR_SIGN_13_LongPosition : 463|9@1+ (0.25,0) [0|127] "N/A"  External
 SG_ VIS_TSR_SIGN_13_RelevantDecision : 504|4@1+ (1,0) [0|10] "N/A"  External
 SG_ VIS_TSR_SIGN_13_Conf : 496|5@1+ (0.0625,0) [0|1] "N/A"  External

BO_ 1842 VIS_TSR_SIGN_MSG3: 64 IFV410
 SG_ VIS_TSR_SIGN_19_Height : 408|8@1+ (0.125,-16) [-16|15.875] "N/A"  External
 SG_ VIS_TSR_SIGN_18_Height : 336|8@1+ (0.125,-16) [-16|15.875] "N/A"  External
 SG_ VIS_TSR_SIGN_17_Height : 264|8@1+ (0.125,-16) [-16|15.875] "N/A"  External
 SG_ VIS_TSR_SIGN_16_Height : 192|8@1+ (0.125,-16) [-16|15.875] "N/A"  External
 SG_ VIS_TSR_SIGN_15_Height : 120|8@1+ (0.125,-16) [-16|15.875] "N/A"  External
 SG_ VIS_TSR_SIGN_14_Height : 48|8@1+ (0.125,-16) [-16|15.875] "N/A"  External
 SG_ VIS_TSR_SIGN_14_ID : 0|5@1+ (1,0) [0|19] "N/A"  External
 SG_ VIS_TSR_SIGN_14_Type : 5|9@1+ (1,0) [0|414] "N/A"  External
 SG_ VIS_TSR_SIGN_14_SupplementalType : 32|8@1+ (1,0) [0|255] "N/A"  External
 SG_ VIS_TSR_SIGN_14_Supplementa_0000 : 40|8@1+ (1,0) [0|255] "N/A"  External
 SG_ VIS_TSR_SIGN_14_LatPosition : 14|9@1+ (0.25,-63) [-63|63] "N/A"  External
 SG_ VIS_TSR_SIGN_14_LongPosition : 23|9@1+ (0.25,0) [0|127] "N/A"  External
 SG_ VIS_TSR_SIGN_14_RelevantDecision : 64|4@1+ (1,0) [0|10] "N/A"  External
 SG_ VIS_TSR_SIGN_14_Conf : 56|5@1+ (0.0625,0) [0|1] "N/A"  External
 SG_ VIS_TSR_SIGN_15_ID : 72|5@1+ (1,0) [0|19] "N/A"  External
 SG_ VIS_TSR_SIGN_15_Type : 77|9@1+ (1,0) [0|414] "N/A"  External
 SG_ VIS_TSR_SIGN_15_SupplementalType : 104|8@1+ (1,0) [0|255] "N/A"  External
 SG_ VIS_TSR_SIGN_15_Supplementa_0000 : 112|8@1+ (1,0) [0|255] "N/A"  External
 SG_ VIS_TSR_SIGN_15_LatPosition : 86|9@1+ (0.25,-63) [-63|63] "N/A"  External
 SG_ VIS_TSR_SIGN_15_LongPosition : 95|9@1+ (0.25,0) [0|127] "N/A"  External
 SG_ VIS_TSR_SIGN_15_RelevantDecision : 136|4@1+ (1,0) [0|10] "N/A"  External
 SG_ VIS_TSR_SIGN_15_Conf : 128|5@1+ (0.0625,0) [0|1] "N/A"  External
 SG_ VIS_TSR_SIGN_16_ID : 144|5@1+ (1,0) [0|19] "N/A"  External
 SG_ VIS_TSR_SIGN_16_Type : 149|9@1+ (1,0) [0|414] "N/A"  External
 SG_ VIS_TSR_SIGN_16_SupplementalType : 176|8@1+ (1,0) [0|255] "N/A"  External
 SG_ VIS_TSR_SIGN_16_Supplementa_0000 : 184|8@1+ (1,0) [0|255] "N/A"  External
 SG_ VIS_TSR_SIGN_16_LatPosition : 167|9@1+ (0.25,-63) [-63|63] "N/A"  External
 SG_ VIS_TSR_SIGN_16_LongPosition : 158|9@1+ (0.25,0) [0|127] "N/A"  External
 SG_ VIS_TSR_SIGN_16_RelevantDecision : 208|4@1+ (1,0) [0|10] "N/A"  External
 SG_ VIS_TSR_SIGN_16_Conf : 200|5@1+ (0.0625,0) [0|1] "N/A"  External
 SG_ VIS_TSR_SIGN_17_ID : 216|5@1+ (1,0) [0|19] "N/A"  External
 SG_ VIS_TSR_SIGN_17_Type : 221|9@1+ (1,0) [0|414] "N/A"  External
 SG_ VIS_TSR_SIGN_17_SupplementalType : 248|8@1+ (1,0) [0|255] "N/A"  External
 SG_ VIS_TSR_SIGN_17_Supplementa_0000 : 256|8@1+ (1,0) [0|255] "N/A"  External
 SG_ VIS_TSR_SIGN_17_LatPosition : 230|9@1+ (0.25,-63) [-63|63] "N/A"  External
 SG_ VIS_TSR_SIGN_17_LongPosition : 239|9@1+ (0.25,0) [0|127] "N/A"  External
 SG_ VIS_TSR_SIGN_17_RelevantDecision : 280|4@1+ (1,0) [0|10] "N/A"  External
 SG_ VIS_TSR_SIGN_17_Conf : 272|5@1+ (0.0625,0) [0|1] "N/A"  External
 SG_ VIS_TSR_SIGN_18_ID : 288|5@1+ (1,0) [0|19] "N/A"  External
 SG_ VIS_TSR_SIGN_18_Type : 293|9@1+ (1,0) [0|414] "N/A"  External
 SG_ VIS_TSR_SIGN_18_SupplementalType : 320|8@1+ (1,0) [0|255] "N/A"  External
 SG_ VIS_TSR_SIGN_18_Supplementa_0000 : 328|8@1+ (1,0) [0|255] "N/A"  External
 SG_ VIS_TSR_SIGN_18_LatPosition : 302|9@1+ (0.25,-63) [-63|63] "N/A"  External
 SG_ VIS_TSR_SIGN_18_LongPosition : 311|9@1+ (0.25,0) [0|127] "N/A"  External
 SG_ VIS_TSR_SIGN_18_RelevantDecision : 352|4@1+ (1,0) [0|10] "N/A"  External
 SG_ VIS_TSR_SIGN_18_Conf : 344|5@1+ (0.0625,0) [0|1] "N/A"  External
 SG_ VIS_TSR_SIGN_19_ID : 360|5@1+ (1,0) [0|19] "N/A"  External
 SG_ VIS_TSR_SIGN_19_Type : 365|9@1+ (1,0) [0|414] "N/A"  External
 SG_ VIS_TSR_SIGN_19_SupplementalType : 392|8@1+ (1,0) [0|255] "N/A"  External
 SG_ VIS_TSR_SIGN_19_Supplementa_0000 : 400|8@1+ (1,0) [0|255] "N/A"  External
 SG_ VIS_TSR_SIGN_19_LatPosition : 374|9@1+ (0.25,-63) [-63|63] "N/A"  External
 SG_ VIS_TSR_SIGN_19_LongPosition : 383|9@1+ (0.25,0) [0|127] "N/A"  External
 SG_ VIS_TSR_SIGN_19_RelevantDecision : 424|4@1+ (1,0) [0|10] "N/A"  External
 SG_ VIS_TSR_SIGN_19_Conf : 416|5@1+ (0.0625,0) [0|1] "N/A"  External

BO_ 1843 VIS_TSR_STOPLINES_MSG1: 64 IFV410
 SG_ VIS_TSR_roadMarking_0_StopLinesM : 0|4@1+ (1,0) [0|10] "N/A"  External
 SG_ VIS_TSR_roadMarking_0_StopLines_ : 4|8@1+ (1,0) [0|255] "N/A"  External
 SG_ VIS_TSR_roadMarking_0_StopL_0000 : 12|9@1+ (1,0) [0|414] "N/A"  External
 SG_ VIS_TSR_roadMarking_0_StopL_0001 : 21|2@1+ (1,0) [0|2] ""  External
 SG_ VIS_TSR_roadMarking_0_StopL_0002 : 23|2@1+ (1,0) [0|2] "N/A"  External
 SG_ VIS_TSR_roadMarking_0_StopL_0003 : 25|1@1+ (1,0) [0|1] "N/A"  External
 SG_ VIS_TSR_roadMarking_0_StopL_0004 : 26|8@1+ (0.025,-3) [-3|3] "RAD"  External
 SG_ VIS_TSR_roadMarking_0_StopL_0005 : 34|8@1+ (0.005,0) [0|1] "N/A"  External
 SG_ VIS_TSR_roadMarking_0_StopL_0006 : 42|12@1+ (0.05,-100) [-100|100] "m"  External
 SG_ VIS_TSR_roadMarking_0_StopL_0007 : 54|13@1+ (0.05,-10) [-10|200] "m"  External
 SG_ VIS_TSR_roadMarking_1_StopLinesM : 67|4@1+ (1,0) [0|10] "N/A"  External
 SG_ VIS_TSR_roadMarking_1_StopLines_ : 71|8@1+ (1,0) [0|255] "N/A"  External
 SG_ VIS_TSR_roadMarking_1_StopL_0000 : 79|9@1+ (1,0) [0|414] "N/A"  External
 SG_ VIS_TSR_roadMarking_1_StopL_0001 : 88|2@1+ (1,0) [0|2] ""  External
 SG_ VIS_TSR_roadMarking_1_StopL_0002 : 90|2@1+ (1,0) [0|2] "N/A"  External
 SG_ VIS_TSR_roadMarking_1_StopL_0003 : 92|1@1+ (1,0) [0|1] "N/A"  External
 SG_ VIS_TSR_roadMarking_1_StopL_0004 : 93|8@1+ (0.025,-3) [-3|3] "RAD"  External
 SG_ VIS_TSR_roadMarking_1_StopL_0005 : 101|8@1+ (0.005,0) [0|1] "N/A"  External
 SG_ VIS_TSR_roadMarking_1_StopL_0006 : 109|12@1+ (0.05,-100) [-100|100] "m"  External
 SG_ VIS_TSR_roadMarking_1_StopL_0007 : 121|13@1+ (0.05,-10) [-10|200] "m"  External
 SG_ VIS_TSR_roadMarking_2_StopLinesM : 134|4@1+ (1,0) [0|10] "N/A"  External
 SG_ VIS_TSR_roadMarking_2_StopLines_ : 138|8@1+ (1,0) [0|255] "N/A"  External
 SG_ VIS_TSR_roadMarking_2_StopL_0000 : 146|9@1+ (1,0) [0|414] "N/A"  External
 SG_ VIS_TSR_roadMarking_2_StopL_0001 : 155|2@1+ (1,0) [0|2] ""  External
 SG_ VIS_TSR_roadMarking_2_StopL_0002 : 157|2@1+ (1,0) [0|2] "N/A"  External
 SG_ VIS_TSR_roadMarking_2_StopL_0003 : 159|1@1+ (1,0) [0|1] "N/A"  External
 SG_ VIS_TSR_roadMarking_2_StopL_0004 : 160|8@1+ (0.025,-3) [-3|3] "RAD"  External
 SG_ VIS_TSR_roadMarking_2_StopL_0005 : 168|8@1+ (0.005,0) [0|1] "N/A"  External
 SG_ VIS_TSR_roadMarking_2_StopL_0006 : 176|12@1+ (0.05,-100) [-100|100] "m"  External
 SG_ VIS_TSR_roadMarking_2_StopL_0007 : 188|13@1+ (0.05,-10) [-10|200] "m"  External
 SG_ VIS_TSR_roadMarking_3_StopLinesM : 201|4@1+ (1,0) [0|10] "N/A"  External
 SG_ VIS_TSR_roadMarking_3_StopLines_ : 205|8@1+ (1,0) [0|255] "N/A"  External
 SG_ VIS_TSR_roadMarking_3_StopL_0000 : 213|9@1+ (1,0) [0|414] "N/A"  External
 SG_ VIS_TSR_roadMarking_3_StopL_0001 : 222|2@1+ (1,0) [0|2] ""  External
 SG_ VIS_TSR_roadMarking_3_StopL_0002 : 224|2@1+ (1,0) [0|2] "N/A"  External
 SG_ VIS_TSR_roadMarking_3_StopL_0003 : 226|1@1+ (1,0) [0|1] "N/A"  External
 SG_ VIS_TSR_roadMarking_3_StopL_0004 : 227|8@1+ (0.025,-3) [-3|3] "RAD"  External
 SG_ VIS_TSR_roadMarking_3_StopL_0005 : 235|8@1+ (0.005,0) [0|1] "N/A"  External
 SG_ VIS_TSR_roadMarking_3_StopL_0006 : 243|12@1+ (0.05,-100) [-100|100] "m"  External
 SG_ VIS_TSR_roadMarking_3_StopL_0007 : 255|13@1+ (0.05,-10) [-10|200] "m"  External
 SG_ VIS_TSR_roadMarking_4_StopLinesM : 268|4@1+ (1,0) [0|10] "N/A"  External
 SG_ VIS_TSR_roadMarking_4_StopLines_ : 272|8@1+ (1,0) [0|255] "N/A"  External
 SG_ VIS_TSR_roadMarking_4_StopL_0000 : 280|9@1+ (1,0) [0|414] "N/A"  External
 SG_ VIS_TSR_roadMarking_4_StopL_0001 : 289|2@1+ (1,0) [0|2] ""  External
 SG_ VIS_TSR_roadMarking_4_StopL_0002 : 291|2@1+ (1,0) [0|2] "N/A"  External
 SG_ VIS_TSR_roadMarking_4_StopL_0003 : 293|1@1+ (1,0) [0|1] "N/A"  External
 SG_ VIS_TSR_roadMarking_4_StopL_0004 : 294|8@1+ (0.025,-3) [-3|3] "RAD"  External
 SG_ VIS_TSR_roadMarking_4_StopL_0005 : 302|8@1+ (0.005,0) [0|1] "N/A"  External
 SG_ VIS_TSR_roadMarking_4_StopL_0006 : 310|12@1+ (0.05,-100) [-100|100] "m"  External
 SG_ VIS_TSR_roadMarking_4_StopL_0007 : 322|13@1+ (0.05,-10) [-10|200] "m"  External

BO_ 1844 VIS_TSR_STOPLINES_MSG2: 64 IFV410
 SG_ VIS_TSR_roadMarking_5_StopLinesM : 0|4@1+ (1,0) [0|10] "N/A"  External
 SG_ VIS_TSR_roadMarking_5_StopLines_ : 4|8@1+ (1,0) [0|255] "N/A"  External
 SG_ VIS_TSR_roadMarking_5_StopL_0000 : 12|9@1+ (1,0) [0|414] "N/A"  External
 SG_ VIS_TSR_roadMarking_5_StopL_0001 : 21|2@1+ (1,0) [0|2] ""  External
 SG_ VIS_TSR_roadMarking_5_StopL_0002 : 23|2@1+ (1,0) [0|2] "N/A"  External
 SG_ VIS_TSR_roadMarking_5_StopL_0003 : 25|1@1+ (1,0) [0|1] "N/A"  External
 SG_ VIS_TSR_roadMarking_5_StopL_0004 : 26|8@1+ (0.025,-3) [-3|3] "RAD"  External
 SG_ VIS_TSR_roadMarking_5_StopL_0005 : 34|8@1+ (0.005,0) [0|1] "N/A"  External
 SG_ VIS_TSR_roadMarking_5_StopL_0006 : 42|12@1+ (0.05,-100) [-100|100] "m"  External
 SG_ VIS_TSR_roadMarking_5_StopL_0007 : 54|13@1+ (0.05,-10) [-10|200] "m"  External
 SG_ VIS_TSR_roadMarking_6_StopLinesM : 67|4@1+ (1,0) [0|10] "N/A"  External
 SG_ VIS_TSR_roadMarking_6_StopLines_ : 71|8@1+ (1,0) [0|255] "N/A"  External
 SG_ VIS_TSR_roadMarking_6_StopL_0000 : 79|9@1+ (1,0) [0|414] "N/A"  External
 SG_ VIS_TSR_roadMarking_6_StopL_0001 : 88|2@1+ (1,0) [0|2] ""  External
 SG_ VIS_TSR_roadMarking_6_StopL_0002 : 90|2@1+ (1,0) [0|2] "N/A"  External
 SG_ VIS_TSR_roadMarking_6_StopL_0003 : 92|1@1+ (1,0) [0|1] "N/A"  External
 SG_ VIS_TSR_roadMarking_6_StopL_0004 : 93|8@1+ (0.025,-3) [-3|3] "RAD"  External
 SG_ VIS_TSR_roadMarking_6_StopL_0005 : 101|8@1+ (0.005,0) [0|1] "N/A"  External
 SG_ VIS_TSR_roadMarking_6_StopL_0006 : 109|12@1+ (0.05,-100) [-100|100] "m"  External
 SG_ VIS_TSR_roadMarking_6_StopL_0007 : 121|13@1+ (0.05,-10) [-10|200] "m"  External
 SG_ VIS_TSR_roadMarking_7_StopLinesM : 134|4@1+ (1,0) [0|10] "N/A"  External
 SG_ VIS_TSR_roadMarking_7_StopLines_ : 138|8@1+ (1,0) [0|255] "N/A"  External
 SG_ VIS_TSR_roadMarking_7_StopL_0000 : 146|9@1+ (1,0) [0|414] "N/A"  External
 SG_ VIS_TSR_roadMarking_7_StopL_0001 : 155|2@1+ (1,0) [0|2] ""  External
 SG_ VIS_TSR_roadMarking_7_StopL_0002 : 157|2@1+ (1,0) [0|2] "N/A"  External
 SG_ VIS_TSR_roadMarking_7_StopL_0003 : 159|1@1+ (1,0) [0|1] "N/A"  External
 SG_ VIS_TSR_roadMarking_7_StopL_0004 : 160|8@1+ (0.025,-3) [-3|3] "RAD"  External
 SG_ VIS_TSR_roadMarking_7_StopL_0005 : 168|8@1+ (0.005,0) [0|1] "N/A"  External
 SG_ VIS_TSR_roadMarking_7_StopL_0006 : 176|12@1+ (0.05,-100) [-100|100] "m"  External
 SG_ VIS_TSR_roadMarking_7_StopL_0007 : 188|13@1+ (0.05,-10) [-10|200] "m"  External
 SG_ VIS_TSR_roadMarking_8_StopLinesM : 201|4@1+ (1,0) [0|10] "N/A"  External
 SG_ VIS_TSR_roadMarking_8_StopLines_ : 205|8@1+ (1,0) [0|255] "N/A"  External
 SG_ VIS_TSR_roadMarking_8_StopL_0000 : 213|9@1+ (1,0) [0|414] "N/A"  External
 SG_ VIS_TSR_roadMarking_8_StopL_0001 : 222|2@1+ (1,0) [0|2] ""  External
 SG_ VIS_TSR_roadMarking_8_StopL_0002 : 224|2@1+ (1,0) [0|2] "N/A"  External
 SG_ VIS_TSR_roadMarking_8_StopL_0003 : 226|1@1+ (1,0) [0|1] "N/A"  External
 SG_ VIS_TSR_roadMarking_8_StopL_0004 : 227|8@1+ (0.025,-3) [-3|3] "RAD"  External
 SG_ VIS_TSR_roadMarking_8_StopL_0005 : 235|8@1+ (0.005,0) [0|1] "N/A"  External
 SG_ VIS_TSR_roadMarking_8_StopL_0006 : 243|12@1+ (0.05,-100) [-100|100] "m"  External
 SG_ VIS_TSR_roadMarking_8_StopL_0007 : 255|13@1+ (0.05,-10) [-10|200] "m"  External
 SG_ VIS_TSR_roadMarking_9_StopLinesM : 268|4@1+ (1,0) [0|10] "N/A"  External
 SG_ VIS_TSR_roadMarking_9_StopLines_ : 272|8@1+ (1,0) [0|255] "N/A"  External
 SG_ VIS_TSR_roadMarking_9_StopL_0000 : 280|9@1+ (1,0) [0|414] "N/A"  External
 SG_ VIS_TSR_roadMarking_9_StopL_0001 : 289|2@1+ (1,0) [0|2] ""  External
 SG_ VIS_TSR_roadMarking_9_StopL_0002 : 291|2@1+ (1,0) [0|2] "N/A"  External
 SG_ VIS_TSR_roadMarking_9_StopL_0003 : 293|1@1+ (1,0) [0|1] "N/A"  External
 SG_ VIS_TSR_roadMarking_9_StopL_0004 : 294|8@1+ (0.025,-3) [-3|3] "RAD"  External
 SG_ VIS_TSR_roadMarking_9_StopL_0005 : 302|8@1+ (0.005,0) [0|1] "N/A"  External
 SG_ VIS_TSR_roadMarking_9_StopL_0006 : 310|12@1+ (0.05,-100) [-100|100] "m"  External
 SG_ VIS_TSR_roadMarking_9_StopL_0007 : 322|13@1+ (0.05,-10) [-10|200] "m"  External

BO_ 1845 VIS_TSR_ARROWS_MSG: 64 IFV410
 SG_ VIS_TSR_roadMarking_0_Arrows_ID : 0|8@1+ (1,0) [0|255] "N/A"  External
 SG_ VIS_TSR_roadMarking_0_Arrows_Typ : 8|9@1+ (1,0) [0|414] "N/A"  External
 SG_ VIS_TSR_roadMarking_0_Arrows_con : 17|8@1+ (0.005,0) [0|1] "N/A"  External
 SG_ VIS_TSR_roadMarking_0_Arrows_Lat : 25|12@1+ (0.025,-32) [-32|31] "m"  External
 SG_ VIS_TSR_roadMarking_0_Arrows_Lon : 37|13@1+ (0.05,-5) [-5|200] "m"  External
 SG_ VIS_TSR_roadMarking_1_Arrows_ID : 50|8@1+ (1,0) [0|255] "N/A"  External
 SG_ VIS_TSR_roadMarking_1_Arrows_Typ : 58|9@1+ (1,0) [0|414] "N/A"  External
 SG_ VIS_TSR_roadMarking_1_Arrows_con : 67|8@1+ (0.005,0) [0|1] "N/A"  External
 SG_ VIS_TSR_roadMarking_1_Arrows_Lat : 75|12@1+ (0.025,-32) [-32|31] "m"  External
 SG_ VIS_TSR_roadMarking_1_Arrows_Lon : 87|13@1+ (0.05,-5) [-5|200] "m"  External
 SG_ VIS_TSR_roadMarking_2_Arrows_ID : 100|8@1+ (1,0) [0|255] "N/A"  External
 SG_ VIS_TSR_roadMarking_2_Arrows_Typ : 108|9@1+ (1,0) [0|414] "N/A"  External
 SG_ VIS_TSR_roadMarking_2_Arrows_con : 117|8@1+ (0.005,0) [0|1] "N/A"  External
 SG_ VIS_TSR_roadMarking_2_Arrows_Lat : 125|12@1+ (0.025,-32) [-32|31] "m"  External
 SG_ VIS_TSR_roadMarking_2_Arrows_Lon : 137|13@1+ (0.05,-5) [-5|200] "m"  External
 SG_ VIS_TSR_roadMarking_3_Arrows_ID : 150|8@1+ (1,0) [0|255] "N/A"  External
 SG_ VIS_TSR_roadMarking_3_Arrows_Typ : 158|9@1+ (1,0) [0|414] "N/A"  External
 SG_ VIS_TSR_roadMarking_3_Arrows_con : 167|8@1+ (0.005,0) [0|1] "N/A"  External
 SG_ VIS_TSR_roadMarking_3_Arrows_Lat : 175|12@1+ (0.025,-32) [-32|31] "m"  External
 SG_ VIS_TSR_roadMarking_3_Arrows_Lon : 187|13@1+ (0.05,-5) [-5|200] "m"  External
 SG_ VIS_TSR_roadMarking_4_Arrows_ID : 200|8@1+ (1,0) [0|255] "N/A"  External
 SG_ VIS_TSR_roadMarking_4_Arrows_Typ : 208|9@1+ (1,0) [0|414] "N/A"  External
 SG_ VIS_TSR_roadMarking_4_Arrows_con : 217|8@1+ (0.005,0) [0|1] "N/A"  External
 SG_ VIS_TSR_roadMarking_4_Arrows_Lat : 225|12@1+ (0.025,-32) [-32|31] "m"  External
 SG_ VIS_TSR_roadMarking_4_Arrows_Lon : 237|13@1+ (0.05,-5) [-5|200] "m"  External
 SG_ VIS_TSR_roadMarking_5_Arrows_ID : 250|8@1+ (1,0) [0|255] "N/A"  External
 SG_ VIS_TSR_roadMarking_5_Arrows_Typ : 258|9@1+ (1,0) [0|414] "N/A"  External
 SG_ VIS_TSR_roadMarking_5_Arrows_con : 267|8@1+ (0.005,0) [0|1] "N/A"  External
 SG_ VIS_TSR_roadMarking_5_Arrows_Lat : 275|12@1+ (0.025,-32) [-32|31] "m"  External
 SG_ VIS_TSR_roadMarking_5_Arrows_Lon : 287|13@1+ (0.05,-5) [-5|200] "m"  External
 SG_ VIS_TSR_roadMarking_6_Arrows_ID : 300|8@1+ (1,0) [0|255] "N/A"  External
 SG_ VIS_TSR_roadMarking_6_Arrows_Typ : 308|9@1+ (1,0) [0|414] "N/A"  External
 SG_ VIS_TSR_roadMarking_6_Arrows_con : 317|8@1+ (0.005,0) [0|1] "N/A"  External
 SG_ VIS_TSR_roadMarking_6_Arrows_Lat : 325|12@1+ (0.025,-32) [-32|31] "m"  External
 SG_ VIS_TSR_roadMarking_6_Arrows_Lon : 337|13@1+ (0.05,-5) [-5|200] "m"  External
 SG_ VIS_TSR_roadMarking_7_Arrows_ID : 350|8@1+ (1,0) [0|255] "N/A"  External
 SG_ VIS_TSR_roadMarking_7_Arrows_Typ : 358|9@1+ (1,0) [0|414] "N/A"  External
 SG_ VIS_TSR_roadMarking_7_Arrows_con : 367|8@1+ (0.005,0) [0|1] "N/A"  External
 SG_ VIS_TSR_roadMarking_7_Arrows_Lat : 375|12@1+ (0.025,-32) [-32|31] "m"  External
 SG_ VIS_TSR_roadMarking_7_Arrows_Lon : 387|13@1+ (0.05,-5) [-5|200] "m"  External
 SG_ VIS_TSR_roadMarking_8_Arrows_ID : 400|8@1+ (1,0) [0|255] "N/A"  External
 SG_ VIS_TSR_roadMarking_8_Arrows_Typ : 408|9@1+ (1,0) [0|414] "N/A"  External
 SG_ VIS_TSR_roadMarking_8_Arrows_con : 417|8@1+ (0.005,0) [0|1] "N/A"  External
 SG_ VIS_TSR_roadMarking_8_Arrows_Lat : 425|12@1+ (0.025,-32) [-32|31] "m"  External
 SG_ VIS_TSR_roadMarking_8_Arrows_Lon : 437|13@1+ (0.05,-5) [-5|200] "m"  External
 SG_ VIS_TSR_roadMarking_9_Arrows_ID : 450|8@1+ (1,0) [0|255] "N/A"  External
 SG_ VIS_TSR_roadMarking_9_Arrows_Typ : 458|9@1+ (1,0) [0|414] "N/A"  External
 SG_ VIS_TSR_roadMarking_9_Arrows_con : 467|8@1+ (0.005,0) [0|1] "N/A"  External
 SG_ VIS_TSR_roadMarking_9_Arrows_Lat : 475|12@1+ (0.025,-32) [-32|31] "m"  External
 SG_ VIS_TSR_roadMarking_9_Arrows_Lon : 487|13@1+ (0.05,-5) [-5|200] "m"  External

BO_ 1846 VIS_TSR_SPD_LIM_MSG: 64 IFV410
 SG_ VIS_TSR_roadMarking_0_SpeedLimit : 0|8@1+ (1,0) [0|255] "N/A"  External
 SG_ VIS_TSR_roadMarking_0_Speed_0000 : 8|9@1+ (1,0) [0|414] "N/A"  External
 SG_ VIS_TSR_roadMarking_0_Speed_0001 : 17|8@1+ (0.005,0) [0|1] "N/A"  External
 SG_ VIS_TSR_roadMarking_0_Speed_0002 : 25|12@1+ (0.025,-32) [-32|31] "m"  External
 SG_ VIS_TSR_roadMarking_0_Speed_0003 : 37|13@1+ (0.05,-5) [-5|200] "m"  External
 SG_ VIS_TSR_roadMarking_1_SpeedLimit : 50|8@1+ (1,0) [0|255] "N/A"  External
 SG_ VIS_TSR_roadMarking_1_Speed_0000 : 58|9@1+ (1,0) [0|414] "N/A"  External
 SG_ VIS_TSR_roadMarking_1_Speed_0001 : 67|8@1+ (0.005,0) [0|1] "N/A"  External
 SG_ VIS_TSR_roadMarking_1_Speed_0002 : 75|12@1+ (0.025,-32) [-32|31] "m"  External
 SG_ VIS_TSR_roadMarking_1_Speed_0003 : 87|13@1+ (0.05,-5) [-5|200] "m"  External
 SG_ VIS_TSR_roadMarking_2_SpeedLimit : 100|8@1+ (1,0) [0|255] "N/A"  External
 SG_ VIS_TSR_roadMarking_2_Speed_0000 : 108|9@1+ (1,0) [0|414] "N/A"  External
 SG_ VIS_TSR_roadMarking_2_Speed_0001 : 117|8@1+ (0.005,0) [0|1] "N/A"  External
 SG_ VIS_TSR_roadMarking_2_Speed_0002 : 125|12@1+ (0.025,-32) [-32|31] "m"  External
 SG_ VIS_TSR_roadMarking_2_Speed_0003 : 137|13@1+ (0.05,-5) [-5|200] "m"  External
 SG_ VIS_TSR_roadMarking_3_SpeedLimit : 150|8@1+ (1,0) [0|255] "N/A"  External
 SG_ VIS_TSR_roadMarking_3_Speed_0000 : 158|9@1+ (1,0) [0|414] "N/A"  External
 SG_ VIS_TSR_roadMarking_3_Speed_0001 : 167|8@1+ (0.005,0) [0|1] "N/A"  External
 SG_ VIS_TSR_roadMarking_3_Speed_0002 : 175|12@1+ (0.025,-32) [-32|31] "m"  External
 SG_ VIS_TSR_roadMarking_3_Speed_0003 : 187|13@1+ (0.05,-5) [-5|200] "m"  External
 SG_ VIS_TSR_roadMarking_4_SpeedLimit : 200|8@1+ (1,0) [0|255] "N/A"  External
 SG_ VIS_TSR_roadMarking_4_Speed_0000 : 208|9@1+ (1,0) [0|414] "N/A"  External
 SG_ VIS_TSR_roadMarking_4_Speed_0001 : 217|8@1+ (0.005,0) [0|1] "N/A"  External
 SG_ VIS_TSR_roadMarking_4_Speed_0002 : 225|12@1+ (0.025,-32) [-32|31] "m"  External
 SG_ VIS_TSR_roadMarking_4_Speed_0003 : 237|13@1+ (0.05,-5) [-5|200] "m"  External
 SG_ VIS_TSR_roadMarking_5_SpeedLimit : 250|8@1+ (1,0) [0|255] "N/A"  External
 SG_ VIS_TSR_roadMarking_5_Speed_0000 : 258|9@1+ (1,0) [0|414] "N/A"  External
 SG_ VIS_TSR_roadMarking_5_Speed_0001 : 267|8@1+ (0.005,0) [0|1] "N/A"  External
 SG_ VIS_TSR_roadMarking_5_Speed_0002 : 275|12@1+ (0.025,-32) [-32|31] "m"  External
 SG_ VIS_TSR_roadMarking_5_Speed_0003 : 287|13@1+ (0.05,-5) [-5|200] "m"  External
 SG_ VIS_TSR_roadMarking_6_SpeedLimit : 300|8@1+ (1,0) [0|255] "N/A"  External
 SG_ VIS_TSR_roadMarking_6_Speed_0000 : 308|9@1+ (1,0) [0|414] "N/A"  External
 SG_ VIS_TSR_roadMarking_6_Speed_0001 : 317|8@1+ (0.005,0) [0|1] "N/A"  External
 SG_ VIS_TSR_roadMarking_6_Speed_0002 : 325|12@1+ (0.025,-32) [-32|31] "m"  External
 SG_ VIS_TSR_roadMarking_6_Speed_0003 : 337|13@1+ (0.05,-5) [-5|200] "m"  External
 SG_ VIS_TSR_roadMarking_7_SpeedLimit : 350|8@1+ (1,0) [0|255] "N/A"  External
 SG_ VIS_TSR_roadMarking_7_Speed_0000 : 358|9@1+ (1,0) [0|414] "N/A"  External
 SG_ VIS_TSR_roadMarking_7_Speed_0001 : 367|8@1+ (0.005,0) [0|1] "N/A"  External
 SG_ VIS_TSR_roadMarking_7_Speed_0002 : 375|12@1+ (0.025,-32) [-32|31] "m"  External
 SG_ VIS_TSR_roadMarking_7_Speed_0003 : 387|13@1+ (0.05,-5) [-5|200] "m"  External
 SG_ VIS_TSR_roadMarking_8_SpeedLimit : 400|8@1+ (1,0) [0|255] "N/A"  External
 SG_ VIS_TSR_roadMarking_8_Speed_0000 : 408|9@1+ (1,0) [0|414] "N/A"  External
 SG_ VIS_TSR_roadMarking_8_Speed_0001 : 417|8@1+ (0.005,0) [0|1] "N/A"  External
 SG_ VIS_TSR_roadMarking_8_Speed_0002 : 425|12@1+ (0.025,-32) [-32|31] "m"  External
 SG_ VIS_TSR_roadMarking_8_Speed_0003 : 437|13@1+ (0.05,-5) [-5|200] "m"  External
 SG_ VIS_TSR_roadMarking_9_SpeedLimit : 450|8@1+ (1,0) [0|255] "N/A"  External
 SG_ VIS_TSR_roadMarking_9_Speed_0000 : 458|9@1+ (1,0) [0|414] "N/A"  External
 SG_ VIS_TSR_roadMarking_9_Speed_0001 : 467|8@1+ (0.005,0) [0|1] "N/A"  External
 SG_ VIS_TSR_roadMarking_9_Speed_0002 : 475|12@1+ (0.025,-32) [-32|31] "m"  External
 SG_ VIS_TSR_roadMarking_9_Speed_0003 : 487|13@1+ (0.05,-5) [-5|200] "m"  External

BO_ 1847 VIS_TSR_CROSSINGS_MSG: 64 IFV410
 SG_ VIS_TSR_roadMarking_0_Crossings_ : 0|8@1+ (1,0) [0|255] "N/A"  External
 SG_ VIS_TSR_roadMarking_0_Cross_0000 : 8|9@1+ (1,0) [0|414] "N/A"  External
 SG_ VIS_TSR_roadMarking_0_Cross_0001 : 17|8@1+ (0.005,0) [0|1] "N/A"  External
 SG_ VIS_TSR_roadMarking_0_Cross_0002 : 25|12@1+ (0.025,-32) [-32|31] "m"  External
 SG_ VIS_TSR_roadMarking_0_Cross_0003 : 37|13@1+ (0.05,-5) [-5|200] "m"  External
 SG_ VIS_TSR_roadMarking_1_Crossings_ : 50|8@1+ (1,0) [0|255] "N/A"  External
 SG_ VIS_TSR_roadMarking_1_Cross_0000 : 58|9@1+ (1,0) [0|414] "N/A"  External
 SG_ VIS_TSR_roadMarking_1_Cross_0001 : 67|8@1+ (0.005,0) [0|1] "N/A"  External
 SG_ VIS_TSR_roadMarking_1_Cross_0002 : 75|12@1+ (0.025,-32) [-32|31] "m"  External
 SG_ VIS_TSR_roadMarking_1_Cross_0003 : 87|13@1+ (0.05,-5) [-5|200] "m"  External
 SG_ VIS_TSR_roadMarking_2_Crossings_ : 100|8@1+ (1,0) [0|255] "N/A"  External
 SG_ VIS_TSR_roadMarking_2_Cross_0000 : 108|9@1+ (1,0) [0|414] "N/A"  External
 SG_ VIS_TSR_roadMarking_2_Cross_0001 : 117|8@1+ (0.005,0) [0|1] "N/A"  External
 SG_ VIS_TSR_roadMarking_2_Cross_0002 : 125|12@1+ (0.025,-32) [-32|31] "m"  External
 SG_ VIS_TSR_roadMarking_2_Cross_0003 : 137|13@1+ (0.05,-5) [-5|200] "m"  External
 SG_ VIS_TSR_roadMarking_3_Crossings_ : 150|8@1+ (1,0) [0|255] "N/A"  External
 SG_ VIS_TSR_roadMarking_3_Cross_0000 : 158|9@1+ (1,0) [0|414] "N/A"  External
 SG_ VIS_TSR_roadMarking_3_Cross_0001 : 167|8@1+ (0.005,0) [0|1] "N/A"  External
 SG_ VIS_TSR_roadMarking_3_Cross_0002 : 175|12@1+ (0.025,-32) [-32|31] "m"  External
 SG_ VIS_TSR_roadMarking_3_Cross_0003 : 187|13@1+ (0.05,-5) [-5|200] "m"  External
 SG_ VIS_TSR_roadMarking_4_Crossings_ : 200|8@1+ (1,0) [0|255] "N/A"  External
 SG_ VIS_TSR_roadMarking_4_Cross_0000 : 208|9@1+ (1,0) [0|414] "N/A"  External
 SG_ VIS_TSR_roadMarking_4_Cross_0001 : 217|8@1+ (0.005,0) [0|1] "N/A"  External
 SG_ VIS_TSR_roadMarking_4_Cross_0002 : 225|12@1+ (0.025,-32) [-32|31] "m"  External
 SG_ VIS_TSR_roadMarking_4_Cross_0003 : 237|13@1+ (0.05,-5) [-5|200] "m"  External
 SG_ VIS_TSR_roadMarking_5_Crossings_ : 250|8@1+ (1,0) [0|255] "N/A"  External
 SG_ VIS_TSR_roadMarking_5_Cross_0000 : 258|9@1+ (1,0) [0|414] "N/A"  External
 SG_ VIS_TSR_roadMarking_5_Cross_0001 : 267|8@1+ (0.005,0) [0|1] "N/A"  External
 SG_ VIS_TSR_roadMarking_5_Cross_0002 : 275|12@1+ (0.025,-32) [-32|31] "m"  External
 SG_ VIS_TSR_roadMarking_5_Cross_0003 : 287|13@1+ (0.05,-5) [-5|200] "m"  External
 SG_ VIS_TSR_roadMarking_6_Crossings_ : 300|8@1+ (1,0) [0|255] "N/A"  External
 SG_ VIS_TSR_roadMarking_6_Cross_0000 : 308|9@1+ (1,0) [0|414] "N/A"  External
 SG_ VIS_TSR_roadMarking_6_Cross_0001 : 317|8@1+ (0.005,0) [0|1] "N/A"  External
 SG_ VIS_TSR_roadMarking_6_Cross_0002 : 325|12@1+ (0.025,-32) [-32|31] "m"  External
 SG_ VIS_TSR_roadMarking_6_Cross_0003 : 337|13@1+ (0.05,-5) [-5|200] "m"  External
 SG_ VIS_TSR_roadMarking_7_Crossings_ : 350|8@1+ (1,0) [0|255] "N/A"  External
 SG_ VIS_TSR_roadMarking_7_Cross_0000 : 358|9@1+ (1,0) [0|414] "N/A"  External
 SG_ VIS_TSR_roadMarking_7_Cross_0001 : 367|8@1+ (0.005,0) [0|1] "N/A"  External
 SG_ VIS_TSR_roadMarking_7_Cross_0002 : 375|12@1+ (0.025,-32) [-32|31] "m"  External
 SG_ VIS_TSR_roadMarking_7_Cross_0003 : 387|13@1+ (0.05,-5) [-5|200] "m"  External
 SG_ VIS_TSR_roadMarking_8_Crossings_ : 400|8@1+ (1,0) [0|255] "N/A"  External
 SG_ VIS_TSR_roadMarking_8_Cross_0000 : 408|9@1+ (1,0) [0|414] "N/A"  External
 SG_ VIS_TSR_roadMarking_8_Cross_0001 : 417|8@1+ (0.005,0) [0|1] "N/A"  External
 SG_ VIS_TSR_roadMarking_8_Cross_0002 : 425|12@1+ (0.025,-32) [-32|31] "m"  External
 SG_ VIS_TSR_roadMarking_8_Cross_0003 : 437|13@1+ (0.05,-5) [-5|200] "m"  External
 SG_ VIS_TSR_roadMarking_9_Crossings_ : 450|8@1+ (1,0) [0|255] "N/A"  External
 SG_ VIS_TSR_roadMarking_9_Cross_0000 : 458|9@1+ (1,0) [0|414] "N/A"  External
 SG_ VIS_TSR_roadMarking_9_Cross_0001 : 467|8@1+ (0.005,0) [0|1] "N/A"  External
 SG_ VIS_TSR_roadMarking_9_Cross_0002 : 475|12@1+ (0.025,-32) [-32|31] "m"  External
 SG_ VIS_TSR_roadMarking_9_Cross_0003 : 487|13@1+ (0.05,-5) [-5|200] "m"  External

BO_ 1848 VIS_TSR_Env_Detection: 64 IFV410
 SG_ VIS_TSR_Env_currentMarket : 0|4@1+ (1,0) [0|10] "N/A"  External
 SG_ VIS_TSR_Env_numberTrafficSigns : 4|5@1+ (1,0) [0|20] "N/A"  External

BO_ 1856 VIS_AHBC_OBJ_01: 64 IFV410
 SG_ VIS_AHBC_OBJ_0_ID : 0|8@1+ (1,0) [0|127] "N/A"  External
 SG_ VIS_AHBC_OBJ_0_classification : 8|4@1+ (1,0) [0|8] "N/A"  External
 SG_ VIS_AHBC_OBJ_0_longpos : 12|11@1+ (1,0) [0|1200] "N/A"  External
 SG_ VIS_AHBC_OBJ_0_leftAngle : 23|11@1+ (0.05,-50) [-50|50] "deg"  External
 SG_ VIS_AHBC_OBJ_0_rightAngle : 34|11@1+ (0.05,-50) [-50|50] "deg"  External
 SG_ VIS_AHBC_OBJ_0_topAngle : 45|11@1+ (0.05,-50) [-50|50] "deg"  External
 SG_ VIS_AHBC_OBJ_0_bottomAngle : 56|11@1+ (0.05,-50) [-50|50] "deg"  External
 SG_ VIS_AHBC_OBJ_0_pixelTop : 67|12@1+ (1,0) [0|960] "N/A"  External
 SG_ VIS_AHBC_OBJ_0_pixelBottom : 79|12@1+ (1,0) [0|960] "N/A"  External
 SG_ VIS_AHBC_OBJ_0_pixelLeft : 91|12@1+ (1,0) [0|1824] "N/A"  External
 SG_ VIS_AHBC_OBJ_0_pixelRight : 103|12@1+ (1,0) [0|1824] "N/A"  External
 SG_ VIS_AHBC_OBJ_1_ID : 115|8@1+ (1,0) [0|127] "N/A"  External
 SG_ VIS_AHBC_OBJ_1_classification : 123|4@1+ (1,0) [0|8] "N/A"  External
 SG_ VIS_AHBC_OBJ_1_longpos : 127|11@1+ (1,0) [0|1200] "N/A"  External
 SG_ VIS_AHBC_OBJ_1_leftAngle : 138|11@1+ (0.05,-50) [-50|50] "deg"  External
 SG_ VIS_AHBC_OBJ_1_rightAngle : 149|11@1+ (0.05,-50) [-50|50] "deg"  External
 SG_ VIS_AHBC_OBJ_1_topAngle : 160|11@1+ (0.05,-50) [-50|50] "deg"  External
 SG_ VIS_AHBC_OBJ_1_bottomAngle : 171|11@1+ (0.05,-50) [-50|50] "deg"  External
 SG_ VIS_AHBC_OBJ_1_pixelTop : 182|12@1+ (1,0) [0|960] "N/A"  External
 SG_ VIS_AHBC_OBJ_1_pixelBottom : 194|12@1+ (1,0) [0|960] "N/A"  External
 SG_ VIS_AHBC_OBJ_1_pixelLeft : 206|12@1+ (1,0) [0|1824] "N/A"  External
 SG_ VIS_AHBC_OBJ_1_pixelRight : 218|12@1+ (1,0) [0|1824] "N/A"  External
 SG_ VIS_AHBC_OBJ_2_ID : 230|8@1+ (1,0) [0|127] "N/A"  External
 SG_ VIS_AHBC_OBJ_2_classification : 238|4@1+ (1,0) [0|8] "N/A"  External
 SG_ VIS_AHBC_OBJ_2_longpos : 242|11@1+ (1,0) [0|1200] "N/A"  External
 SG_ VIS_AHBC_OBJ_2_leftAngle : 253|11@1+ (0.05,-50) [-50|50] "deg"  External
 SG_ VIS_AHBC_OBJ_2_rightAngle : 264|11@1+ (0.05,-50) [-50|50] "deg"  External
 SG_ VIS_AHBC_OBJ_2_topAngle : 275|11@1+ (0.05,-50) [-50|50] "deg"  External
 SG_ VIS_AHBC_OBJ_2_bottomAngle : 286|11@1+ (0.05,-50) [-50|50] "deg"  External
 SG_ VIS_AHBC_OBJ_2_pixelTop : 297|12@1+ (1,0) [0|960] "N/A"  External
 SG_ VIS_AHBC_OBJ_2_pixelBottom : 309|12@1+ (1,0) [0|960] "N/A"  External
 SG_ VIS_AHBC_OBJ_2_pixelLeft : 321|12@1+ (1,0) [0|1824] "N/A"  External
 SG_ VIS_AHBC_OBJ_2_pixelRight : 333|12@1+ (1,0) [0|1824] "N/A"  External
 SG_ VIS_AHBC_OBJ_3_ID : 345|8@1+ (1,0) [0|127] "N/A"  External
 SG_ VIS_AHBC_OBJ_3_classification : 353|4@1+ (1,0) [0|8] "N/A"  External
 SG_ VIS_AHBC_OBJ_3_longpos : 357|11@1+ (1,0) [0|1200] "N/A"  External
 SG_ VIS_AHBC_OBJ_3_leftAngle : 368|11@1+ (0.05,-50) [-50|50] "deg"  External
 SG_ VIS_AHBC_OBJ_3_rightAngle : 379|11@1+ (0.05,-50) [-50|50] "deg"  External
 SG_ VIS_AHBC_OBJ_3_topAngle : 390|11@1+ (0.05,-50) [-50|50] "deg"  External
 SG_ VIS_AHBC_OBJ_3_bottomAngle : 401|11@1+ (0.05,-50) [-50|50] "deg"  External
 SG_ VIS_AHBC_OBJ_3_pixelTop : 412|12@1+ (1,0) [0|960] "N/A"  External
 SG_ VIS_AHBC_OBJ_3_pixelBottom : 424|12@1+ (1,0) [0|960] "N/A"  External
 SG_ VIS_AHBC_OBJ_3_pixelLeft : 436|12@1+ (1,0) [0|1824] "N/A"  External
 SG_ VIS_AHBC_OBJ_3_pixelRight : 448|12@1+ (1,0) [0|1824] "N/A"  External

BO_ 1857 VIS_AHBC_OBJ_02: 64 IFV410
 SG_ VIS_AHBC_OBJ_4_ID : 0|8@1+ (1,0) [0|127] "N/A"  External
 SG_ VIS_AHBC_OBJ_4_classification : 8|4@1+ (1,0) [0|8] "N/A"  External
 SG_ VIS_AHBC_OBJ_4_longpos : 12|11@1+ (1,0) [0|1200] "N/A"  External
 SG_ VIS_AHBC_OBJ_4_leftAngle : 23|11@1+ (0.05,-50) [-50|50] "deg"  External
 SG_ VIS_AHBC_OBJ_4_rightAngle : 34|11@1+ (0.05,-50) [-50|50] "deg"  External
 SG_ VIS_AHBC_OBJ_4_topAngle : 45|11@1+ (0.05,-50) [-50|50] "deg"  External
 SG_ VIS_AHBC_OBJ_4_bottomAngle : 56|11@1+ (0.05,-50) [-50|50] "deg"  External
 SG_ VIS_AHBC_OBJ_4_pixelTop : 67|12@1+ (1,0) [0|960] "N/A"  External
 SG_ VIS_AHBC_OBJ_4_pixelBottom : 79|12@1+ (1,0) [0|960] "N/A"  External
 SG_ VIS_AHBC_OBJ_4_pixelLeft : 91|12@1+ (1,0) [0|1824] "N/A"  External
 SG_ VIS_AHBC_OBJ_4_pixelRight : 103|12@1+ (1,0) [0|1824] "N/A"  External
 SG_ VIS_AHBC_OBJ_5_ID : 115|8@1+ (1,0) [0|127] "N/A"  External
 SG_ VIS_AHBC_OBJ_5_classification : 123|4@1+ (1,0) [0|8] "N/A"  External
 SG_ VIS_AHBC_OBJ_5_longpos : 127|11@1+ (1,0) [0|1200] "N/A"  External
 SG_ VIS_AHBC_OBJ_5_leftAngle : 138|11@1+ (0.05,-50) [-50|50] "deg"  External
 SG_ VIS_AHBC_OBJ_5_rightAngle : 149|11@1+ (0.05,-50) [-50|50] "deg"  External
 SG_ VIS_AHBC_OBJ_5_topAngle : 160|11@1+ (0.05,-50) [-50|50] "deg"  External
 SG_ VIS_AHBC_OBJ_5_bottomAngle : 171|11@1+ (0.05,-50) [-50|50] "deg"  External
 SG_ VIS_AHBC_OBJ_5_pixelTop : 182|12@1+ (1,0) [0|960] "N/A"  External
 SG_ VIS_AHBC_OBJ_5_pixelBottom : 194|12@1+ (1,0) [0|960] "N/A"  External
 SG_ VIS_AHBC_OBJ_5_pixelLeft : 206|12@1+ (1,0) [0|1824] "N/A"  External
 SG_ VIS_AHBC_OBJ_5_pixelRight : 218|12@1+ (1,0) [0|1824] "N/A"  External
 SG_ VIS_AHBC_OBJ_6_ID : 230|8@1+ (1,0) [0|127] "N/A"  External
 SG_ VIS_AHBC_OBJ_6_classification : 238|4@1+ (1,0) [0|8] "N/A"  External
 SG_ VIS_AHBC_OBJ_6_longpos : 242|11@1+ (1,0) [0|1200] "N/A"  External
 SG_ VIS_AHBC_OBJ_6_leftAngle : 253|11@1+ (0.05,-50) [-50|50] "deg"  External
 SG_ VIS_AHBC_OBJ_6_rightAngle : 264|11@1+ (0.05,-50) [-50|50] "deg"  External
 SG_ VIS_AHBC_OBJ_6_topAngle : 275|11@1+ (0.05,-50) [-50|50] "deg"  External
 SG_ VIS_AHBC_OBJ_6_bottomAngle : 286|11@1+ (0.05,-50) [-50|50] "deg"  External
 SG_ VIS_AHBC_OBJ_6_pixelTop : 297|12@1+ (1,0) [0|960] "N/A"  External
 SG_ VIS_AHBC_OBJ_6_pixelBottom : 309|12@1+ (1,0) [0|960] "N/A"  External
 SG_ VIS_AHBC_OBJ_6_pixelLeft : 321|12@1+ (1,0) [0|1824] "N/A"  External
 SG_ VIS_AHBC_OBJ_6_pixelRight : 333|12@1+ (1,0) [0|1824] "N/A"  External
 SG_ VIS_AHBC_OBJ_7_ID : 345|8@1+ (1,0) [0|127] "N/A"  External
 SG_ VIS_AHBC_OBJ_7_classification : 353|4@1+ (1,0) [0|8] "N/A"  External
 SG_ VIS_AHBC_OBJ_7_longpos : 357|11@1+ (1,0) [0|1200] "N/A"  External
 SG_ VIS_AHBC_OBJ_7_leftAngle : 368|11@1+ (0.05,-50) [-50|50] "deg"  External
 SG_ VIS_AHBC_OBJ_7_rightAngle : 379|11@1+ (0.05,-50) [-50|50] "deg"  External
 SG_ VIS_AHBC_OBJ_7_topAngle : 390|11@1+ (0.05,-50) [-50|50] "deg"  External
 SG_ VIS_AHBC_OBJ_7_bottomAngle : 401|11@1+ (0.05,-50) [-50|50] "deg"  External
 SG_ VIS_AHBC_OBJ_7_pixelTop : 412|12@1+ (1,0) [0|960] "N/A"  External
 SG_ VIS_AHBC_OBJ_7_pixelBottom : 424|12@1+ (1,0) [0|960] "N/A"  External
 SG_ VIS_AHBC_OBJ_7_pixelLeft : 436|12@1+ (1,0) [0|1824] "N/A"  External
 SG_ VIS_AHBC_OBJ_7_pixelRight : 448|12@1+ (1,0) [0|1824] "N/A"  External

BO_ 1858 VIS_AHBC_OBJ_03: 64 IFV410
 SG_ VIS_AHBC_OBJ_8_ID : 0|8@1+ (1,0) [0|127] "N/A"  External
 SG_ VIS_AHBC_OBJ_8_classification : 8|4@1+ (1,0) [0|8] "N/A"  External
 SG_ VIS_AHBC_OBJ_8_longpos : 12|11@1+ (1,0) [0|1200] "N/A"  External
 SG_ VIS_AHBC_OBJ_8_leftAngle : 23|11@1+ (0.05,-50) [-50|50] "deg"  External
 SG_ VIS_AHBC_OBJ_8_rightAngle : 34|11@1+ (0.05,-50) [-50|50] "deg"  External
 SG_ VIS_AHBC_OBJ_8_topAngle : 45|11@1+ (0.05,-50) [-50|50] "deg"  External
 SG_ VIS_AHBC_OBJ_8_bottomAngle : 56|11@1+ (0.05,-50) [-50|50] "deg"  External
 SG_ VIS_AHBC_OBJ_8_pixelTop : 67|12@1+ (1,0) [0|960] "N/A"  External
 SG_ VIS_AHBC_OBJ_8_pixelBottom : 79|12@1+ (1,0) [0|960] "N/A"  External
 SG_ VIS_AHBC_OBJ_8_pixelLeft : 91|12@1+ (1,0) [0|1824] "N/A"  External
 SG_ VIS_AHBC_OBJ_8_pixelRight : 103|12@1+ (1,0) [0|1824] "N/A"  External
 SG_ VIS_AHBC_OBJ_9_ID : 115|8@1+ (1,0) [0|127] "N/A"  External
 SG_ VIS_AHBC_OBJ_9_classification : 123|4@1+ (1,0) [0|8] "N/A"  External
 SG_ VIS_AHBC_OBJ_9_longpos : 127|11@1+ (1,0) [0|1200] "N/A"  External
 SG_ VIS_AHBC_OBJ_9_leftAngle : 138|11@1+ (0.05,-50) [-50|50] "deg"  External
 SG_ VIS_AHBC_OBJ_9_rightAngle : 149|11@1+ (0.05,-50) [-50|50] "deg"  External
 SG_ VIS_AHBC_OBJ_9_topAngle : 160|11@1+ (0.05,-50) [-50|50] "deg"  External
 SG_ VIS_AHBC_OBJ_9_bottomAngle : 171|11@1+ (0.05,-50) [-50|50] "deg"  External
 SG_ VIS_AHBC_OBJ_9_pixelTop : 182|12@1+ (1,0) [0|960] "N/A"  External
 SG_ VIS_AHBC_OBJ_9_pixelBottom : 194|12@1+ (1,0) [0|960] "N/A"  External
 SG_ VIS_AHBC_OBJ_9_pixelLeft : 206|12@1+ (1,0) [0|1824] "N/A"  External
 SG_ VIS_AHBC_OBJ_9_pixelRight : 218|12@1+ (1,0) [0|1824] "N/A"  External
 SG_ VIS_AHBC_OBJ_10_ID : 230|8@1+ (1,0) [0|127] "N/A"  External
 SG_ VIS_AHBC_OBJ_10_classification : 238|4@1+ (1,0) [0|8] "N/A"  External
 SG_ VIS_AHBC_OBJ_10_longpos : 242|11@1+ (1,0) [0|1200] "N/A"  External
 SG_ VIS_AHBC_OBJ_10_leftAngle : 253|11@1+ (0.05,-50) [-50|50] "deg"  External
 SG_ VIS_AHBC_OBJ_10_rightAngle : 264|11@1+ (0.05,-50) [-50|50] "deg"  External
 SG_ VIS_AHBC_OBJ_10_topAngle : 275|11@1+ (0.05,-50) [-50|50] "deg"  External
 SG_ VIS_AHBC_OBJ_10_bottomAngle : 286|11@1+ (0.05,-50) [-50|50] "deg"  External
 SG_ VIS_AHBC_OBJ_10_pixelTop : 297|12@1+ (1,0) [0|960] "N/A"  External
 SG_ VIS_AHBC_OBJ_10_pixelBottom : 309|12@1+ (1,0) [0|960] "N/A"  External
 SG_ VIS_AHBC_OBJ_10_pixelLeft : 321|12@1+ (1,0) [0|1824] "N/A"  External
 SG_ VIS_AHBC_OBJ_10_pixelRight : 333|12@1+ (1,0) [0|1824] "N/A"  External
 SG_ VIS_AHBC_OBJ_11_ID : 345|8@1+ (1,0) [0|127] "N/A"  External
 SG_ VIS_AHBC_OBJ_11_classification : 353|4@1+ (1,0) [0|8] "N/A"  External
 SG_ VIS_AHBC_OBJ_11_longpos : 357|11@1+ (1,0) [0|1200] "N/A"  External
 SG_ VIS_AHBC_OBJ_11_leftAngle : 368|11@1+ (0.05,-50) [-50|50] "deg"  External
 SG_ VIS_AHBC_OBJ_11_rightAngle : 379|11@1+ (0.05,-50) [-50|50] "deg"  External
 SG_ VIS_AHBC_OBJ_11_topAngle : 390|11@1+ (0.05,-50) [-50|50] "deg"  External
 SG_ VIS_AHBC_OBJ_11_bottomAngle : 401|11@1+ (0.05,-50) [-50|50] "deg"  External
 SG_ VIS_AHBC_OBJ_11_pixelTop : 412|12@1+ (1,0) [0|960] "N/A"  External
 SG_ VIS_AHBC_OBJ_11_pixelBottom : 424|12@1+ (1,0) [0|960] "N/A"  External
 SG_ VIS_AHBC_OBJ_11_pixelLeft : 436|12@1+ (1,0) [0|1824] "N/A"  External
 SG_ VIS_AHBC_OBJ_11_pixelRight : 448|12@1+ (1,0) [0|1824] "N/A"  External

BO_ 1859 VIS_AHBC_OBJ_04: 64 IFV410
 SG_ VIS_AHBC_OBJ_12_ID : 0|8@1+ (1,0) [0|127] "N/A"  External
 SG_ VIS_AHBC_OBJ_12_classification : 8|4@1+ (1,0) [0|8] "N/A"  External
 SG_ VIS_AHBC_OBJ_12_longpos : 12|11@1+ (1,0) [0|1200] "N/A"  External
 SG_ VIS_AHBC_OBJ_12_leftAngle : 23|11@1+ (0.05,-50) [-50|50] "deg"  External
 SG_ VIS_AHBC_OBJ_12_rightAngle : 34|11@1+ (0.05,-50) [-50|50] "deg"  External
 SG_ VIS_AHBC_OBJ_12_topAngle : 45|11@1+ (0.05,-50) [-50|50] "deg"  External
 SG_ VIS_AHBC_OBJ_12_bottomAngle : 56|11@1+ (0.05,-50) [-50|50] "deg"  External
 SG_ VIS_AHBC_OBJ_12_pixelTop : 67|12@1+ (1,0) [0|960] "N/A"  External
 SG_ VIS_AHBC_OBJ_12_pixelBottom : 79|12@1+ (1,0) [0|960] "N/A"  External
 SG_ VIS_AHBC_OBJ_12_pixelLeft : 91|12@1+ (1,0) [0|1824] "N/A"  External
 SG_ VIS_AHBC_OBJ_12_pixelRight : 103|12@1+ (1,0) [0|1824] "N/A"  External
 SG_ VIS_AHBC_OBJ_13_ID : 115|8@1+ (1,0) [0|127] "N/A"  External
 SG_ VIS_AHBC_OBJ_13_classification : 123|4@1+ (1,0) [0|8] "N/A"  External
 SG_ VIS_AHBC_OBJ_13_longpos : 127|11@1+ (1,0) [0|1200] "N/A"  External
 SG_ VIS_AHBC_OBJ_13_leftAngle : 138|11@1+ (0.05,-50) [-50|50] "deg"  External
 SG_ VIS_AHBC_OBJ_13_rightAngle : 149|11@1+ (0.05,-50) [-50|50] "deg"  External
 SG_ VIS_AHBC_OBJ_13_topAngle : 160|11@1+ (0.05,-50) [-50|50] "deg"  External
 SG_ VIS_AHBC_OBJ_13_bottomAngle : 171|11@1+ (0.05,-50) [-50|50] "deg"  External
 SG_ VIS_AHBC_OBJ_13_pixelTop : 182|12@1+ (1,0) [0|960] "N/A"  External
 SG_ VIS_AHBC_OBJ_13_pixelBottom : 194|12@1+ (1,0) [0|960] "N/A"  External
 SG_ VIS_AHBC_OBJ_13_pixelLeft : 206|12@1+ (1,0) [0|1824] "N/A"  External
 SG_ VIS_AHBC_OBJ_13_pixelRight : 218|12@1+ (1,0) [0|1824] "N/A"  External
 SG_ VIS_AHBC_OBJ_14_ID : 230|8@1+ (1,0) [0|127] "N/A"  External
 SG_ VIS_AHBC_OBJ_14_classification : 238|4@1+ (1,0) [0|8] "N/A"  External
 SG_ VIS_AHBC_OBJ_14_longpos : 242|11@1+ (1,0) [0|1200] "N/A"  External
 SG_ VIS_AHBC_OBJ_14_leftAngle : 253|11@1+ (0.05,-50) [-50|50] "deg"  External
 SG_ VIS_AHBC_OBJ_14_rightAngle : 264|11@1+ (0.05,-50) [-50|50] "deg"  External
 SG_ VIS_AHBC_OBJ_14_topAngle : 275|11@1+ (0.05,-50) [-50|50] "deg"  External
 SG_ VIS_AHBC_OBJ_14_bottomAngle : 286|11@1+ (0.05,-50) [-50|50] "deg"  External
 SG_ VIS_AHBC_OBJ_14_pixelTop : 297|12@1+ (1,0) [0|960] "N/A"  External
 SG_ VIS_AHBC_OBJ_14_pixelBottom : 309|12@1+ (1,0) [0|960] "N/A"  External
 SG_ VIS_AHBC_OBJ_14_pixelLeft : 321|12@1+ (1,0) [0|1824] "N/A"  External
 SG_ VIS_AHBC_OBJ_14_pixelRight : 333|12@1+ (1,0) [0|1824] "N/A"  External

BO_ 1860 VIS_AHBC_REF_SGN_01: 64 IFV410
 SG_ VIS_AHBC_REF_SGN_0_ID : 0|8@1+ (1,0) [0|255] ""  External
 SG_ VIS_AHBC_REF_SGN_0_Distance : 8|10@1+ (1,0) [0|1000] "m"  External
 SG_ VIS_AHBC_REF_SGN_0_TopAngle : 18|6@1+ (1,-30) [-30|30] "deg"  External
 SG_ VIS_AHBC_REF_SGN_0_BottomAngle : 24|6@1+ (1,-30) [-30|30] "deg"  External
 SG_ VIS_AHBC_REF_SGN_0_LeftAngle : 30|6@1+ (1,-30) [-30|30] "deg"  External
 SG_ VIS_AHBC_REF_SGN_0_RightAngle : 36|6@1+ (1,-30) [-30|30] "deg"  External
 SG_ VIS_AHBC_REF_SGN_0_GlareLevelMax : 42|7@1+ (1,0) [0|100] "SED"  External
 SG_ VIS_AHBC_REF_SGN_0_GlareLevelCur : 49|7@1+ (1,0) [0|100] "SED"  External
 SG_ VIS_AHBC_REF_SGN_1_ID : 56|8@1+ (1,0) [0|255] ""  External
 SG_ VIS_AHBC_REF_SGN_1_Distance : 64|10@1+ (1,0) [0|1000] "m"  External
 SG_ VIS_AHBC_REF_SGN_1_TopAngle : 74|6@1+ (1,-30) [-30|30] "deg"  External
 SG_ VIS_AHBC_REF_SGN_1_BottomAngle : 80|6@1+ (1,-30) [-30|30] "deg"  External
 SG_ VIS_AHBC_REF_SGN_1_LeftAngle : 86|6@1+ (1,-30) [-30|30] "deg"  External
 SG_ VIS_AHBC_REF_SGN_1_RightAngle : 92|6@1+ (1,-30) [-30|30] "deg"  External
 SG_ VIS_AHBC_REF_SGN_1_GlareLevelMax : 98|7@1+ (1,0) [0|100] "SED"  External
 SG_ VIS_AHBC_REF_SGN_1_GlareLevelCur : 105|7@1+ (1,0) [0|100] "SED"  External
 SG_ VIS_AHBC_REF_SGN_2_ID : 112|8@1+ (1,0) [0|255] ""  External
 SG_ VIS_AHBC_REF_SGN_2_Distance : 120|10@1+ (1,0) [0|1000] "m"  External
 SG_ VIS_AHBC_REF_SGN_2_TopAngle : 130|6@1+ (1,-30) [-30|30] "deg"  External
 SG_ VIS_AHBC_REF_SGN_2_BottomAngle : 136|6@1+ (1,-30) [-30|30] "deg"  External
 SG_ VIS_AHBC_REF_SGN_2_LeftAngle : 142|6@1+ (1,-30) [-30|30] "deg"  External
 SG_ VIS_AHBC_REF_SGN_2_RightAngle : 148|6@1+ (1,-30) [-30|30] "deg"  External
 SG_ VIS_AHBC_REF_SGN_2_GlareLevelMax : 154|7@1+ (1,0) [0|100] "SED"  External
 SG_ VIS_AHBC_REF_SGN_2_GlareLevelCur : 161|7@1+ (1,0) [0|100] "SED"  External
 SG_ VIS_AHBC_REF_SGN_3_ID : 168|8@1+ (1,0) [0|255] ""  External
 SG_ VIS_AHBC_REF_SGN_3_Distance : 176|10@1+ (1,0) [0|1000] "m"  External
 SG_ VIS_AHBC_REF_SGN_3_TopAngle : 186|6@1+ (1,-30) [-30|30] "deg"  External
 SG_ VIS_AHBC_REF_SGN_3_BottomAngle : 192|6@1+ (1,-30) [-30|30] "deg"  External
 SG_ VIS_AHBC_REF_SGN_3_LeftAngle : 198|6@1+ (1,-30) [-30|30] "deg"  External
 SG_ VIS_AHBC_REF_SGN_3_RightAngle : 204|6@1+ (1,-30) [-30|30] "deg"  External
 SG_ VIS_AHBC_REF_SGN_3_GlareLevelMax : 210|7@1+ (1,0) [0|100] "SED"  External
 SG_ VIS_AHBC_REF_SGN_3_GlareLevelCur : 217|7@1+ (1,0) [0|100] "SED"  External
 SG_ VIS_AHBC_REF_SGN_4_ID : 224|8@1+ (1,0) [0|255] ""  External
 SG_ VIS_AHBC_REF_SGN_4_Distance : 232|10@1+ (1,0) [0|1000] "m"  External
 SG_ VIS_AHBC_REF_SGN_4_TopAngle : 242|6@1+ (1,-30) [-30|30] "deg"  External
 SG_ VIS_AHBC_REF_SGN_4_BottomAngle : 248|6@1+ (1,-30) [-30|30] "deg"  External
 SG_ VIS_AHBC_REF_SGN_4_LeftAngle : 254|6@1+ (1,-30) [-30|30] "deg"  External
 SG_ VIS_AHBC_REF_SGN_4_RightAngle : 260|6@1+ (1,-30) [-30|30] "deg"  External
 SG_ VIS_AHBC_REF_SGN_4_GlareLevelMax : 266|7@1+ (1,0) [0|100] "SED"  External
 SG_ VIS_AHBC_REF_SGN_4_GlareLevelCur : 273|7@1+ (1,0) [0|100] "SED"  External
 SG_ VIS_AHBC_REF_SGN_5_ID : 280|8@1+ (1,0) [0|255] ""  External
 SG_ VIS_AHBC_REF_SGN_5_Distance : 288|10@1+ (1,0) [0|1000] "m"  External
 SG_ VIS_AHBC_REF_SGN_5_TopAngle : 298|6@1+ (1,-30) [-30|30] "deg"  External
 SG_ VIS_AHBC_REF_SGN_5_BottomAngle : 304|6@1+ (1,-30) [-30|30] "deg"  External
 SG_ VIS_AHBC_REF_SGN_5_LeftAngle : 310|6@1+ (1,-30) [-30|30] "deg"  External
 SG_ VIS_AHBC_REF_SGN_5_RightAngle : 316|6@1+ (1,-30) [-30|30] "deg"  External
 SG_ VIS_AHBC_REF_SGN_5_GlareLevelMax : 322|7@1+ (1,0) [0|100] "SED"  External
 SG_ VIS_AHBC_REF_SGN_5_GlareLevelCur : 329|7@1+ (1,0) [0|100] "SED"  External

BO_ 1861 VIS_AHBC_REF_SGN_02: 64 IFV410
 SG_ VIS_AHBC_REF_SGN_6_ID : 0|8@1+ (1,0) [0|255] ""  External
 SG_ VIS_AHBC_REF_SGN_6_Distance : 8|10@1+ (1,0) [0|1000] "m"  External
 SG_ VIS_AHBC_REF_SGN_6_TopAngle : 18|6@1+ (1,-30) [-30|30] "deg"  External
 SG_ VIS_AHBC_REF_SGN_6_BottomAngle : 24|6@1+ (1,-30) [-30|30] "deg"  External
 SG_ VIS_AHBC_REF_SGN_6_LeftAngle : 30|6@1+ (1,-30) [-30|30] "deg"  External
 SG_ VIS_AHBC_REF_SGN_6_RightAngle : 36|6@1+ (1,-30) [-30|30] "deg"  External
 SG_ VIS_AHBC_REF_SGN_6_GlareLevelMax : 42|7@1+ (1,0) [0|100] "SED"  External
 SG_ VIS_AHBC_REF_SGN_6_GlareLevelCur : 49|7@1+ (1,0) [0|100] "SED"  External
 SG_ VIS_AHBC_REF_SGN_7_ID : 56|8@1+ (1,0) [0|255] ""  External
 SG_ VIS_AHBC_REF_SGN_7_Distance : 64|10@1+ (1,0) [0|1000] "m"  External
 SG_ VIS_AHBC_REF_SGN_7_TopAngle : 74|6@1+ (1,-30) [-30|30] "deg"  External
 SG_ VIS_AHBC_REF_SGN_7_BottomAngle : 80|6@1+ (1,-30) [-30|30] "deg"  External
 SG_ VIS_AHBC_REF_SGN_7_LeftAngle : 86|6@1+ (1,-30) [-30|30] "deg"  External
 SG_ VIS_AHBC_REF_SGN_7_RightAngle : 92|6@1+ (1,-30) [-30|30] "deg"  External
 SG_ VIS_AHBC_REF_SGN_7_GlareLevelMax : 98|7@1+ (1,0) [0|100] "SED"  External
 SG_ VIS_AHBC_REF_SGN_7_GlareLevelCur : 105|7@1+ (1,0) [0|100] "SED"  External
 SG_ VIS_AHBC_REF_SGN_8_ID : 112|8@1+ (1,0) [0|255] ""  External
 SG_ VIS_AHBC_REF_SGN_8_Distance : 120|10@1+ (1,0) [0|1000] "m"  External
 SG_ VIS_AHBC_REF_SGN_8_TopAngle : 130|6@1+ (1,-30) [-30|30] "deg"  External
 SG_ VIS_AHBC_REF_SGN_8_BottomAngle : 136|6@1+ (1,-30) [-30|30] "deg"  External
 SG_ VIS_AHBC_REF_SGN_8_LeftAngle : 142|6@1+ (1,-30) [-30|30] "deg"  External
 SG_ VIS_AHBC_REF_SGN_8_RightAngle : 148|6@1+ (1,-30) [-30|30] "deg"  External
 SG_ VIS_AHBC_REF_SGN_8_GlareLevelMax : 154|7@1+ (1,0) [0|100] "SED"  External
 SG_ VIS_AHBC_REF_SGN_8_GlareLevelCur : 161|7@1+ (1,0) [0|100] "SED"  External
 SG_ VIS_AHBC_REF_SGN_9_ID : 168|8@1+ (1,0) [0|255] ""  External
 SG_ VIS_AHBC_REF_SGN_9_Distance : 176|10@1+ (1,0) [0|1000] "m"  External
 SG_ VIS_AHBC_REF_SGN_9_TopAngle : 186|6@1+ (1,-30) [-30|30] "deg"  External
 SG_ VIS_AHBC_REF_SGN_9_BottomAngle : 192|6@1+ (1,-30) [-30|30] "deg"  External
 SG_ VIS_AHBC_REF_SGN_9_LeftAngle : 198|6@1+ (1,-30) [-30|30] "deg"  External
 SG_ VIS_AHBC_REF_SGN_9_RightAngle : 204|6@1+ (1,-30) [-30|30] "deg"  External
 SG_ VIS_AHBC_REF_SGN_9_GlareLevelMax : 210|7@1+ (1,0) [0|100] "SED"  External
 SG_ VIS_AHBC_REF_SGN_9_GlareLevelCur : 217|7@1+ (1,0) [0|100] "SED"  External
 SG_ VIS_AHBC_REF_SGN_10_ID : 224|8@1+ (1,0) [0|255] ""  External
 SG_ VIS_AHBC_REF_SGN_10_Distance : 232|10@1+ (1,0) [0|1000] "m"  External
 SG_ VIS_AHBC_REF_SGN_10_TopAngle : 242|6@1+ (1,-30) [-30|30] "deg"  External
 SG_ VIS_AHBC_REF_SGN_10_BottomAngle : 248|6@1+ (1,-30) [-30|30] "deg"  External
 SG_ VIS_AHBC_REF_SGN_10_LeftAngle : 254|6@1+ (1,-30) [-30|30] "deg"  External
 SG_ VIS_AHBC_REF_SGN_10_RightAngle : 260|6@1+ (1,-30) [-30|30] "deg"  External
 SG_ VIS_AHBC_REF_SGN_10_GlareLevelMa : 266|7@1+ (1,0) [0|100] "SED"  External
 SG_ VIS_AHBC_REF_SGN_10_GlareLevelCu : 273|7@1+ (1,0) [0|100] "SED"  External
 SG_ VIS_AHBC_REF_SGN_11_ID : 280|8@1+ (1,0) [0|255] ""  External
 SG_ VIS_AHBC_REF_SGN_11_Distance : 288|10@1+ (1,0) [0|1000] "m"  External
 SG_ VIS_AHBC_REF_SGN_11_TopAngle : 298|6@1+ (1,-30) [-30|30] "deg"  External
 SG_ VIS_AHBC_REF_SGN_11_BottomAngle : 304|6@1+ (1,-30) [-30|30] "deg"  External
 SG_ VIS_AHBC_REF_SGN_11_LeftAngle : 310|6@1+ (1,-30) [-30|30] "deg"  External
 SG_ VIS_AHBC_REF_SGN_11_RightAngle : 316|6@1+ (1,-30) [-30|30] "deg"  External
 SG_ VIS_AHBC_REF_SGN_11_GlareLevelMa : 322|7@1+ (1,0) [0|100] "SED"  External
 SG_ VIS_AHBC_REF_SGN_11_GlareLevelCu : 329|7@1+ (1,0) [0|100] "SED"  External

BO_ 1862 VIS_AHBC_INFO: 64 IFV410
 SG_ VIS_AHBC_numOfActiveLightSpots : 0|4@1+ (1,0) [0|15] "N/A"  External
 SG_ VIS_AHBC_numOfReflectiveSigns : 4|4@1+ (1,0) [0|12] "N/A"  External
 SG_ VIS_AHBC_clearFieldOfView : 8|2@1+ (1,0) [0|2] "N/A"  External
 SG_ VIS_AHBC_gridFrequency : 10|2@1+ (1,0) [0|2] "N/A"  External
 SG_ VIS_AHBC_Available : 12|2@1+ (1,0) [0|2] "N/A"  External
 SG_ VIS_AHBC_beamRequest : 14|1@1+ (1,0) [0|1] "N/A"  External
 SG_ VIS_AHBC_eventsDetected : 15|16@1+ (1,0) [0|65535] "N/A"  External
 SG_ VIS_AHBC_Tunnel : 31|2@1+ (1,0) [0|2] "N/A"  External
 SG_ VIS_AHBC_fogDetected : 33|1@1+ (1,0) [0|1] "N/A"  External
 SG_ VIS_AHBC_highwayDetected : 34|1@1+ (1,0) [0|1] "N/A"  External
 SG_ VIS_AHBC_villageDetected : 35|1@1+ (1,0) [0|1] "N/A"  External
 SG_ VIS_AHBC_oncomingLaneNotDark : 36|1@1+ (1,0) [0|1] "N/A"  External
 SG_ VIS_AHBC_approachingJunction : 37|1@1+ (1,0) [0|1] "N/A"  External
 SG_ VIS_AHBC_lightNoisyScene : 38|1@1+ (1,0) [0|1] "N/A"  External
 SG_ VIS_AHBC_lightCone : 39|1@1+ (1,0) [0|1] "N/A"  External

BO_ 1833 VIS_AEB_INFO: 64 IFV410
 SG_ VIS_AEB_VehIndexUsed : 0|32@1+ (1,0) [0|4294967295] "N/A"  External
 SG_ VIS_AEB_VRUWarning : 32|8@1+ (1,0) [0|15] "N/A"  External
 SG_ VIS_AEB_VRUBrake : 40|8@1+ (1,0) [0|15] "N/A"  External
 SG_ VIS_AEB_VRUBrakeDBS : 48|8@1+ (1,0) [0|15] "N/A"  External
 SG_ VIS_AEB_VRUHighBrake : 56|8@1+ (1,0) [0|15] "N/A"  External
 SG_ VIS_AEB_VRUPartialBrake : 64|8@1+ (1,0) [0|15] "N/A"  External
 SG_ VIS_AEB_VRUPrefill : 72|8@1+ (1,0) [0|15] "N/A"  External
 SG_ VIS_AEB_VRUNotify : 80|8@1+ (1,0) [0|15] "N/A"  External
 SG_ VIS_AEB_VRUBrakeJerk : 88|8@1+ (1,0) [0|15] "N/A"  External
 SG_ VIS_AEB_VehWarning : 96|8@1+ (1,0) [0|15] "N/A"  External
 SG_ VIS_AEB_VehBrake : 104|8@1+ (1,0) [0|15] "N/A"  External
 SG_ VIS_AEB_VehBrakeDBS : 112|8@1+ (1,0) [0|15] "N/A"  External
 SG_ VIS_AEB_VehHighBrake : 120|8@1+ (1,0) [0|15] "N/A"  External
 SG_ VIS_AEB_VehPartialBrake : 128|8@1+ (1,0) [0|15] "N/A"  External
 SG_ VIS_AEB_PCAiWarning : 136|8@1+ (1,0) [0|15] "N/A"  External
 SG_ VIS_AEB_PCAiBrake : 144|8@1+ (1,0) [0|15] "N/A"  External

BO_ 1795 Electrical_Status: 64 IFV410
 SG_ EQ_StaticCal_runMode : 391|1@1+ (1,0) [0|1] ""  External
 SG_ EQ_StaticCal_imageIndex : 368|16@1+ (1,0) [0|65535] ""  External
 SG_ EQ_StaticCal_error : 384|4@1+ (1,0) [0|15] ""  External
 SG_ EQ_DynamicCal_status : 363|2@1+ (1,0) [0|3] ""  External
 SG_ EQ_DynamicCal_runMode : 360|3@1+ (1,0) [0|7] ""  External
 SG_ EQ_DynamicCal_imageIndex : 344|16@1+ (1,0) [0|65535] ""  External
 SG_ EQ_DynamicCal_error : 365|3@1+ (1,0) [0|7] ""  External
 SG_ EQ_Mesp_target_mode : 392|3@1+ (1,0) [0|7] ""  External
 SG_ EQ_Mesp_return_status : 388|3@1+ (1,0) [0|7] ""  External
 SG_ EQ_Mesp_current_step : 328|8@1+ (1,0) [0|255] ""  External
 SG_ EQ_Mesp_current_msg_tag_cnt : 336|8@1+ (1,0) [0|255] ""  External
 SG_ EQ_Boot_Test_results : 312|16@1+ (1,0) [0|4095] ""  External
 SG_ EQ_Diag_Minor_Error : 296|16@1+ (1,0) [0|5013] ""  External
 SG_ EQ_Diag_Fatal_Error : 288|8@1+ (1,0) [0|255] ""  External
 SG_ EQ_Diag_Application_Diagnostics_ : 272|16@1+ (1,0) [0|65535] ""  External
 SG_ MCAL_ModuleId : 216|16@1+ (1,0) [0|65535] ""  External
 SG_ MCAL_InstanceId : 208|8@1+ (1,0) [0|255] ""  External
 SG_ MCAL_ErrorId : 200|8@1+ (1,0) [0|255] ""  External
 SG_ MCAL_ApiId : 192|8@1+ (1,0) [0|255] ""  External
 SG_ AURIX_Core5_Cpu_Load : 136|8@1+ (1,0) [0|100] "%"  External
 SG_ AURIX_Core4_Cpu_Load : 128|8@1+ (1,0) [0|100] "%"  External
 SG_ AURIX_Core3_Cpu_Load : 120|8@1+ (1,0) [0|100] "%"  External
 SG_ AURIX_Core2_Cpu_Load : 112|8@1+ (1,0) [0|100] "%"  External
 SG_ AURIX_Core1_Cpu_Load : 104|8@1+ (1,0) [0|100] "%"  External
 SG_ AURIX_Core0_Cpu_Load : 96|8@1+ (1,0) [0|100] "%"  External

BO_ 1794 ADAS_SW_Version_Info: 64 IFV410
 SG_ SATA_Interface_Wrapper_Version : 88|8@1+ (1,0) [0|255] ""  External
 SG_ Tracker_Interface_Wrapper_Versio : 112|8@1+ (1,0) [0|255] ""  External
 SG_ SPP_Interface_Wrapper_Version : 136|8@1+ (1,0) [0|255] ""  External
 SG_ TA_Interface_Wrapper_Version : 160|8@1+ (1,0) [0|255] ""  External
 SG_ ME_RELEASE_REV : 48|8@1+ (1,0) [0|255] ""  External
 SG_ ME_PROMOTE_REV : 56|8@1+ (1,0) [0|255] ""  External
 SG_ ME_FIELD_REV : 64|8@1+ (1,0) [0|255] ""  External
 SG_ SPP_Interface_Major_Version : 120|8@1+ (1,0) [0|255] ""  External
 SG_ TA_Interface_Minor_Version : 152|8@1+ (1,0) [0|255] ""  External
 SG_ TA_Interface_Major_Version : 144|8@1+ (1,0) [0|255] ""  External
 SG_ SPP_Interface_Minor_Version : 128|8@1+ (1,0) [0|255] ""  External
 SG_ CWMP_BOOT_RELEASE_REV : 0|8@1+ (1,0) [0|255] ""  External
 SG_ CWMP_BOOT_PROMOTE_REV : 8|8@1+ (1,0) [0|255] ""  External
 SG_ CWMP_BOOT_FIELD_REV : 16|8@1+ (1,0) [0|255] ""  External
 SG_ CWMP_RELEASE_REV : 24|8@1+ (1,0) [0|255] ""  External
 SG_ CWMP_PROMOTE_REV : 32|8@1+ (1,0) [0|255] ""  External
 SG_ CWMP_FIELD_REV : 40|8@1+ (1,0) [0|255] ""  External
 SG_ SATA_Interface_Major_Version : 72|8@1+ (1,0) [0|255] ""  External
 SG_ SATA_Interface_Minor_Version : 80|8@1+ (1,0) [0|255] ""  External
 SG_ Tracker_Interface_Major_Version : 96|8@1+ (1,0) [0|255] ""  External
 SG_ Tracker_Interface_Minor_Version : 104|8@1+ (1,0) [0|255] ""  External
 SG_ OTP_Interface_Major_Version : 168|8@1+ (1,0) [0|255] ""  External
 SG_ OTP_Interface_Minor_Version : 176|8@1+ (1,0) [0|255] ""  External
 SG_ OTP_Interface_Wrapper_Versio : 184|8@1+ (1,0) [0|255] ""  External
 SG_ SWP1_Interface_Major_Version : 192|8@1+ (1,0) [0|255] ""  External
 SG_ SWP1_Interface_Minor_Version : 200|8@1+ (1,0) [0|255] ""  External
 SG_ SWP1_Interface_Wrapper_Versio : 208|8@1+ (1,0) [0|255] ""  External
 SG_ SWP4_Interface_Major_Version : 216|8@1+ (1,0) [0|255] ""  External
 SG_ SWP4_Interface_Minor_Version : 224|8@1+ (1,0) [0|255] ""  External
 SG_ SWP4_Interface_Wrapper_Versio : 232|8@1+ (1,0) [0|255] ""  External
 SG_ SWP5_Interface_Major_Version : 240|8@1+ (1,0) [0|255] ""  External
 SG_ SWP5_Interface_Minor_Version : 248|8@1+ (1,0) [0|255] ""  External
 SG_ SWP5_Interface_Wrapper_Versio : 256|8@1+ (1,0) [0|255] ""  External
 SG_ MRR_Interface_Major_Version : 264|8@1+ (1,0) [0|255] ""  External
 SG_ MRR_Interface_Minor_Version : 272|8@1+ (1,0) [0|255] ""  External
 SG_ MRR_Interface_Wrapper_Versio : 280|8@1+ (1,0) [0|255] ""  External
 SG_ SRR_Interface_Major_Version : 288|8@1+ (1,0) [0|255] ""  External
 SG_ SRR_Interface_Minor_Version : 296|8@1+ (1,0) [0|255] ""  External
 SG_ SRR_Interface_Wrapper_Versio : 304|8@1+ (1,0) [0|255] ""  External

BO_TX_BU_ 1794 : ASDM,IFV410;
BA_DEF_ BO_  "GenMsgSendType" ENUM  "FixedPeriodic","Event","EnabledPeriodic","NotUsed","NotUsed","EventPeriodic","NotUsed","NotUsed","NoMsgSendType";
BA_DEF_ BO_  "GenMsgCycleTime" INT 0 100000;
BA_DEF_ BO_  "GenMsgILSupport" ENUM  "No","Yes";
BA_DEF_ SG_  "GenSigStartValue" INT 0 1000000000;
BA_DEF_ SG_  "UsedOnPgmDBC" ENUM  "No","Yes";
BA_DEF_ SG_  "GenSigSendType" ENUM  "Cyclic","OnWrite","vector_leerstring","OnChange","vector_leerstring","IfActive","vector_leerstring","NoSigSendType";
BA_DEF_ BO_  "VFrameFormat" ENUM  "StandardCAN","ExtendedCAN","reserved","reserved","reserved","reserved","reserved","reserved","reserved","reserved","reserved","reserved","reserved","reserved","StandardCAN_FD","ExtendedCAN_FD";
BA_DEF_ SG_  "SystemSignalLongSymbol" STRING ;
BA_DEF_DEF_  "GenMsgSendType" "NoMsgSendType";
BA_DEF_DEF_  "GenMsgCycleTime" 0;
BA_DEF_DEF_  "GenMsgILSupport" "Yes";
BA_DEF_DEF_  "GenSigStartValue" 0;
BA_DEF_DEF_  "UsedOnPgmDBC" "Yes";
BA_DEF_DEF_  "GenSigSendType" "NoSigSendType";
BA_DEF_DEF_  "VFrameFormat" "StandardCAN";
BA_DEF_DEF_  "SystemSignalLongSymbol" "";
BA_ "GenMsgSendType" BO_ 1840 0;
BA_ "GenMsgCycleTime" BO_ 1840 50;
BA_ "VFrameFormat" BO_ 1840 14;
BA_ "GenMsgSendType" BO_ 1841 0;
BA_ "GenMsgCycleTime" BO_ 1841 50;
BA_ "VFrameFormat" BO_ 1841 14;
BA_ "GenMsgSendType" BO_ 1842 0;
BA_ "GenMsgCycleTime" BO_ 1842 50;
BA_ "VFrameFormat" BO_ 1842 14;
BA_ "GenMsgSendType" BO_ 1843 0;
BA_ "GenMsgCycleTime" BO_ 1843 50;
BA_ "VFrameFormat" BO_ 1843 14;
BA_ "GenMsgSendType" BO_ 1844 0;
BA_ "GenMsgCycleTime" BO_ 1844 50;
BA_ "VFrameFormat" BO_ 1844 14;
BA_ "GenMsgSendType" BO_ 1845 0;
BA_ "GenMsgCycleTime" BO_ 1845 50;
BA_ "VFrameFormat" BO_ 1845 14;
BA_ "GenMsgSendType" BO_ 1846 0;
BA_ "GenMsgCycleTime" BO_ 1846 50;
BA_ "VFrameFormat" BO_ 1846 14;
BA_ "GenMsgSendType" BO_ 1847 0;
BA_ "GenMsgCycleTime" BO_ 1847 50;
BA_ "VFrameFormat" BO_ 1847 14;
BA_ "GenMsgSendType" BO_ 1848 0;
BA_ "GenMsgCycleTime" BO_ 1848 50;
BA_ "VFrameFormat" BO_ 1848 14;
BA_ "GenMsgSendType" BO_ 1856 0;
BA_ "GenMsgCycleTime" BO_ 1856 50;
BA_ "VFrameFormat" BO_ 1856 14;
BA_ "GenMsgSendType" BO_ 1857 0;
BA_ "GenMsgCycleTime" BO_ 1857 50;
BA_ "VFrameFormat" BO_ 1857 14;
BA_ "GenMsgSendType" BO_ 1858 0;
BA_ "GenMsgCycleTime" BO_ 1858 50;
BA_ "VFrameFormat" BO_ 1858 14;
BA_ "GenMsgSendType" BO_ 1859 0;
BA_ "GenMsgCycleTime" BO_ 1859 50;
BA_ "VFrameFormat" BO_ 1859 14;
BA_ "GenMsgSendType" BO_ 1860 0;
BA_ "GenMsgCycleTime" BO_ 1860 50;
BA_ "VFrameFormat" BO_ 1860 14;
BA_ "GenMsgSendType" BO_ 1861 0;
BA_ "GenMsgCycleTime" BO_ 1861 50;
BA_ "VFrameFormat" BO_ 1861 14;
BA_ "GenMsgSendType" BO_ 1862 0;
BA_ "GenMsgCycleTime" BO_ 1862 50;
BA_ "VFrameFormat" BO_ 1862 14;
BA_ "GenMsgSendType" BO_ 1833 0;
BA_ "GenMsgCycleTime" BO_ 1833 50;
BA_ "VFrameFormat" BO_ 1833 14;
BA_ "GenMsgCycleTime" BO_ 1795 25;
BA_ "GenMsgSendType" BO_ 1795 0;
BA_ "VFrameFormat" BO_ 1795 14;
BA_ "GenMsgSendType" BO_ 1794 0;
BA_ "GenMsgCycleTime" BO_ 1794 1000;
BA_ "VFrameFormat" BO_ 1794 14;
BA_ "GenSigStartValue" SG_ 1840 VIS_TSR_SIGN_6_Height 128;
BA_ "GenSigStartValue" SG_ 1840 VIS_TSR_SIGN_5_Height 128;
BA_ "GenSigStartValue" SG_ 1840 VIS_TSR_SIGN_4_Height 128;
BA_ "GenSigStartValue" SG_ 1840 VIS_TSR_SIGN_3_Height 128;
BA_ "GenSigStartValue" SG_ 1840 VIS_TSR_SIGN_2_Height 128;
BA_ "GenSigStartValue" SG_ 1840 VIS_TSR_SIGN_1_Height 128;
BA_ "GenSigStartValue" SG_ 1840 VIS_TSR_SIGN_0_Height 128;
BA_ "GenSigStartValue" SG_ 1841 VIS_TSR_SIGN_13_Height 128;
BA_ "GenSigStartValue" SG_ 1841 VIS_TSR_SIGN_12_Height 128;
BA_ "GenSigStartValue" SG_ 1841 VIS_TSR_SIGN_11_Height 128;
BA_ "GenSigStartValue" SG_ 1841 VIS_TSR_SIGN_10_Height 128;
BA_ "GenSigStartValue" SG_ 1841 VIS_TSR_SIGN_9_Height 128;
BA_ "GenSigStartValue" SG_ 1841 VIS_TSR_SIGN_8_Height 128;
BA_ "GenSigStartValue" SG_ 1841 VIS_TSR_SIGN_7_Height 128;
BA_ "SystemSignalLongSymbol" SG_ 1841 VIS_TSR_SIGN_10_SupplementalType "VIS_TSR_SIGN_10_SupplementalType1";
BA_ "SystemSignalLongSymbol" SG_ 1841 VIS_TSR_SIGN_10_Supplementa_0000 "VIS_TSR_SIGN_10_SupplementalType2";
BA_ "SystemSignalLongSymbol" SG_ 1841 VIS_TSR_SIGN_11_SupplementalType "VIS_TSR_SIGN_11_SupplementalType1";
BA_ "SystemSignalLongSymbol" SG_ 1841 VIS_TSR_SIGN_11_Supplementa_0000 "VIS_TSR_SIGN_11_SupplementalType2";
BA_ "SystemSignalLongSymbol" SG_ 1841 VIS_TSR_SIGN_12_SupplementalType "VIS_TSR_SIGN_12_SupplementalType1";
BA_ "SystemSignalLongSymbol" SG_ 1841 VIS_TSR_SIGN_12_Supplementa_0000 "VIS_TSR_SIGN_12_SupplementalType2";
BA_ "SystemSignalLongSymbol" SG_ 1841 VIS_TSR_SIGN_13_SupplementalType "VIS_TSR_SIGN_13_SupplementalType1";
BA_ "SystemSignalLongSymbol" SG_ 1841 VIS_TSR_SIGN_13_Supplementa_0000 "VIS_TSR_SIGN_13_SupplementalType2";
BA_ "GenSigStartValue" SG_ 1842 VIS_TSR_SIGN_19_Height 128;
BA_ "GenSigStartValue" SG_ 1842 VIS_TSR_SIGN_18_Height 128;
BA_ "GenSigStartValue" SG_ 1842 VIS_TSR_SIGN_17_Height 128;
BA_ "GenSigStartValue" SG_ 1842 VIS_TSR_SIGN_16_Height 128;
BA_ "GenSigStartValue" SG_ 1842 VIS_TSR_SIGN_15_Height 128;
BA_ "GenSigStartValue" SG_ 1842 VIS_TSR_SIGN_14_Height 128;
BA_ "SystemSignalLongSymbol" SG_ 1842 VIS_TSR_SIGN_14_SupplementalType "VIS_TSR_SIGN_14_SupplementalType1";
BA_ "SystemSignalLongSymbol" SG_ 1842 VIS_TSR_SIGN_14_Supplementa_0000 "VIS_TSR_SIGN_14_SupplementalType2";
BA_ "SystemSignalLongSymbol" SG_ 1842 VIS_TSR_SIGN_15_SupplementalType "VIS_TSR_SIGN_15_SupplementalType1";
BA_ "SystemSignalLongSymbol" SG_ 1842 VIS_TSR_SIGN_15_Supplementa_0000 "VIS_TSR_SIGN_15_SupplementalType2";
BA_ "SystemSignalLongSymbol" SG_ 1842 VIS_TSR_SIGN_16_SupplementalType "VIS_TSR_SIGN_16_SupplementalType1";
BA_ "SystemSignalLongSymbol" SG_ 1842 VIS_TSR_SIGN_16_Supplementa_0000 "VIS_TSR_SIGN_16_SupplementalType2";
BA_ "SystemSignalLongSymbol" SG_ 1842 VIS_TSR_SIGN_17_SupplementalType "VIS_TSR_SIGN_17_SupplementalType1";
BA_ "SystemSignalLongSymbol" SG_ 1842 VIS_TSR_SIGN_17_Supplementa_0000 "VIS_TSR_SIGN_17_SupplementalType2";
BA_ "SystemSignalLongSymbol" SG_ 1842 VIS_TSR_SIGN_18_SupplementalType "VIS_TSR_SIGN_18_SupplementalType1";
BA_ "SystemSignalLongSymbol" SG_ 1842 VIS_TSR_SIGN_18_Supplementa_0000 "VIS_TSR_SIGN_18_SupplementalType2";
BA_ "SystemSignalLongSymbol" SG_ 1842 VIS_TSR_SIGN_19_SupplementalType "VIS_TSR_SIGN_19_SupplementalType1";
BA_ "SystemSignalLongSymbol" SG_ 1842 VIS_TSR_SIGN_19_Supplementa_0000 "VIS_TSR_SIGN_19_SupplementalType2";
BA_ "SystemSignalLongSymbol" SG_ 1843 VIS_TSR_roadMarking_0_StopLinesM "VIS_TSR_roadMarking_0_StopLinesMarkings_num";
BA_ "SystemSignalLongSymbol" SG_ 1843 VIS_TSR_roadMarking_0_StopLines_ "VIS_TSR_roadMarking_0_StopLines_ID";
BA_ "SystemSignalLongSymbol" SG_ 1843 VIS_TSR_roadMarking_0_StopL_0000 "VIS_TSR_roadMarking_0_StopLines_Type";
BA_ "SystemSignalLongSymbol" SG_ 1843 VIS_TSR_roadMarking_0_StopL_0001 "VIS_TSR_roadMarking_0_StopLines_ColorType";
BA_ "SystemSignalLongSymbol" SG_ 1843 VIS_TSR_roadMarking_0_StopL_0002 "VIS_TSR_roadMarking_0_StopLines_Status";
BA_ "SystemSignalLongSymbol" SG_ 1843 VIS_TSR_roadMarking_0_StopL_0003 "VIS_TSR_roadMarking_0_StopLines_isRelevant";
BA_ "SystemSignalLongSymbol" SG_ 1843 VIS_TSR_roadMarking_0_StopL_0004 "VIS_TSR_roadMarking_0_StopLines_angle";
BA_ "SystemSignalLongSymbol" SG_ 1843 VIS_TSR_roadMarking_0_StopL_0005 "VIS_TSR_roadMarking_0_StopLines_conf";
BA_ "SystemSignalLongSymbol" SG_ 1843 VIS_TSR_roadMarking_0_StopL_0006 "VIS_TSR_roadMarking_0_StopLines_longDistance";
BA_ "SystemSignalLongSymbol" SG_ 1843 VIS_TSR_roadMarking_0_StopL_0007 "VIS_TSR_roadMarking_0_StopLines_latlDistance";
BA_ "SystemSignalLongSymbol" SG_ 1843 VIS_TSR_roadMarking_1_StopLinesM "VIS_TSR_roadMarking_1_StopLinesMarkings_num";
BA_ "SystemSignalLongSymbol" SG_ 1843 VIS_TSR_roadMarking_1_StopLines_ "VIS_TSR_roadMarking_1_StopLines_ID";
BA_ "SystemSignalLongSymbol" SG_ 1843 VIS_TSR_roadMarking_1_StopL_0000 "VIS_TSR_roadMarking_1_StopLines_Type";
BA_ "SystemSignalLongSymbol" SG_ 1843 VIS_TSR_roadMarking_1_StopL_0001 "VIS_TSR_roadMarking_1_StopLines_ColorType";
BA_ "SystemSignalLongSymbol" SG_ 1843 VIS_TSR_roadMarking_1_StopL_0002 "VIS_TSR_roadMarking_1_StopLines_Status";
BA_ "SystemSignalLongSymbol" SG_ 1843 VIS_TSR_roadMarking_1_StopL_0003 "VIS_TSR_roadMarking_1_StopLines_isRelevant";
BA_ "SystemSignalLongSymbol" SG_ 1843 VIS_TSR_roadMarking_1_StopL_0004 "VIS_TSR_roadMarking_1_StopLines_angle";
BA_ "SystemSignalLongSymbol" SG_ 1843 VIS_TSR_roadMarking_1_StopL_0005 "VIS_TSR_roadMarking_1_StopLines_conf";
BA_ "SystemSignalLongSymbol" SG_ 1843 VIS_TSR_roadMarking_1_StopL_0006 "VIS_TSR_roadMarking_1_StopLines_longDistance";
BA_ "SystemSignalLongSymbol" SG_ 1843 VIS_TSR_roadMarking_1_StopL_0007 "VIS_TSR_roadMarking_1_StopLines_latlDistance";
BA_ "SystemSignalLongSymbol" SG_ 1843 VIS_TSR_roadMarking_2_StopLinesM "VIS_TSR_roadMarking_2_StopLinesMarkings_num";
BA_ "SystemSignalLongSymbol" SG_ 1843 VIS_TSR_roadMarking_2_StopLines_ "VIS_TSR_roadMarking_2_StopLines_ID";
BA_ "SystemSignalLongSymbol" SG_ 1843 VIS_TSR_roadMarking_2_StopL_0000 "VIS_TSR_roadMarking_2_StopLines_Type";
BA_ "SystemSignalLongSymbol" SG_ 1843 VIS_TSR_roadMarking_2_StopL_0001 "VIS_TSR_roadMarking_2_StopLines_ColorType";
BA_ "SystemSignalLongSymbol" SG_ 1843 VIS_TSR_roadMarking_2_StopL_0002 "VIS_TSR_roadMarking_2_StopLines_Status";
BA_ "SystemSignalLongSymbol" SG_ 1843 VIS_TSR_roadMarking_2_StopL_0003 "VIS_TSR_roadMarking_2_StopLines_isRelevant";
BA_ "SystemSignalLongSymbol" SG_ 1843 VIS_TSR_roadMarking_2_StopL_0004 "VIS_TSR_roadMarking_2_StopLines_angle";
BA_ "SystemSignalLongSymbol" SG_ 1843 VIS_TSR_roadMarking_2_StopL_0005 "VIS_TSR_roadMarking_2_StopLines_conf";
BA_ "SystemSignalLongSymbol" SG_ 1843 VIS_TSR_roadMarking_2_StopL_0006 "VIS_TSR_roadMarking_2_StopLines_longDistance";
BA_ "SystemSignalLongSymbol" SG_ 1843 VIS_TSR_roadMarking_2_StopL_0007 "VIS_TSR_roadMarking_2_StopLines_latlDistance";
BA_ "SystemSignalLongSymbol" SG_ 1843 VIS_TSR_roadMarking_3_StopLinesM "VIS_TSR_roadMarking_3_StopLinesMarkings_num";
BA_ "SystemSignalLongSymbol" SG_ 1843 VIS_TSR_roadMarking_3_StopLines_ "VIS_TSR_roadMarking_3_StopLines_ID";
BA_ "SystemSignalLongSymbol" SG_ 1843 VIS_TSR_roadMarking_3_StopL_0000 "VIS_TSR_roadMarking_3_StopLines_Type";
BA_ "SystemSignalLongSymbol" SG_ 1843 VIS_TSR_roadMarking_3_StopL_0001 "VIS_TSR_roadMarking_3_StopLines_ColorType";
BA_ "SystemSignalLongSymbol" SG_ 1843 VIS_TSR_roadMarking_3_StopL_0002 "VIS_TSR_roadMarking_3_StopLines_Status";
BA_ "SystemSignalLongSymbol" SG_ 1843 VIS_TSR_roadMarking_3_StopL_0003 "VIS_TSR_roadMarking_3_StopLines_isRelevant";
BA_ "SystemSignalLongSymbol" SG_ 1843 VIS_TSR_roadMarking_3_StopL_0004 "VIS_TSR_roadMarking_3_StopLines_angle";
BA_ "SystemSignalLongSymbol" SG_ 1843 VIS_TSR_roadMarking_3_StopL_0005 "VIS_TSR_roadMarking_3_StopLines_conf";
BA_ "SystemSignalLongSymbol" SG_ 1843 VIS_TSR_roadMarking_3_StopL_0006 "VIS_TSR_roadMarking_3_StopLines_longDistance";
BA_ "SystemSignalLongSymbol" SG_ 1843 VIS_TSR_roadMarking_3_StopL_0007 "VIS_TSR_roadMarking_3_StopLines_latlDistance";
BA_ "SystemSignalLongSymbol" SG_ 1843 VIS_TSR_roadMarking_4_StopLinesM "VIS_TSR_roadMarking_4_StopLinesMarkings_num";
BA_ "SystemSignalLongSymbol" SG_ 1843 VIS_TSR_roadMarking_4_StopLines_ "VIS_TSR_roadMarking_4_StopLines_ID";
BA_ "SystemSignalLongSymbol" SG_ 1843 VIS_TSR_roadMarking_4_StopL_0000 "VIS_TSR_roadMarking_4_StopLines_Type";
BA_ "SystemSignalLongSymbol" SG_ 1843 VIS_TSR_roadMarking_4_StopL_0001 "VIS_TSR_roadMarking_4_StopLines_ColorType";
BA_ "SystemSignalLongSymbol" SG_ 1843 VIS_TSR_roadMarking_4_StopL_0002 "VIS_TSR_roadMarking_4_StopLines_Status";
BA_ "SystemSignalLongSymbol" SG_ 1843 VIS_TSR_roadMarking_4_StopL_0003 "VIS_TSR_roadMarking_4_StopLines_isRelevant";
BA_ "SystemSignalLongSymbol" SG_ 1843 VIS_TSR_roadMarking_4_StopL_0004 "VIS_TSR_roadMarking_4_StopLines_angle";
BA_ "SystemSignalLongSymbol" SG_ 1843 VIS_TSR_roadMarking_4_StopL_0005 "VIS_TSR_roadMarking_4_StopLines_conf";
BA_ "SystemSignalLongSymbol" SG_ 1843 VIS_TSR_roadMarking_4_StopL_0006 "VIS_TSR_roadMarking_4_StopLines_longDistance";
BA_ "SystemSignalLongSymbol" SG_ 1843 VIS_TSR_roadMarking_4_StopL_0007 "VIS_TSR_roadMarking_4_StopLines_latlDistance";
BA_ "SystemSignalLongSymbol" SG_ 1844 VIS_TSR_roadMarking_5_StopLinesM "VIS_TSR_roadMarking_5_StopLinesMarkings_num";
BA_ "SystemSignalLongSymbol" SG_ 1844 VIS_TSR_roadMarking_5_StopLines_ "VIS_TSR_roadMarking_5_StopLines_ID";
BA_ "SystemSignalLongSymbol" SG_ 1844 VIS_TSR_roadMarking_5_StopL_0000 "VIS_TSR_roadMarking_5_StopLines_Type";
BA_ "SystemSignalLongSymbol" SG_ 1844 VIS_TSR_roadMarking_5_StopL_0001 "VIS_TSR_roadMarking_5_StopLines_ColorType";
BA_ "SystemSignalLongSymbol" SG_ 1844 VIS_TSR_roadMarking_5_StopL_0002 "VIS_TSR_roadMarking_5_StopLines_Status";
BA_ "SystemSignalLongSymbol" SG_ 1844 VIS_TSR_roadMarking_5_StopL_0003 "VIS_TSR_roadMarking_5_StopLines_isRelevant";
BA_ "SystemSignalLongSymbol" SG_ 1844 VIS_TSR_roadMarking_5_StopL_0004 "VIS_TSR_roadMarking_5_StopLines_angle";
BA_ "SystemSignalLongSymbol" SG_ 1844 VIS_TSR_roadMarking_5_StopL_0005 "VIS_TSR_roadMarking_5_StopLines_conf";
BA_ "SystemSignalLongSymbol" SG_ 1844 VIS_TSR_roadMarking_5_StopL_0006 "VIS_TSR_roadMarking_5_StopLines_longDistance";
BA_ "SystemSignalLongSymbol" SG_ 1844 VIS_TSR_roadMarking_5_StopL_0007 "VIS_TSR_roadMarking_5_StopLines_latlDistance";
BA_ "SystemSignalLongSymbol" SG_ 1844 VIS_TSR_roadMarking_6_StopLinesM "VIS_TSR_roadMarking_6_StopLinesMarkings_num";
BA_ "SystemSignalLongSymbol" SG_ 1844 VIS_TSR_roadMarking_6_StopLines_ "VIS_TSR_roadMarking_6_StopLines_ID";
BA_ "SystemSignalLongSymbol" SG_ 1844 VIS_TSR_roadMarking_6_StopL_0000 "VIS_TSR_roadMarking_6_StopLines_Type";
BA_ "SystemSignalLongSymbol" SG_ 1844 VIS_TSR_roadMarking_6_StopL_0001 "VIS_TSR_roadMarking_6_StopLines_ColorType";
BA_ "SystemSignalLongSymbol" SG_ 1844 VIS_TSR_roadMarking_6_StopL_0002 "VIS_TSR_roadMarking_6_StopLines_Status";
BA_ "SystemSignalLongSymbol" SG_ 1844 VIS_TSR_roadMarking_6_StopL_0003 "VIS_TSR_roadMarking_6_StopLines_isRelevant";
BA_ "SystemSignalLongSymbol" SG_ 1844 VIS_TSR_roadMarking_6_StopL_0004 "VIS_TSR_roadMarking_6_StopLines_angle";
BA_ "SystemSignalLongSymbol" SG_ 1844 VIS_TSR_roadMarking_6_StopL_0005 "VIS_TSR_roadMarking_6_StopLines_conf";
BA_ "SystemSignalLongSymbol" SG_ 1844 VIS_TSR_roadMarking_6_StopL_0006 "VIS_TSR_roadMarking_6_StopLines_longDistance";
BA_ "SystemSignalLongSymbol" SG_ 1844 VIS_TSR_roadMarking_6_StopL_0007 "VIS_TSR_roadMarking_6_StopLines_latlDistance";
BA_ "SystemSignalLongSymbol" SG_ 1844 VIS_TSR_roadMarking_7_StopLinesM "VIS_TSR_roadMarking_7_StopLinesMarkings_num";
BA_ "SystemSignalLongSymbol" SG_ 1844 VIS_TSR_roadMarking_7_StopLines_ "VIS_TSR_roadMarking_7_StopLines_ID";
BA_ "SystemSignalLongSymbol" SG_ 1844 VIS_TSR_roadMarking_7_StopL_0000 "VIS_TSR_roadMarking_7_StopLines_Type";
BA_ "SystemSignalLongSymbol" SG_ 1844 VIS_TSR_roadMarking_7_StopL_0001 "VIS_TSR_roadMarking_7_StopLines_ColorType";
BA_ "SystemSignalLongSymbol" SG_ 1844 VIS_TSR_roadMarking_7_StopL_0002 "VIS_TSR_roadMarking_7_StopLines_Status";
BA_ "SystemSignalLongSymbol" SG_ 1844 VIS_TSR_roadMarking_7_StopL_0003 "VIS_TSR_roadMarking_7_StopLines_isRelevant";
BA_ "SystemSignalLongSymbol" SG_ 1844 VIS_TSR_roadMarking_7_StopL_0004 "VIS_TSR_roadMarking_7_StopLines_angle";
BA_ "SystemSignalLongSymbol" SG_ 1844 VIS_TSR_roadMarking_7_StopL_0005 "VIS_TSR_roadMarking_7_StopLines_conf";
BA_ "SystemSignalLongSymbol" SG_ 1844 VIS_TSR_roadMarking_7_StopL_0006 "VIS_TSR_roadMarking_7_StopLines_longDistance";
BA_ "SystemSignalLongSymbol" SG_ 1844 VIS_TSR_roadMarking_7_StopL_0007 "VIS_TSR_roadMarking_7_StopLines_latlDistance";
BA_ "SystemSignalLongSymbol" SG_ 1844 VIS_TSR_roadMarking_8_StopLinesM "VIS_TSR_roadMarking_8_StopLinesMarkings_num";
BA_ "SystemSignalLongSymbol" SG_ 1844 VIS_TSR_roadMarking_8_StopLines_ "VIS_TSR_roadMarking_8_StopLines_ID";
BA_ "SystemSignalLongSymbol" SG_ 1844 VIS_TSR_roadMarking_8_StopL_0000 "VIS_TSR_roadMarking_8_StopLines_Type";
BA_ "SystemSignalLongSymbol" SG_ 1844 VIS_TSR_roadMarking_8_StopL_0001 "VIS_TSR_roadMarking_8_StopLines_ColorType";
BA_ "SystemSignalLongSymbol" SG_ 1844 VIS_TSR_roadMarking_8_StopL_0002 "VIS_TSR_roadMarking_8_StopLines_Status";
BA_ "SystemSignalLongSymbol" SG_ 1844 VIS_TSR_roadMarking_8_StopL_0003 "VIS_TSR_roadMarking_8_StopLines_isRelevant";
BA_ "SystemSignalLongSymbol" SG_ 1844 VIS_TSR_roadMarking_8_StopL_0004 "VIS_TSR_roadMarking_8_StopLines_angle";
BA_ "SystemSignalLongSymbol" SG_ 1844 VIS_TSR_roadMarking_8_StopL_0005 "VIS_TSR_roadMarking_8_StopLines_conf";
BA_ "SystemSignalLongSymbol" SG_ 1844 VIS_TSR_roadMarking_8_StopL_0006 "VIS_TSR_roadMarking_8_StopLines_longDistance";
BA_ "SystemSignalLongSymbol" SG_ 1844 VIS_TSR_roadMarking_8_StopL_0007 "VIS_TSR_roadMarking_8_StopLines_latlDistance";
BA_ "SystemSignalLongSymbol" SG_ 1844 VIS_TSR_roadMarking_9_StopLinesM "VIS_TSR_roadMarking_9_StopLinesMarkings_num";
BA_ "SystemSignalLongSymbol" SG_ 1844 VIS_TSR_roadMarking_9_StopLines_ "VIS_TSR_roadMarking_9_StopLines_ID";
BA_ "SystemSignalLongSymbol" SG_ 1844 VIS_TSR_roadMarking_9_StopL_0000 "VIS_TSR_roadMarking_9_StopLines_Type";
BA_ "SystemSignalLongSymbol" SG_ 1844 VIS_TSR_roadMarking_9_StopL_0001 "VIS_TSR_roadMarking_9_StopLines_ColorType";
BA_ "SystemSignalLongSymbol" SG_ 1844 VIS_TSR_roadMarking_9_StopL_0002 "VIS_TSR_roadMarking_9_StopLines_Status";
BA_ "SystemSignalLongSymbol" SG_ 1844 VIS_TSR_roadMarking_9_StopL_0003 "VIS_TSR_roadMarking_9_StopLines_isRelevant";
BA_ "SystemSignalLongSymbol" SG_ 1844 VIS_TSR_roadMarking_9_StopL_0004 "VIS_TSR_roadMarking_9_StopLines_angle";
BA_ "SystemSignalLongSymbol" SG_ 1844 VIS_TSR_roadMarking_9_StopL_0005 "VIS_TSR_roadMarking_9_StopLines_conf";
BA_ "SystemSignalLongSymbol" SG_ 1844 VIS_TSR_roadMarking_9_StopL_0006 "VIS_TSR_roadMarking_9_StopLines_longDistance";
BA_ "SystemSignalLongSymbol" SG_ 1844 VIS_TSR_roadMarking_9_StopL_0007 "VIS_TSR_roadMarking_9_StopLines_latlDistance";
BA_ "SystemSignalLongSymbol" SG_ 1845 VIS_TSR_roadMarking_0_Arrows_Typ "VIS_TSR_roadMarking_0_Arrows_Type";
BA_ "SystemSignalLongSymbol" SG_ 1845 VIS_TSR_roadMarking_0_Arrows_con "VIS_TSR_roadMarking_0_Arrows_conf";
BA_ "SystemSignalLongSymbol" SG_ 1845 VIS_TSR_roadMarking_0_Arrows_Lat "VIS_TSR_roadMarking_0_Arrows_LatPosition";
BA_ "SystemSignalLongSymbol" SG_ 1845 VIS_TSR_roadMarking_0_Arrows_Lon "VIS_TSR_roadMarking_0_Arrows_LongPosition";
BA_ "SystemSignalLongSymbol" SG_ 1845 VIS_TSR_roadMarking_1_Arrows_Typ "VIS_TSR_roadMarking_1_Arrows_Type";
BA_ "SystemSignalLongSymbol" SG_ 1845 VIS_TSR_roadMarking_1_Arrows_con "VIS_TSR_roadMarking_1_Arrows_conf";
BA_ "SystemSignalLongSymbol" SG_ 1845 VIS_TSR_roadMarking_1_Arrows_Lat "VIS_TSR_roadMarking_1_Arrows_LatPosition";
BA_ "SystemSignalLongSymbol" SG_ 1845 VIS_TSR_roadMarking_1_Arrows_Lon "VIS_TSR_roadMarking_1_Arrows_LongPosition";
BA_ "SystemSignalLongSymbol" SG_ 1845 VIS_TSR_roadMarking_2_Arrows_Typ "VIS_TSR_roadMarking_2_Arrows_Type";
BA_ "SystemSignalLongSymbol" SG_ 1845 VIS_TSR_roadMarking_2_Arrows_con "VIS_TSR_roadMarking_2_Arrows_conf";
BA_ "SystemSignalLongSymbol" SG_ 1845 VIS_TSR_roadMarking_2_Arrows_Lat "VIS_TSR_roadMarking_2_Arrows_LatPosition";
BA_ "SystemSignalLongSymbol" SG_ 1845 VIS_TSR_roadMarking_2_Arrows_Lon "VIS_TSR_roadMarking_2_Arrows_LongPosition";
BA_ "SystemSignalLongSymbol" SG_ 1845 VIS_TSR_roadMarking_3_Arrows_Typ "VIS_TSR_roadMarking_3_Arrows_Type";
BA_ "SystemSignalLongSymbol" SG_ 1845 VIS_TSR_roadMarking_3_Arrows_con "VIS_TSR_roadMarking_3_Arrows_conf";
BA_ "SystemSignalLongSymbol" SG_ 1845 VIS_TSR_roadMarking_3_Arrows_Lat "VIS_TSR_roadMarking_3_Arrows_LatPosition";
BA_ "SystemSignalLongSymbol" SG_ 1845 VIS_TSR_roadMarking_3_Arrows_Lon "VIS_TSR_roadMarking_3_Arrows_LongPosition";
BA_ "SystemSignalLongSymbol" SG_ 1845 VIS_TSR_roadMarking_4_Arrows_Typ "VIS_TSR_roadMarking_4_Arrows_Type";
BA_ "SystemSignalLongSymbol" SG_ 1845 VIS_TSR_roadMarking_4_Arrows_con "VIS_TSR_roadMarking_4_Arrows_conf";
BA_ "SystemSignalLongSymbol" SG_ 1845 VIS_TSR_roadMarking_4_Arrows_Lat "VIS_TSR_roadMarking_4_Arrows_LatPosition";
BA_ "SystemSignalLongSymbol" SG_ 1845 VIS_TSR_roadMarking_4_Arrows_Lon "VIS_TSR_roadMarking_4_Arrows_LongPosition";
BA_ "SystemSignalLongSymbol" SG_ 1845 VIS_TSR_roadMarking_5_Arrows_Typ "VIS_TSR_roadMarking_5_Arrows_Type";
BA_ "SystemSignalLongSymbol" SG_ 1845 VIS_TSR_roadMarking_5_Arrows_con "VIS_TSR_roadMarking_5_Arrows_conf";
BA_ "SystemSignalLongSymbol" SG_ 1845 VIS_TSR_roadMarking_5_Arrows_Lat "VIS_TSR_roadMarking_5_Arrows_LatPosition";
BA_ "SystemSignalLongSymbol" SG_ 1845 VIS_TSR_roadMarking_5_Arrows_Lon "VIS_TSR_roadMarking_5_Arrows_LongPosition";
BA_ "SystemSignalLongSymbol" SG_ 1845 VIS_TSR_roadMarking_6_Arrows_Typ "VIS_TSR_roadMarking_6_Arrows_Type";
BA_ "SystemSignalLongSymbol" SG_ 1845 VIS_TSR_roadMarking_6_Arrows_con "VIS_TSR_roadMarking_6_Arrows_conf";
BA_ "SystemSignalLongSymbol" SG_ 1845 VIS_TSR_roadMarking_6_Arrows_Lat "VIS_TSR_roadMarking_6_Arrows_LatPosition";
BA_ "SystemSignalLongSymbol" SG_ 1845 VIS_TSR_roadMarking_6_Arrows_Lon "VIS_TSR_roadMarking_6_Arrows_LongPosition";
BA_ "SystemSignalLongSymbol" SG_ 1845 VIS_TSR_roadMarking_7_Arrows_Typ "VIS_TSR_roadMarking_7_Arrows_Type";
BA_ "SystemSignalLongSymbol" SG_ 1845 VIS_TSR_roadMarking_7_Arrows_con "VIS_TSR_roadMarking_7_Arrows_conf";
BA_ "SystemSignalLongSymbol" SG_ 1845 VIS_TSR_roadMarking_7_Arrows_Lat "VIS_TSR_roadMarking_7_Arrows_LatPosition";
BA_ "SystemSignalLongSymbol" SG_ 1845 VIS_TSR_roadMarking_7_Arrows_Lon "VIS_TSR_roadMarking_7_Arrows_LongPosition";
BA_ "SystemSignalLongSymbol" SG_ 1845 VIS_TSR_roadMarking_8_Arrows_Typ "VIS_TSR_roadMarking_8_Arrows_Type";
BA_ "SystemSignalLongSymbol" SG_ 1845 VIS_TSR_roadMarking_8_Arrows_con "VIS_TSR_roadMarking_8_Arrows_conf";
BA_ "SystemSignalLongSymbol" SG_ 1845 VIS_TSR_roadMarking_8_Arrows_Lat "VIS_TSR_roadMarking_8_Arrows_LatPosition";
BA_ "SystemSignalLongSymbol" SG_ 1845 VIS_TSR_roadMarking_8_Arrows_Lon "VIS_TSR_roadMarking_8_Arrows_LongPosition";
BA_ "SystemSignalLongSymbol" SG_ 1845 VIS_TSR_roadMarking_9_Arrows_Typ "VIS_TSR_roadMarking_9_Arrows_Type";
BA_ "SystemSignalLongSymbol" SG_ 1845 VIS_TSR_roadMarking_9_Arrows_con "VIS_TSR_roadMarking_9_Arrows_conf";
BA_ "SystemSignalLongSymbol" SG_ 1845 VIS_TSR_roadMarking_9_Arrows_Lat "VIS_TSR_roadMarking_9_Arrows_LatPosition";
BA_ "SystemSignalLongSymbol" SG_ 1845 VIS_TSR_roadMarking_9_Arrows_Lon "VIS_TSR_roadMarking_9_Arrows_LongPosition";
BA_ "SystemSignalLongSymbol" SG_ 1846 VIS_TSR_roadMarking_0_SpeedLimit "VIS_TSR_roadMarking_0_SpeedLimits_ID";
BA_ "SystemSignalLongSymbol" SG_ 1846 VIS_TSR_roadMarking_0_Speed_0000 "VIS_TSR_roadMarking_0_SpeedLimits_Type";
BA_ "SystemSignalLongSymbol" SG_ 1846 VIS_TSR_roadMarking_0_Speed_0001 "VIS_TSR_roadMarking_0_SpeedLimits_conf";
BA_ "SystemSignalLongSymbol" SG_ 1846 VIS_TSR_roadMarking_0_Speed_0002 "VIS_TSR_roadMarking_0_SpeedLimits_LatPosition";
BA_ "SystemSignalLongSymbol" SG_ 1846 VIS_TSR_roadMarking_0_Speed_0003 "VIS_TSR_roadMarking_0_SpeedLimits_LongPosition";
BA_ "SystemSignalLongSymbol" SG_ 1846 VIS_TSR_roadMarking_1_SpeedLimit "VIS_TSR_roadMarking_1_SpeedLimits_ID";
BA_ "SystemSignalLongSymbol" SG_ 1846 VIS_TSR_roadMarking_1_Speed_0000 "VIS_TSR_roadMarking_1_SpeedLimits_Type";
BA_ "SystemSignalLongSymbol" SG_ 1846 VIS_TSR_roadMarking_1_Speed_0001 "VIS_TSR_roadMarking_1_SpeedLimits_conf";
BA_ "SystemSignalLongSymbol" SG_ 1846 VIS_TSR_roadMarking_1_Speed_0002 "VIS_TSR_roadMarking_1_SpeedLimits_LatPosition";
BA_ "SystemSignalLongSymbol" SG_ 1846 VIS_TSR_roadMarking_1_Speed_0003 "VIS_TSR_roadMarking_1_SpeedLimits_LongPosition";
BA_ "SystemSignalLongSymbol" SG_ 1846 VIS_TSR_roadMarking_2_SpeedLimit "VIS_TSR_roadMarking_2_SpeedLimits_ID";
BA_ "SystemSignalLongSymbol" SG_ 1846 VIS_TSR_roadMarking_2_Speed_0000 "VIS_TSR_roadMarking_2_SpeedLimits_Type";
BA_ "SystemSignalLongSymbol" SG_ 1846 VIS_TSR_roadMarking_2_Speed_0001 "VIS_TSR_roadMarking_2_SpeedLimits_conf";
BA_ "SystemSignalLongSymbol" SG_ 1846 VIS_TSR_roadMarking_2_Speed_0002 "VIS_TSR_roadMarking_2_SpeedLimits_LatPosition";
BA_ "SystemSignalLongSymbol" SG_ 1846 VIS_TSR_roadMarking_2_Speed_0003 "VIS_TSR_roadMarking_2_SpeedLimits_LongPosition";
BA_ "SystemSignalLongSymbol" SG_ 1846 VIS_TSR_roadMarking_3_SpeedLimit "VIS_TSR_roadMarking_3_SpeedLimits_ID";
BA_ "SystemSignalLongSymbol" SG_ 1846 VIS_TSR_roadMarking_3_Speed_0000 "VIS_TSR_roadMarking_3_SpeedLimits_Type";
BA_ "SystemSignalLongSymbol" SG_ 1846 VIS_TSR_roadMarking_3_Speed_0001 "VIS_TSR_roadMarking_3_SpeedLimits_conf";
BA_ "SystemSignalLongSymbol" SG_ 1846 VIS_TSR_roadMarking_3_Speed_0002 "VIS_TSR_roadMarking_3_SpeedLimits_LatPosition";
BA_ "SystemSignalLongSymbol" SG_ 1846 VIS_TSR_roadMarking_3_Speed_0003 "VIS_TSR_roadMarking_3_SpeedLimits_LongPosition";
BA_ "SystemSignalLongSymbol" SG_ 1846 VIS_TSR_roadMarking_4_SpeedLimit "VIS_TSR_roadMarking_4_SpeedLimits_ID";
BA_ "SystemSignalLongSymbol" SG_ 1846 VIS_TSR_roadMarking_4_Speed_0000 "VIS_TSR_roadMarking_4_SpeedLimits_Type";
BA_ "SystemSignalLongSymbol" SG_ 1846 VIS_TSR_roadMarking_4_Speed_0001 "VIS_TSR_roadMarking_4_SpeedLimits_conf";
BA_ "SystemSignalLongSymbol" SG_ 1846 VIS_TSR_roadMarking_4_Speed_0002 "VIS_TSR_roadMarking_4_SpeedLimits_LatPosition";
BA_ "SystemSignalLongSymbol" SG_ 1846 VIS_TSR_roadMarking_4_Speed_0003 "VIS_TSR_roadMarking_4_SpeedLimits_LongPosition";
BA_ "SystemSignalLongSymbol" SG_ 1846 VIS_TSR_roadMarking_5_SpeedLimit "VIS_TSR_roadMarking_5_SpeedLimits_ID";
BA_ "SystemSignalLongSymbol" SG_ 1846 VIS_TSR_roadMarking_5_Speed_0000 "VIS_TSR_roadMarking_5_SpeedLimits_Type";
BA_ "SystemSignalLongSymbol" SG_ 1846 VIS_TSR_roadMarking_5_Speed_0001 "VIS_TSR_roadMarking_5_SpeedLimits_conf";
BA_ "SystemSignalLongSymbol" SG_ 1846 VIS_TSR_roadMarking_5_Speed_0002 "VIS_TSR_roadMarking_5_SpeedLimits_LatPosition";
BA_ "SystemSignalLongSymbol" SG_ 1846 VIS_TSR_roadMarking_5_Speed_0003 "VIS_TSR_roadMarking_5_SpeedLimits_LongPosition";
BA_ "SystemSignalLongSymbol" SG_ 1846 VIS_TSR_roadMarking_6_SpeedLimit "VIS_TSR_roadMarking_6_SpeedLimits_ID";
BA_ "SystemSignalLongSymbol" SG_ 1846 VIS_TSR_roadMarking_6_Speed_0000 "VIS_TSR_roadMarking_6_SpeedLimits_Type";
BA_ "SystemSignalLongSymbol" SG_ 1846 VIS_TSR_roadMarking_6_Speed_0001 "VIS_TSR_roadMarking_6_SpeedLimits_conf";
BA_ "SystemSignalLongSymbol" SG_ 1846 VIS_TSR_roadMarking_6_Speed_0002 "VIS_TSR_roadMarking_6_SpeedLimits_LatPosition";
BA_ "SystemSignalLongSymbol" SG_ 1846 VIS_TSR_roadMarking_6_Speed_0003 "VIS_TSR_roadMarking_6_SpeedLimits_LongPosition";
BA_ "SystemSignalLongSymbol" SG_ 1846 VIS_TSR_roadMarking_7_SpeedLimit "VIS_TSR_roadMarking_7_SpeedLimits_ID";
BA_ "SystemSignalLongSymbol" SG_ 1846 VIS_TSR_roadMarking_7_Speed_0000 "VIS_TSR_roadMarking_7_SpeedLimits_Type";
BA_ "SystemSignalLongSymbol" SG_ 1846 VIS_TSR_roadMarking_7_Speed_0001 "VIS_TSR_roadMarking_7_SpeedLimits_conf";
BA_ "SystemSignalLongSymbol" SG_ 1846 VIS_TSR_roadMarking_7_Speed_0002 "VIS_TSR_roadMarking_7_SpeedLimits_LatPosition";
BA_ "SystemSignalLongSymbol" SG_ 1846 VIS_TSR_roadMarking_7_Speed_0003 "VIS_TSR_roadMarking_7_SpeedLimits_LongPosition";
BA_ "SystemSignalLongSymbol" SG_ 1846 VIS_TSR_roadMarking_8_SpeedLimit "VIS_TSR_roadMarking_8_SpeedLimits_ID";
BA_ "SystemSignalLongSymbol" SG_ 1846 VIS_TSR_roadMarking_8_Speed_0000 "VIS_TSR_roadMarking_8_SpeedLimits_Type";
BA_ "SystemSignalLongSymbol" SG_ 1846 VIS_TSR_roadMarking_8_Speed_0001 "VIS_TSR_roadMarking_8_SpeedLimits_conf";
BA_ "SystemSignalLongSymbol" SG_ 1846 VIS_TSR_roadMarking_8_Speed_0002 "VIS_TSR_roadMarking_8_SpeedLimits_LatPosition";
BA_ "SystemSignalLongSymbol" SG_ 1846 VIS_TSR_roadMarking_8_Speed_0003 "VIS_TSR_roadMarking_8_SpeedLimits_LongPosition";
BA_ "SystemSignalLongSymbol" SG_ 1846 VIS_TSR_roadMarking_9_SpeedLimit "VIS_TSR_roadMarking_9_SpeedLimits_ID";
BA_ "SystemSignalLongSymbol" SG_ 1846 VIS_TSR_roadMarking_9_Speed_0000 "VIS_TSR_roadMarking_9_SpeedLimits_Type";
BA_ "SystemSignalLongSymbol" SG_ 1846 VIS_TSR_roadMarking_9_Speed_0001 "VIS_TSR_roadMarking_9_SpeedLimits_conf";
BA_ "SystemSignalLongSymbol" SG_ 1846 VIS_TSR_roadMarking_9_Speed_0002 "VIS_TSR_roadMarking_9_SpeedLimits_LatPosition";
BA_ "SystemSignalLongSymbol" SG_ 1846 VIS_TSR_roadMarking_9_Speed_0003 "VIS_TSR_roadMarking_9_SpeedLimits_LongPosition";
BA_ "SystemSignalLongSymbol" SG_ 1847 VIS_TSR_roadMarking_0_Crossings_ "VIS_TSR_roadMarking_0_Crossings_ID";
BA_ "SystemSignalLongSymbol" SG_ 1847 VIS_TSR_roadMarking_0_Cross_0000 "VIS_TSR_roadMarking_0_Crossings_Type";
BA_ "SystemSignalLongSymbol" SG_ 1847 VIS_TSR_roadMarking_0_Cross_0001 "VIS_TSR_roadMarking_0_Crossings_conf";
BA_ "SystemSignalLongSymbol" SG_ 1847 VIS_TSR_roadMarking_0_Cross_0002 "VIS_TSR_roadMarking_0_Crossings_LatPosition";
BA_ "SystemSignalLongSymbol" SG_ 1847 VIS_TSR_roadMarking_0_Cross_0003 "VIS_TSR_roadMarking_0_Crossings_LongPosition";
BA_ "SystemSignalLongSymbol" SG_ 1847 VIS_TSR_roadMarking_1_Crossings_ "VIS_TSR_roadMarking_1_Crossings_ID";
BA_ "SystemSignalLongSymbol" SG_ 1847 VIS_TSR_roadMarking_1_Cross_0000 "VIS_TSR_roadMarking_1_Crossings_Type";
BA_ "SystemSignalLongSymbol" SG_ 1847 VIS_TSR_roadMarking_1_Cross_0001 "VIS_TSR_roadMarking_1_Crossings_conf";
BA_ "SystemSignalLongSymbol" SG_ 1847 VIS_TSR_roadMarking_1_Cross_0002 "VIS_TSR_roadMarking_1_Crossings_LatPosition";
BA_ "SystemSignalLongSymbol" SG_ 1847 VIS_TSR_roadMarking_1_Cross_0003 "VIS_TSR_roadMarking_1_Crossings_LongPosition";
BA_ "SystemSignalLongSymbol" SG_ 1847 VIS_TSR_roadMarking_2_Crossings_ "VIS_TSR_roadMarking_2_Crossings_ID";
BA_ "SystemSignalLongSymbol" SG_ 1847 VIS_TSR_roadMarking_2_Cross_0000 "VIS_TSR_roadMarking_2_Crossings_Type";
BA_ "SystemSignalLongSymbol" SG_ 1847 VIS_TSR_roadMarking_2_Cross_0001 "VIS_TSR_roadMarking_2_Crossings_conf";
BA_ "SystemSignalLongSymbol" SG_ 1847 VIS_TSR_roadMarking_2_Cross_0002 "VIS_TSR_roadMarking_2_Crossings_LatPosition";
BA_ "SystemSignalLongSymbol" SG_ 1847 VIS_TSR_roadMarking_2_Cross_0003 "VIS_TSR_roadMarking_2_Crossings_LongPosition";
BA_ "SystemSignalLongSymbol" SG_ 1847 VIS_TSR_roadMarking_3_Crossings_ "VIS_TSR_roadMarking_3_Crossings_ID";
BA_ "SystemSignalLongSymbol" SG_ 1847 VIS_TSR_roadMarking_3_Cross_0000 "VIS_TSR_roadMarking_3_Crossings_Type";
BA_ "SystemSignalLongSymbol" SG_ 1847 VIS_TSR_roadMarking_3_Cross_0001 "VIS_TSR_roadMarking_3_Crossings_conf";
BA_ "SystemSignalLongSymbol" SG_ 1847 VIS_TSR_roadMarking_3_Cross_0002 "VIS_TSR_roadMarking_3_Crossings_LatPosition";
BA_ "SystemSignalLongSymbol" SG_ 1847 VIS_TSR_roadMarking_3_Cross_0003 "VIS_TSR_roadMarking_3_Crossings_LongPosition";
BA_ "SystemSignalLongSymbol" SG_ 1847 VIS_TSR_roadMarking_4_Crossings_ "VIS_TSR_roadMarking_4_Crossings_ID";
BA_ "SystemSignalLongSymbol" SG_ 1847 VIS_TSR_roadMarking_4_Cross_0000 "VIS_TSR_roadMarking_4_Crossings_Type";
BA_ "SystemSignalLongSymbol" SG_ 1847 VIS_TSR_roadMarking_4_Cross_0001 "VIS_TSR_roadMarking_4_Crossings_conf";
BA_ "SystemSignalLongSymbol" SG_ 1847 VIS_TSR_roadMarking_4_Cross_0002 "VIS_TSR_roadMarking_4_Crossings_LatPosition";
BA_ "SystemSignalLongSymbol" SG_ 1847 VIS_TSR_roadMarking_4_Cross_0003 "VIS_TSR_roadMarking_4_Crossings_LongPosition";
BA_ "SystemSignalLongSymbol" SG_ 1847 VIS_TSR_roadMarking_5_Crossings_ "VIS_TSR_roadMarking_5_Crossings_ID";
BA_ "SystemSignalLongSymbol" SG_ 1847 VIS_TSR_roadMarking_5_Cross_0000 "VIS_TSR_roadMarking_5_Crossings_Type";
BA_ "SystemSignalLongSymbol" SG_ 1847 VIS_TSR_roadMarking_5_Cross_0001 "VIS_TSR_roadMarking_5_Crossings_conf";
BA_ "SystemSignalLongSymbol" SG_ 1847 VIS_TSR_roadMarking_5_Cross_0002 "VIS_TSR_roadMarking_5_Crossings_LatPosition";
BA_ "SystemSignalLongSymbol" SG_ 1847 VIS_TSR_roadMarking_5_Cross_0003 "VIS_TSR_roadMarking_5_Crossings_LongPosition";
BA_ "SystemSignalLongSymbol" SG_ 1847 VIS_TSR_roadMarking_6_Crossings_ "VIS_TSR_roadMarking_6_Crossings_ID";
BA_ "SystemSignalLongSymbol" SG_ 1847 VIS_TSR_roadMarking_6_Cross_0000 "VIS_TSR_roadMarking_6_Crossings_Type";
BA_ "SystemSignalLongSymbol" SG_ 1847 VIS_TSR_roadMarking_6_Cross_0001 "VIS_TSR_roadMarking_6_Crossings_conf";
BA_ "SystemSignalLongSymbol" SG_ 1847 VIS_TSR_roadMarking_6_Cross_0002 "VIS_TSR_roadMarking_6_Crossings_LatPosition";
BA_ "SystemSignalLongSymbol" SG_ 1847 VIS_TSR_roadMarking_6_Cross_0003 "VIS_TSR_roadMarking_6_Crossings_LongPosition";
BA_ "SystemSignalLongSymbol" SG_ 1847 VIS_TSR_roadMarking_7_Crossings_ "VIS_TSR_roadMarking_7_Crossings_ID";
BA_ "SystemSignalLongSymbol" SG_ 1847 VIS_TSR_roadMarking_7_Cross_0000 "VIS_TSR_roadMarking_7_Crossings_Type";
BA_ "SystemSignalLongSymbol" SG_ 1847 VIS_TSR_roadMarking_7_Cross_0001 "VIS_TSR_roadMarking_7_Crossings_conf";
BA_ "SystemSignalLongSymbol" SG_ 1847 VIS_TSR_roadMarking_7_Cross_0002 "VIS_TSR_roadMarking_7_Crossings_LatPosition";
BA_ "SystemSignalLongSymbol" SG_ 1847 VIS_TSR_roadMarking_7_Cross_0003 "VIS_TSR_roadMarking_7_Crossings_LongPosition";
BA_ "SystemSignalLongSymbol" SG_ 1847 VIS_TSR_roadMarking_8_Crossings_ "VIS_TSR_roadMarking_8_Crossings_ID";
BA_ "SystemSignalLongSymbol" SG_ 1847 VIS_TSR_roadMarking_8_Cross_0000 "VIS_TSR_roadMarking_8_Crossings_Type";
BA_ "SystemSignalLongSymbol" SG_ 1847 VIS_TSR_roadMarking_8_Cross_0001 "VIS_TSR_roadMarking_8_Crossings_conf";
BA_ "SystemSignalLongSymbol" SG_ 1847 VIS_TSR_roadMarking_8_Cross_0002 "VIS_TSR_roadMarking_8_Crossings_LatPosition";
BA_ "SystemSignalLongSymbol" SG_ 1847 VIS_TSR_roadMarking_8_Cross_0003 "VIS_TSR_roadMarking_8_Crossings_LongPosition";
BA_ "SystemSignalLongSymbol" SG_ 1847 VIS_TSR_roadMarking_9_Crossings_ "VIS_TSR_roadMarking_9_Crossings_ID";
BA_ "SystemSignalLongSymbol" SG_ 1847 VIS_TSR_roadMarking_9_Cross_0000 "VIS_TSR_roadMarking_9_Crossings_Type";
BA_ "SystemSignalLongSymbol" SG_ 1847 VIS_TSR_roadMarking_9_Cross_0001 "VIS_TSR_roadMarking_9_Crossings_conf";
BA_ "SystemSignalLongSymbol" SG_ 1847 VIS_TSR_roadMarking_9_Cross_0002 "VIS_TSR_roadMarking_9_Crossings_LatPosition";
BA_ "SystemSignalLongSymbol" SG_ 1847 VIS_TSR_roadMarking_9_Cross_0003 "VIS_TSR_roadMarking_9_Crossings_LongPosition";
BA_ "SystemSignalLongSymbol" SG_ 1860 VIS_AHBC_REF_SGN_0_GlareLevelCur "VIS_AHBC_REF_SGN_0_GlareLevelCurrent";
BA_ "SystemSignalLongSymbol" SG_ 1860 VIS_AHBC_REF_SGN_1_GlareLevelCur "VIS_AHBC_REF_SGN_1_GlareLevelCurrent";
BA_ "SystemSignalLongSymbol" SG_ 1860 VIS_AHBC_REF_SGN_2_GlareLevelCur "VIS_AHBC_REF_SGN_2_GlareLevelCurrent";
BA_ "SystemSignalLongSymbol" SG_ 1860 VIS_AHBC_REF_SGN_3_GlareLevelCur "VIS_AHBC_REF_SGN_3_GlareLevelCurrent";
BA_ "SystemSignalLongSymbol" SG_ 1860 VIS_AHBC_REF_SGN_4_GlareLevelCur "VIS_AHBC_REF_SGN_4_GlareLevelCurrent";
BA_ "SystemSignalLongSymbol" SG_ 1860 VIS_AHBC_REF_SGN_5_GlareLevelCur "VIS_AHBC_REF_SGN_5_GlareLevelCurrent";
BA_ "SystemSignalLongSymbol" SG_ 1861 VIS_AHBC_REF_SGN_6_GlareLevelCur "VIS_AHBC_REF_SGN_6_GlareLevelCurrent";
BA_ "SystemSignalLongSymbol" SG_ 1861 VIS_AHBC_REF_SGN_7_GlareLevelCur "VIS_AHBC_REF_SGN_7_GlareLevelCurrent";
BA_ "SystemSignalLongSymbol" SG_ 1861 VIS_AHBC_REF_SGN_8_GlareLevelCur "VIS_AHBC_REF_SGN_8_GlareLevelCurrent";
BA_ "SystemSignalLongSymbol" SG_ 1861 VIS_AHBC_REF_SGN_9_GlareLevelCur "VIS_AHBC_REF_SGN_9_GlareLevelCurrent";
BA_ "SystemSignalLongSymbol" SG_ 1861 VIS_AHBC_REF_SGN_10_GlareLevelMa "VIS_AHBC_REF_SGN_10_GlareLevelMax";
BA_ "SystemSignalLongSymbol" SG_ 1861 VIS_AHBC_REF_SGN_10_GlareLevelCu "VIS_AHBC_REF_SGN_10_GlareLevelCurrent";
BA_ "SystemSignalLongSymbol" SG_ 1861 VIS_AHBC_REF_SGN_11_GlareLevelMa "VIS_AHBC_REF_SGN_11_GlareLevelMax";
BA_ "SystemSignalLongSymbol" SG_ 1861 VIS_AHBC_REF_SGN_11_GlareLevelCu "VIS_AHBC_REF_SGN_11_GlareLevelCurrent";
VAL_ 1840 VIS_TSR_SIGN_0_Type 0 "E_EYEQ_TSR_e_std_10    " 1 "E_EYEQ_TSR_e_std_20    " 2 "E_EYEQ_TSR_e_std_30    " 3 "E_EYEQ_TSR_e_std_40    " 4 "E_EYEQ_TSR_e_std_50    " 5 "E_EYEQ_TSR_e_std_60    " 6 "E_EYEQ_TSR_e_std_70    " 7 "E_EYEQ_TSR_e_std_80    " 8 "E_EYEQ_TSR_e_std_90    " 9 "E_EYEQ_TSR_e_std_100    " 10 "E_EYEQ_TSR_e_std_110    " 11 "E_EYEQ_TSR_e_std_120    " 12 "E_EYEQ_TSR_e_std_130    " 13 "E_EYEQ_TSR_e_std_140    " 23 "E_EYEQ_TSR_e_car_limit    " 24 "E_EYEQ_TSR_e_carUpMotorDownDiagonal    " 25 "E_EYEQ_TSR_e_minimum_SL    " 27 "E_EYEQ_TSR_e_leftOrStraight    " 28 "E_EYEQ_TSR_e_lgt_10    " 29 "E_EYEQ_TSR_e_lgt_20    " 30 "E_EYEQ_TSR_e_lgt_30    " 31 "E_EYEQ_TSR_e_lgt_40    " 32 "E_EYEQ_TSR_e_lgt_50    " 33 "E_EYEQ_TSR_e_lgt_60    " 34 "E_EYEQ_TSR_e_lgt_70    " 35 "E_EYEQ_TSR_e_lgt_80    " 36 "E_EYEQ_TSR_e_lgt_90    " 37 "E_EYEQ_TSR_e_lgt_100    " 38 "E_EYEQ_TSR_e_lgt_110    " 39 "E_EYEQ_TSR_e_lgt_120    " 40 "E_EYEQ_TSR_e_lgt_130    " 41 "E_EYEQ_TSR_e_lgt_140" ;
VAL_ 1840 VIS_TSR_SIGN_0_SupplementalType1 0 "E_EYEQ_TSR_e_none    " 1 "E_EYEQ_TSR_e_rain    " 2 "E_EYEQ_TSR_e_snow    " 3 "E_EYEQ_TSR_e_trailer    " 4 "E_EYEQ_TSR_e_time    " 5 "E_EYEQ_TSR_e_Arrow_left    " 6 "E_EYEQ_TSR_e_Arrow_right    " 7 "E_EYEQ_TSR_e_BendArrow_left    " 8 "E_EYEQ_TSR_e_BendArrow_right    " 9 "E_EYEQ_TSR_e_truck    " 10 "E_EYEQ_TSR_e_distance_arrow    " 11 "E_EYEQ_TSR_e_weight    " 12 "E_EYEQ_TSR_e_distance_in    " 13 "E_EYEQ_TSR_e_tractor    " 14 "E_EYEQ_TSR_e_snow_rain    " 15 "E_EYEQ_TSR_e_school    " 16 "E_EYEQ_TSR_e_rain_cloud    " 17 "E_EYEQ_TSR_e_fog" 18 "E_EYEQ_TSR_e_hazardous_materials    " 19 "E_EYEQ_TSR_e_night    " 20 "E_EYEQ_TSR_e_supp_sign_generic    " 21 "E_EYEQ_TSR_e_rappel    " 22 "E_EYEQ_TSR_e_zone    " 23 "E_EYEQ_TSR_e_ramp    " 24 "E_EYEQ_TSR_e_end    " 25 "E_EYEQ_TSR_e_exit    " 26 "E_EYEQ_TSR_e_advisory    " 27 "E_EYEQ_TSR_e_minimum    " 28 "E_EYEQ_TSR_e_reduced_ahead    " 29 "E_EYEQ_TSR_e_distance_stop    " 30 "E_EYEQ_TSR_e_par_verglas    " 31 "E_EYEQ_TSR_e_ahead    " 32 "E_EYEQ_TSR_e_area    " 33 "E_EYEQ_TSR_e_road_work_au    " 34 "E_EYEQ_TSR_e_arrow_bidirectional    " 35 "E_EYEQ_TSR_e_work_zone    " 36 "E_EYEQ_TSR_e_distance_in_for    " 37 "E_EYEQ_TSR_e_zone_end    " 38 "E_EYEQ_TSR_e_supp_end_school_zone    " 39 "E_EYEQ_TSR_e_supp_camera    " 40 "E_EYEQ_TSR_e_larmschutz    " 41 "E_EYEQ_TSR_e_car    " 42 "E_EYEQ_TSR_e_shared_zone    " 43 "E_EYEQ_TSR_e_supp_bump    " 44 "E_EYEQ_TSR_e_snow_rain_dis_arrow    " 45 "E_EYEQ_TSR_e_snow_truck    " 46 "E_EYEQ_TSR_e_motorcycle    " 47 "E_EYEQ_TSR_e_time_school    " 48 "E_EYEQ_TSR_e_truck_bus    " 49 "E_EYEQ_TSR_e_num_of_supp_signs_types    " 255 "E_EYEQ_TSR_e_invalid_supp" ;
VAL_ 1840 VIS_TSR_SIGN_0_SupplementalType2 0 "E_EYEQ_TSR_e_none    " 1 "E_EYEQ_TSR_e_rain    " 2 "E_EYEQ_TSR_e_snow    " 3 "E_EYEQ_TSR_e_trailer    " 4 "E_EYEQ_TSR_e_time    " 5 "E_EYEQ_TSR_e_Arrow_left    " 6 "E_EYEQ_TSR_e_Arrow_right    " 7 "E_EYEQ_TSR_e_BendArrow_left    " 8 "E_EYEQ_TSR_e_BendArrow_right    " 9 "E_EYEQ_TSR_e_truck    " 10 "E_EYEQ_TSR_e_distance_arrow    " 11 "E_EYEQ_TSR_e_weight    " 12 "E_EYEQ_TSR_e_distance_in    " 13 "E_EYEQ_TSR_e_tractor    " 14 "E_EYEQ_TSR_e_snow_rain    " 15 "E_EYEQ_TSR_e_school    " 16 "E_EYEQ_TSR_e_rain_cloud    " 17 "E_EYEQ_TSR_e_fog" 18 "E_EYEQ_TSR_e_hazardous_materials    " 19 "E_EYEQ_TSR_e_night    " 20 "E_EYEQ_TSR_e_supp_sign_generic    " 21 "E_EYEQ_TSR_e_rappel    " 22 "E_EYEQ_TSR_e_zone    " 23 "E_EYEQ_TSR_e_ramp    " 24 "E_EYEQ_TSR_e_end    " 25 "E_EYEQ_TSR_e_exit    " 26 "E_EYEQ_TSR_e_advisory    " 27 "E_EYEQ_TSR_e_minimum    " 28 "E_EYEQ_TSR_e_reduced_ahead    " 29 "E_EYEQ_TSR_e_distance_stop    " 30 "E_EYEQ_TSR_e_par_verglas    " 31 "E_EYEQ_TSR_e_ahead    " 32 "E_EYEQ_TSR_e_area    " 33 "E_EYEQ_TSR_e_road_work_au    " 34 "E_EYEQ_TSR_e_arrow_bidirectional    " 35 "E_EYEQ_TSR_e_work_zone    " 36 "E_EYEQ_TSR_e_distance_in_for    " 37 "E_EYEQ_TSR_e_zone_end    " 38 "E_EYEQ_TSR_e_supp_end_school_zone    " 39 "E_EYEQ_TSR_e_supp_camera    " 40 "E_EYEQ_TSR_e_larmschutz    " 41 "E_EYEQ_TSR_e_car    " 42 "E_EYEQ_TSR_e_shared_zone    " 43 "E_EYEQ_TSR_e_supp_bump    " 44 "E_EYEQ_TSR_e_snow_rain_dis_arrow    " 45 "E_EYEQ_TSR_e_snow_truck    " 46 "E_EYEQ_TSR_e_motorcycle    " 47 "E_EYEQ_TSR_e_time_school    " 48 "E_EYEQ_TSR_e_truck_bus    " 49 "E_EYEQ_TSR_e_num_of_supp_signs_types    " 255 "E_EYEQ_TSR_e_invalid_supp" ;
VAL_ 1840 VIS_TSR_SIGN_0_RelevantDecision 0 "RELEVANT_SIGN" 1 "HIGHWAY_EXIT_SIGN" 2 "LANE_ASSIGNMENT_SIGN" 3 "PARRALEL_ROAD_SIGN" 4 "SIGN_ON_TURN" 5 "FAR_IRRELEVANT_SIGN" 6 "INTERNAL_SIGN_CONTRADICTION" 7 "ERROR_SIGN_CODE" 8 "�CIPV_IN_FRONT" 9 "�CONTRADICT_ARROW_SIGN" 10 "OTHER_FILTER_REASON" ;
VAL_ 1840 VIS_TSR_SIGN_1_Type 0 "E_EYEQ_TSR_e_std_10    " 1 "E_EYEQ_TSR_e_std_20    " 2 "E_EYEQ_TSR_e_std_30    " 3 "E_EYEQ_TSR_e_std_40    " 4 "E_EYEQ_TSR_e_std_50    " 5 "E_EYEQ_TSR_e_std_60    " 6 "E_EYEQ_TSR_e_std_70    " 7 "E_EYEQ_TSR_e_std_80    " 8 "E_EYEQ_TSR_e_std_90    " 9 "E_EYEQ_TSR_e_std_100    " 10 "E_EYEQ_TSR_e_std_110    " 11 "E_EYEQ_TSR_e_std_120    " 12 "E_EYEQ_TSR_e_std_130    " 13 "E_EYEQ_TSR_e_std_140    " 23 "E_EYEQ_TSR_e_car_limit    " 24 "E_EYEQ_TSR_e_carUpMotorDownDiagonal    " 25 "E_EYEQ_TSR_e_minimum_SL    " 27 "E_EYEQ_TSR_e_leftOrStraight    " 28 "E_EYEQ_TSR_e_lgt_10    " 29 "E_EYEQ_TSR_e_lgt_20    " 30 "E_EYEQ_TSR_e_lgt_30    " 31 "E_EYEQ_TSR_e_lgt_40    " 32 "E_EYEQ_TSR_e_lgt_50    " 33 "E_EYEQ_TSR_e_lgt_60    " 34 "E_EYEQ_TSR_e_lgt_70    " 35 "E_EYEQ_TSR_e_lgt_80    " 36 "E_EYEQ_TSR_e_lgt_90    " 37 "E_EYEQ_TSR_e_lgt_100    " 38 "E_EYEQ_TSR_e_lgt_110    " 39 "E_EYEQ_TSR_e_lgt_120    " 40 "E_EYEQ_TSR_e_lgt_130    " 41 "E_EYEQ_TSR_e_lgt_140" ;
VAL_ 1840 VIS_TSR_SIGN_1_SupplementalType1 0 "E_EYEQ_TSR_e_none    " 1 "E_EYEQ_TSR_e_rain    " 2 "E_EYEQ_TSR_e_snow    " 3 "E_EYEQ_TSR_e_trailer    " 4 "E_EYEQ_TSR_e_time    " 5 "E_EYEQ_TSR_e_Arrow_left    " 6 "E_EYEQ_TSR_e_Arrow_right    " 7 "E_EYEQ_TSR_e_BendArrow_left    " 8 "E_EYEQ_TSR_e_BendArrow_right    " 9 "E_EYEQ_TSR_e_truck    " 10 "E_EYEQ_TSR_e_distance_arrow    " 11 "E_EYEQ_TSR_e_weight    " 12 "E_EYEQ_TSR_e_distance_in    " 13 "E_EYEQ_TSR_e_tractor    " 14 "E_EYEQ_TSR_e_snow_rain    " 15 "E_EYEQ_TSR_e_school    " 16 "E_EYEQ_TSR_e_rain_cloud    " 17 "E_EYEQ_TSR_e_fog" 18 "E_EYEQ_TSR_e_hazardous_materials    " 19 "E_EYEQ_TSR_e_night    " 20 "E_EYEQ_TSR_e_supp_sign_generic    " 21 "E_EYEQ_TSR_e_rappel    " 22 "E_EYEQ_TSR_e_zone    " 23 "E_EYEQ_TSR_e_ramp    " 24 "E_EYEQ_TSR_e_end    " 25 "E_EYEQ_TSR_e_exit    " 26 "E_EYEQ_TSR_e_advisory    " 27 "E_EYEQ_TSR_e_minimum    " 28 "E_EYEQ_TSR_e_reduced_ahead    " 29 "E_EYEQ_TSR_e_distance_stop    " 30 "E_EYEQ_TSR_e_par_verglas    " 31 "E_EYEQ_TSR_e_ahead    " 32 "E_EYEQ_TSR_e_area    " 33 "E_EYEQ_TSR_e_road_work_au    " 34 "E_EYEQ_TSR_e_arrow_bidirectional    " 35 "E_EYEQ_TSR_e_work_zone    " 36 "E_EYEQ_TSR_e_distance_in_for    " 37 "E_EYEQ_TSR_e_zone_end    " 38 "E_EYEQ_TSR_e_supp_end_school_zone    " 39 "E_EYEQ_TSR_e_supp_camera    " 40 "E_EYEQ_TSR_e_larmschutz    " 41 "E_EYEQ_TSR_e_car    " 42 "E_EYEQ_TSR_e_shared_zone    " 43 "E_EYEQ_TSR_e_supp_bump    " 44 "E_EYEQ_TSR_e_snow_rain_dis_arrow    " 45 "E_EYEQ_TSR_e_snow_truck    " 46 "E_EYEQ_TSR_e_motorcycle    " 47 "E_EYEQ_TSR_e_time_school    " 48 "E_EYEQ_TSR_e_truck_bus    " 49 "E_EYEQ_TSR_e_num_of_supp_signs_types    " 255 "E_EYEQ_TSR_e_invalid_supp" ;
VAL_ 1840 VIS_TSR_SIGN_1_SupplementalType2 0 "E_EYEQ_TSR_e_none    " 1 "E_EYEQ_TSR_e_rain    " 2 "E_EYEQ_TSR_e_snow    " 3 "E_EYEQ_TSR_e_trailer    " 4 "E_EYEQ_TSR_e_time    " 5 "E_EYEQ_TSR_e_Arrow_left    " 6 "E_EYEQ_TSR_e_Arrow_right    " 7 "E_EYEQ_TSR_e_BendArrow_left    " 8 "E_EYEQ_TSR_e_BendArrow_right    " 9 "E_EYEQ_TSR_e_truck    " 10 "E_EYEQ_TSR_e_distance_arrow    " 11 "E_EYEQ_TSR_e_weight    " 12 "E_EYEQ_TSR_e_distance_in    " 13 "E_EYEQ_TSR_e_tractor    " 14 "E_EYEQ_TSR_e_snow_rain    " 15 "E_EYEQ_TSR_e_school    " 16 "E_EYEQ_TSR_e_rain_cloud    " 17 "E_EYEQ_TSR_e_fog" 18 "E_EYEQ_TSR_e_hazardous_materials    " 19 "E_EYEQ_TSR_e_night    " 20 "E_EYEQ_TSR_e_supp_sign_generic    " 21 "E_EYEQ_TSR_e_rappel    " 22 "E_EYEQ_TSR_e_zone    " 23 "E_EYEQ_TSR_e_ramp    " 24 "E_EYEQ_TSR_e_end    " 25 "E_EYEQ_TSR_e_exit    " 26 "E_EYEQ_TSR_e_advisory    " 27 "E_EYEQ_TSR_e_minimum    " 28 "E_EYEQ_TSR_e_reduced_ahead    " 29 "E_EYEQ_TSR_e_distance_stop    " 30 "E_EYEQ_TSR_e_par_verglas    " 31 "E_EYEQ_TSR_e_ahead    " 32 "E_EYEQ_TSR_e_area    " 33 "E_EYEQ_TSR_e_road_work_au    " 34 "E_EYEQ_TSR_e_arrow_bidirectional    " 35 "E_EYEQ_TSR_e_work_zone    " 36 "E_EYEQ_TSR_e_distance_in_for    " 37 "E_EYEQ_TSR_e_zone_end    " 38 "E_EYEQ_TSR_e_supp_end_school_zone    " 39 "E_EYEQ_TSR_e_supp_camera    " 40 "E_EYEQ_TSR_e_larmschutz    " 41 "E_EYEQ_TSR_e_car    " 42 "E_EYEQ_TSR_e_shared_zone    " 43 "E_EYEQ_TSR_e_supp_bump    " 44 "E_EYEQ_TSR_e_snow_rain_dis_arrow    " 45 "E_EYEQ_TSR_e_snow_truck    " 46 "E_EYEQ_TSR_e_motorcycle    " 47 "E_EYEQ_TSR_e_time_school    " 48 "E_EYEQ_TSR_e_truck_bus    " 49 "E_EYEQ_TSR_e_num_of_supp_signs_types    " 255 "E_EYEQ_TSR_e_invalid_supp" ;
VAL_ 1840 VIS_TSR_SIGN_1_RelevantDecision 0 "RELEVANT_SIGN" 1 "HIGHWAY_EXIT_SIGN" 2 "LANE_ASSIGNMENT_SIGN" 3 "PARRALEL_ROAD_SIGN" 4 "SIGN_ON_TURN" 5 "FAR_IRRELEVANT_SIGN" 6 "INTERNAL_SIGN_CONTRADICTION" 7 "ERROR_SIGN_CODE" 8 "�CIPV_IN_FRONT" 9 "�CONTRADICT_ARROW_SIGN" 10 "OTHER_FILTER_REASON" ;
VAL_ 1840 VIS_TSR_SIGN_2_Type 0 "E_EYEQ_TSR_e_std_10    " 1 "E_EYEQ_TSR_e_std_20    " 2 "E_EYEQ_TSR_e_std_30    " 3 "E_EYEQ_TSR_e_std_40    " 4 "E_EYEQ_TSR_e_std_50    " 5 "E_EYEQ_TSR_e_std_60    " 6 "E_EYEQ_TSR_e_std_70    " 7 "E_EYEQ_TSR_e_std_80    " 8 "E_EYEQ_TSR_e_std_90    " 9 "E_EYEQ_TSR_e_std_100    " 10 "E_EYEQ_TSR_e_std_110    " 11 "E_EYEQ_TSR_e_std_120    " 12 "E_EYEQ_TSR_e_std_130    " 13 "E_EYEQ_TSR_e_std_140    " 23 "E_EYEQ_TSR_e_car_limit    " 24 "E_EYEQ_TSR_e_carUpMotorDownDiagonal    " 25 "E_EYEQ_TSR_e_minimum_SL    " 27 "E_EYEQ_TSR_e_leftOrStraight    " 28 "E_EYEQ_TSR_e_lgt_10    " 29 "E_EYEQ_TSR_e_lgt_20    " 30 "E_EYEQ_TSR_e_lgt_30    " 31 "E_EYEQ_TSR_e_lgt_40    " 32 "E_EYEQ_TSR_e_lgt_50    " 33 "E_EYEQ_TSR_e_lgt_60    " 34 "E_EYEQ_TSR_e_lgt_70    " 35 "E_EYEQ_TSR_e_lgt_80    " 36 "E_EYEQ_TSR_e_lgt_90    " 37 "E_EYEQ_TSR_e_lgt_100    " 38 "E_EYEQ_TSR_e_lgt_110    " 39 "E_EYEQ_TSR_e_lgt_120    " 40 "E_EYEQ_TSR_e_lgt_130    " 41 "E_EYEQ_TSR_e_lgt_140" ;
VAL_ 1840 VIS_TSR_SIGN_2_SupplementalType1 0 "E_EYEQ_TSR_e_none    " 1 "E_EYEQ_TSR_e_rain    " 2 "E_EYEQ_TSR_e_snow    " 3 "E_EYEQ_TSR_e_trailer    " 4 "E_EYEQ_TSR_e_time    " 5 "E_EYEQ_TSR_e_Arrow_left    " 6 "E_EYEQ_TSR_e_Arrow_right    " 7 "E_EYEQ_TSR_e_BendArrow_left    " 8 "E_EYEQ_TSR_e_BendArrow_right    " 9 "E_EYEQ_TSR_e_truck    " 10 "E_EYEQ_TSR_e_distance_arrow    " 11 "E_EYEQ_TSR_e_weight    " 12 "E_EYEQ_TSR_e_distance_in    " 13 "E_EYEQ_TSR_e_tractor    " 14 "E_EYEQ_TSR_e_snow_rain    " 15 "E_EYEQ_TSR_e_school    " 16 "E_EYEQ_TSR_e_rain_cloud    " 17 "E_EYEQ_TSR_e_fog" 18 "E_EYEQ_TSR_e_hazardous_materials    " 19 "E_EYEQ_TSR_e_night    " 20 "E_EYEQ_TSR_e_supp_sign_generic    " 21 "E_EYEQ_TSR_e_rappel    " 22 "E_EYEQ_TSR_e_zone    " 23 "E_EYEQ_TSR_e_ramp    " 24 "E_EYEQ_TSR_e_end    " 25 "E_EYEQ_TSR_e_exit    " 26 "E_EYEQ_TSR_e_advisory    " 27 "E_EYEQ_TSR_e_minimum    " 28 "E_EYEQ_TSR_e_reduced_ahead    " 29 "E_EYEQ_TSR_e_distance_stop    " 30 "E_EYEQ_TSR_e_par_verglas    " 31 "E_EYEQ_TSR_e_ahead    " 32 "E_EYEQ_TSR_e_area    " 33 "E_EYEQ_TSR_e_road_work_au    " 34 "E_EYEQ_TSR_e_arrow_bidirectional    " 35 "E_EYEQ_TSR_e_work_zone    " 36 "E_EYEQ_TSR_e_distance_in_for    " 37 "E_EYEQ_TSR_e_zone_end    " 38 "E_EYEQ_TSR_e_supp_end_school_zone    " 39 "E_EYEQ_TSR_e_supp_camera    " 40 "E_EYEQ_TSR_e_larmschutz    " 41 "E_EYEQ_TSR_e_car    " 42 "E_EYEQ_TSR_e_shared_zone    " 43 "E_EYEQ_TSR_e_supp_bump    " 44 "E_EYEQ_TSR_e_snow_rain_dis_arrow    " 45 "E_EYEQ_TSR_e_snow_truck    " 46 "E_EYEQ_TSR_e_motorcycle    " 47 "E_EYEQ_TSR_e_time_school    " 48 "E_EYEQ_TSR_e_truck_bus    " 49 "E_EYEQ_TSR_e_num_of_supp_signs_types    " 255 "E_EYEQ_TSR_e_invalid_supp" ;
VAL_ 1840 VIS_TSR_SIGN_2_SupplementalType2 0 "E_EYEQ_TSR_e_none    " 1 "E_EYEQ_TSR_e_rain    " 2 "E_EYEQ_TSR_e_snow    " 3 "E_EYEQ_TSR_e_trailer    " 4 "E_EYEQ_TSR_e_time    " 5 "E_EYEQ_TSR_e_Arrow_left    " 6 "E_EYEQ_TSR_e_Arrow_right    " 7 "E_EYEQ_TSR_e_BendArrow_left    " 8 "E_EYEQ_TSR_e_BendArrow_right    " 9 "E_EYEQ_TSR_e_truck    " 10 "E_EYEQ_TSR_e_distance_arrow    " 11 "E_EYEQ_TSR_e_weight    " 12 "E_EYEQ_TSR_e_distance_in    " 13 "E_EYEQ_TSR_e_tractor    " 14 "E_EYEQ_TSR_e_snow_rain    " 15 "E_EYEQ_TSR_e_school    " 16 "E_EYEQ_TSR_e_rain_cloud    " 17 "E_EYEQ_TSR_e_fog" 18 "E_EYEQ_TSR_e_hazardous_materials    " 19 "E_EYEQ_TSR_e_night    " 20 "E_EYEQ_TSR_e_supp_sign_generic    " 21 "E_EYEQ_TSR_e_rappel    " 22 "E_EYEQ_TSR_e_zone    " 23 "E_EYEQ_TSR_e_ramp    " 24 "E_EYEQ_TSR_e_end    " 25 "E_EYEQ_TSR_e_exit    " 26 "E_EYEQ_TSR_e_advisory    " 27 "E_EYEQ_TSR_e_minimum    " 28 "E_EYEQ_TSR_e_reduced_ahead    " 29 "E_EYEQ_TSR_e_distance_stop    " 30 "E_EYEQ_TSR_e_par_verglas    " 31 "E_EYEQ_TSR_e_ahead    " 32 "E_EYEQ_TSR_e_area    " 33 "E_EYEQ_TSR_e_road_work_au    " 34 "E_EYEQ_TSR_e_arrow_bidirectional    " 35 "E_EYEQ_TSR_e_work_zone    " 36 "E_EYEQ_TSR_e_distance_in_for    " 37 "E_EYEQ_TSR_e_zone_end    " 38 "E_EYEQ_TSR_e_supp_end_school_zone    " 39 "E_EYEQ_TSR_e_supp_camera    " 40 "E_EYEQ_TSR_e_larmschutz    " 41 "E_EYEQ_TSR_e_car    " 42 "E_EYEQ_TSR_e_shared_zone    " 43 "E_EYEQ_TSR_e_supp_bump    " 44 "E_EYEQ_TSR_e_snow_rain_dis_arrow    " 45 "E_EYEQ_TSR_e_snow_truck    " 46 "E_EYEQ_TSR_e_motorcycle    " 47 "E_EYEQ_TSR_e_time_school    " 48 "E_EYEQ_TSR_e_truck_bus    " 49 "E_EYEQ_TSR_e_num_of_supp_signs_types    " 255 "E_EYEQ_TSR_e_invalid_supp" ;
VAL_ 1840 VIS_TSR_SIGN_2_RelevantDecision 0 "RELEVANT_SIGN" 1 "HIGHWAY_EXIT_SIGN" 2 "LANE_ASSIGNMENT_SIGN" 3 "PARRALEL_ROAD_SIGN" 4 "SIGN_ON_TURN" 5 "FAR_IRRELEVANT_SIGN" 6 "INTERNAL_SIGN_CONTRADICTION" 7 "ERROR_SIGN_CODE" 8 "�CIPV_IN_FRONT" 9 "�CONTRADICT_ARROW_SIGN" 10 "OTHER_FILTER_REASON" ;
VAL_ 1840 VIS_TSR_SIGN_3_Type 0 "E_EYEQ_TSR_e_std_10    " 1 "E_EYEQ_TSR_e_std_20    " 2 "E_EYEQ_TSR_e_std_30    " 3 "E_EYEQ_TSR_e_std_40    " 4 "E_EYEQ_TSR_e_std_50    " 5 "E_EYEQ_TSR_e_std_60    " 6 "E_EYEQ_TSR_e_std_70    " 7 "E_EYEQ_TSR_e_std_80    " 8 "E_EYEQ_TSR_e_std_90    " 9 "E_EYEQ_TSR_e_std_100    " 10 "E_EYEQ_TSR_e_std_110    " 11 "E_EYEQ_TSR_e_std_120    " 12 "E_EYEQ_TSR_e_std_130    " 13 "E_EYEQ_TSR_e_std_140    " 23 "E_EYEQ_TSR_e_car_limit    " 24 "E_EYEQ_TSR_e_carUpMotorDownDiagonal    " 25 "E_EYEQ_TSR_e_minimum_SL    " 27 "E_EYEQ_TSR_e_leftOrStraight    " 28 "E_EYEQ_TSR_e_lgt_10    " 29 "E_EYEQ_TSR_e_lgt_20    " 30 "E_EYEQ_TSR_e_lgt_30    " 31 "E_EYEQ_TSR_e_lgt_40    " 32 "E_EYEQ_TSR_e_lgt_50    " 33 "E_EYEQ_TSR_e_lgt_60    " 34 "E_EYEQ_TSR_e_lgt_70    " 35 "E_EYEQ_TSR_e_lgt_80    " 36 "E_EYEQ_TSR_e_lgt_90    " 37 "E_EYEQ_TSR_e_lgt_100    " 38 "E_EYEQ_TSR_e_lgt_110    " 39 "E_EYEQ_TSR_e_lgt_120    " 40 "E_EYEQ_TSR_e_lgt_130    " 41 "E_EYEQ_TSR_e_lgt_140" ;
VAL_ 1840 VIS_TSR_SIGN_3_SupplementalType1 0 "E_EYEQ_TSR_e_none    " 1 "E_EYEQ_TSR_e_rain    " 2 "E_EYEQ_TSR_e_snow    " 3 "E_EYEQ_TSR_e_trailer    " 4 "E_EYEQ_TSR_e_time    " 5 "E_EYEQ_TSR_e_Arrow_left    " 6 "E_EYEQ_TSR_e_Arrow_right    " 7 "E_EYEQ_TSR_e_BendArrow_left    " 8 "E_EYEQ_TSR_e_BendArrow_right    " 9 "E_EYEQ_TSR_e_truck    " 10 "E_EYEQ_TSR_e_distance_arrow    " 11 "E_EYEQ_TSR_e_weight    " 12 "E_EYEQ_TSR_e_distance_in    " 13 "E_EYEQ_TSR_e_tractor    " 14 "E_EYEQ_TSR_e_snow_rain    " 15 "E_EYEQ_TSR_e_school    " 16 "E_EYEQ_TSR_e_rain_cloud    " 17 "E_EYEQ_TSR_e_fog" 18 "E_EYEQ_TSR_e_hazardous_materials    " 19 "E_EYEQ_TSR_e_night    " 20 "E_EYEQ_TSR_e_supp_sign_generic    " 21 "E_EYEQ_TSR_e_rappel    " 22 "E_EYEQ_TSR_e_zone    " 23 "E_EYEQ_TSR_e_ramp    " 24 "E_EYEQ_TSR_e_end    " 25 "E_EYEQ_TSR_e_exit    " 26 "E_EYEQ_TSR_e_advisory    " 27 "E_EYEQ_TSR_e_minimum    " 28 "E_EYEQ_TSR_e_reduced_ahead    " 29 "E_EYEQ_TSR_e_distance_stop    " 30 "E_EYEQ_TSR_e_par_verglas    " 31 "E_EYEQ_TSR_e_ahead    " 32 "E_EYEQ_TSR_e_area    " 33 "E_EYEQ_TSR_e_road_work_au    " 34 "E_EYEQ_TSR_e_arrow_bidirectional    " 35 "E_EYEQ_TSR_e_work_zone    " 36 "E_EYEQ_TSR_e_distance_in_for    " 37 "E_EYEQ_TSR_e_zone_end    " 38 "E_EYEQ_TSR_e_supp_end_school_zone    " 39 "E_EYEQ_TSR_e_supp_camera    " 40 "E_EYEQ_TSR_e_larmschutz    " 41 "E_EYEQ_TSR_e_car    " 42 "E_EYEQ_TSR_e_shared_zone    " 43 "E_EYEQ_TSR_e_supp_bump    " 44 "E_EYEQ_TSR_e_snow_rain_dis_arrow    " 45 "E_EYEQ_TSR_e_snow_truck    " 46 "E_EYEQ_TSR_e_motorcycle    " 47 "E_EYEQ_TSR_e_time_school    " 48 "E_EYEQ_TSR_e_truck_bus    " 49 "E_EYEQ_TSR_e_num_of_supp_signs_types    " 255 "E_EYEQ_TSR_e_invalid_supp" ;
VAL_ 1840 VIS_TSR_SIGN_3_SupplementalType2 0 "E_EYEQ_TSR_e_none    " 1 "E_EYEQ_TSR_e_rain    " 2 "E_EYEQ_TSR_e_snow    " 3 "E_EYEQ_TSR_e_trailer    " 4 "E_EYEQ_TSR_e_time    " 5 "E_EYEQ_TSR_e_Arrow_left    " 6 "E_EYEQ_TSR_e_Arrow_right    " 7 "E_EYEQ_TSR_e_BendArrow_left    " 8 "E_EYEQ_TSR_e_BendArrow_right    " 9 "E_EYEQ_TSR_e_truck    " 10 "E_EYEQ_TSR_e_distance_arrow    " 11 "E_EYEQ_TSR_e_weight    " 12 "E_EYEQ_TSR_e_distance_in    " 13 "E_EYEQ_TSR_e_tractor    " 14 "E_EYEQ_TSR_e_snow_rain    " 15 "E_EYEQ_TSR_e_school    " 16 "E_EYEQ_TSR_e_rain_cloud    " 17 "E_EYEQ_TSR_e_fog" 18 "E_EYEQ_TSR_e_hazardous_materials    " 19 "E_EYEQ_TSR_e_night    " 20 "E_EYEQ_TSR_e_supp_sign_generic    " 21 "E_EYEQ_TSR_e_rappel    " 22 "E_EYEQ_TSR_e_zone    " 23 "E_EYEQ_TSR_e_ramp    " 24 "E_EYEQ_TSR_e_end    " 25 "E_EYEQ_TSR_e_exit    " 26 "E_EYEQ_TSR_e_advisory    " 27 "E_EYEQ_TSR_e_minimum    " 28 "E_EYEQ_TSR_e_reduced_ahead    " 29 "E_EYEQ_TSR_e_distance_stop    " 30 "E_EYEQ_TSR_e_par_verglas    " 31 "E_EYEQ_TSR_e_ahead    " 32 "E_EYEQ_TSR_e_area    " 33 "E_EYEQ_TSR_e_road_work_au    " 34 "E_EYEQ_TSR_e_arrow_bidirectional    " 35 "E_EYEQ_TSR_e_work_zone    " 36 "E_EYEQ_TSR_e_distance_in_for    " 37 "E_EYEQ_TSR_e_zone_end    " 38 "E_EYEQ_TSR_e_supp_end_school_zone    " 39 "E_EYEQ_TSR_e_supp_camera    " 40 "E_EYEQ_TSR_e_larmschutz    " 41 "E_EYEQ_TSR_e_car    " 42 "E_EYEQ_TSR_e_shared_zone    " 43 "E_EYEQ_TSR_e_supp_bump    " 44 "E_EYEQ_TSR_e_snow_rain_dis_arrow    " 45 "E_EYEQ_TSR_e_snow_truck    " 46 "E_EYEQ_TSR_e_motorcycle    " 47 "E_EYEQ_TSR_e_time_school    " 48 "E_EYEQ_TSR_e_truck_bus    " 49 "E_EYEQ_TSR_e_num_of_supp_signs_types    " 255 "E_EYEQ_TSR_e_invalid_supp" ;
VAL_ 1840 VIS_TSR_SIGN_3_RelevantDecision 0 "RELEVANT_SIGN" 1 "HIGHWAY_EXIT_SIGN" 2 "LANE_ASSIGNMENT_SIGN" 3 "PARRALEL_ROAD_SIGN" 4 "SIGN_ON_TURN" 5 "FAR_IRRELEVANT_SIGN" 6 "INTERNAL_SIGN_CONTRADICTION" 7 "ERROR_SIGN_CODE" 8 "�CIPV_IN_FRONT" 9 "�CONTRADICT_ARROW_SIGN" 10 "OTHER_FILTER_REASON" ;
VAL_ 1840 VIS_TSR_SIGN_4_Type 0 "E_EYEQ_TSR_e_std_10    " 1 "E_EYEQ_TSR_e_std_20    " 2 "E_EYEQ_TSR_e_std_30    " 3 "E_EYEQ_TSR_e_std_40    " 4 "E_EYEQ_TSR_e_std_50    " 5 "E_EYEQ_TSR_e_std_60    " 6 "E_EYEQ_TSR_e_std_70    " 7 "E_EYEQ_TSR_e_std_80    " 8 "E_EYEQ_TSR_e_std_90    " 9 "E_EYEQ_TSR_e_std_100    " 10 "E_EYEQ_TSR_e_std_110    " 11 "E_EYEQ_TSR_e_std_120    " 12 "E_EYEQ_TSR_e_std_130    " 13 "E_EYEQ_TSR_e_std_140    " 23 "E_EYEQ_TSR_e_car_limit    " 24 "E_EYEQ_TSR_e_carUpMotorDownDiagonal    " 25 "E_EYEQ_TSR_e_minimum_SL    " 27 "E_EYEQ_TSR_e_leftOrStraight    " 28 "E_EYEQ_TSR_e_lgt_10    " 29 "E_EYEQ_TSR_e_lgt_20    " 30 "E_EYEQ_TSR_e_lgt_30    " 31 "E_EYEQ_TSR_e_lgt_40    " 32 "E_EYEQ_TSR_e_lgt_50    " 33 "E_EYEQ_TSR_e_lgt_60    " 34 "E_EYEQ_TSR_e_lgt_70    " 35 "E_EYEQ_TSR_e_lgt_80    " 36 "E_EYEQ_TSR_e_lgt_90    " 37 "E_EYEQ_TSR_e_lgt_100    " 38 "E_EYEQ_TSR_e_lgt_110    " 39 "E_EYEQ_TSR_e_lgt_120    " 40 "E_EYEQ_TSR_e_lgt_130    " 41 "E_EYEQ_TSR_e_lgt_140" ;
VAL_ 1840 VIS_TSR_SIGN_4_SupplementalType1 0 "E_EYEQ_TSR_e_none    " 1 "E_EYEQ_TSR_e_rain    " 2 "E_EYEQ_TSR_e_snow    " 3 "E_EYEQ_TSR_e_trailer    " 4 "E_EYEQ_TSR_e_time    " 5 "E_EYEQ_TSR_e_Arrow_left    " 6 "E_EYEQ_TSR_e_Arrow_right    " 7 "E_EYEQ_TSR_e_BendArrow_left    " 8 "E_EYEQ_TSR_e_BendArrow_right    " 9 "E_EYEQ_TSR_e_truck    " 10 "E_EYEQ_TSR_e_distance_arrow    " 11 "E_EYEQ_TSR_e_weight    " 12 "E_EYEQ_TSR_e_distance_in    " 13 "E_EYEQ_TSR_e_tractor    " 14 "E_EYEQ_TSR_e_snow_rain    " 15 "E_EYEQ_TSR_e_school    " 16 "E_EYEQ_TSR_e_rain_cloud    " 17 "E_EYEQ_TSR_e_fog" 18 "E_EYEQ_TSR_e_hazardous_materials    " 19 "E_EYEQ_TSR_e_night    " 20 "E_EYEQ_TSR_e_supp_sign_generic    " 21 "E_EYEQ_TSR_e_rappel    " 22 "E_EYEQ_TSR_e_zone    " 23 "E_EYEQ_TSR_e_ramp    " 24 "E_EYEQ_TSR_e_end    " 25 "E_EYEQ_TSR_e_exit    " 26 "E_EYEQ_TSR_e_advisory    " 27 "E_EYEQ_TSR_e_minimum    " 28 "E_EYEQ_TSR_e_reduced_ahead    " 29 "E_EYEQ_TSR_e_distance_stop    " 30 "E_EYEQ_TSR_e_par_verglas    " 31 "E_EYEQ_TSR_e_ahead    " 32 "E_EYEQ_TSR_e_area    " 33 "E_EYEQ_TSR_e_road_work_au    " 34 "E_EYEQ_TSR_e_arrow_bidirectional    " 35 "E_EYEQ_TSR_e_work_zone    " 36 "E_EYEQ_TSR_e_distance_in_for    " 37 "E_EYEQ_TSR_e_zone_end    " 38 "E_EYEQ_TSR_e_supp_end_school_zone    " 39 "E_EYEQ_TSR_e_supp_camera    " 40 "E_EYEQ_TSR_e_larmschutz    " 41 "E_EYEQ_TSR_e_car    " 42 "E_EYEQ_TSR_e_shared_zone    " 43 "E_EYEQ_TSR_e_supp_bump    " 44 "E_EYEQ_TSR_e_snow_rain_dis_arrow    " 45 "E_EYEQ_TSR_e_snow_truck    " 46 "E_EYEQ_TSR_e_motorcycle    " 47 "E_EYEQ_TSR_e_time_school    " 48 "E_EYEQ_TSR_e_truck_bus    " 49 "E_EYEQ_TSR_e_num_of_supp_signs_types    " 255 "E_EYEQ_TSR_e_invalid_supp" ;
VAL_ 1840 VIS_TSR_SIGN_4_SupplementalType2 0 "E_EYEQ_TSR_e_none    " 1 "E_EYEQ_TSR_e_rain    " 2 "E_EYEQ_TSR_e_snow    " 3 "E_EYEQ_TSR_e_trailer    " 4 "E_EYEQ_TSR_e_time    " 5 "E_EYEQ_TSR_e_Arrow_left    " 6 "E_EYEQ_TSR_e_Arrow_right    " 7 "E_EYEQ_TSR_e_BendArrow_left    " 8 "E_EYEQ_TSR_e_BendArrow_right    " 9 "E_EYEQ_TSR_e_truck    " 10 "E_EYEQ_TSR_e_distance_arrow    " 11 "E_EYEQ_TSR_e_weight    " 12 "E_EYEQ_TSR_e_distance_in    " 13 "E_EYEQ_TSR_e_tractor    " 14 "E_EYEQ_TSR_e_snow_rain    " 15 "E_EYEQ_TSR_e_school    " 16 "E_EYEQ_TSR_e_rain_cloud    " 17 "E_EYEQ_TSR_e_fog" 18 "E_EYEQ_TSR_e_hazardous_materials    " 19 "E_EYEQ_TSR_e_night    " 20 "E_EYEQ_TSR_e_supp_sign_generic    " 21 "E_EYEQ_TSR_e_rappel    " 22 "E_EYEQ_TSR_e_zone    " 23 "E_EYEQ_TSR_e_ramp    " 24 "E_EYEQ_TSR_e_end    " 25 "E_EYEQ_TSR_e_exit    " 26 "E_EYEQ_TSR_e_advisory    " 27 "E_EYEQ_TSR_e_minimum    " 28 "E_EYEQ_TSR_e_reduced_ahead    " 29 "E_EYEQ_TSR_e_distance_stop    " 30 "E_EYEQ_TSR_e_par_verglas    " 31 "E_EYEQ_TSR_e_ahead    " 32 "E_EYEQ_TSR_e_area    " 33 "E_EYEQ_TSR_e_road_work_au    " 34 "E_EYEQ_TSR_e_arrow_bidirectional    " 35 "E_EYEQ_TSR_e_work_zone    " 36 "E_EYEQ_TSR_e_distance_in_for    " 37 "E_EYEQ_TSR_e_zone_end    " 38 "E_EYEQ_TSR_e_supp_end_school_zone    " 39 "E_EYEQ_TSR_e_supp_camera    " 40 "E_EYEQ_TSR_e_larmschutz    " 41 "E_EYEQ_TSR_e_car    " 42 "E_EYEQ_TSR_e_shared_zone    " 43 "E_EYEQ_TSR_e_supp_bump    " 44 "E_EYEQ_TSR_e_snow_rain_dis_arrow    " 45 "E_EYEQ_TSR_e_snow_truck    " 46 "E_EYEQ_TSR_e_motorcycle    " 47 "E_EYEQ_TSR_e_time_school    " 48 "E_EYEQ_TSR_e_truck_bus    " 49 "E_EYEQ_TSR_e_num_of_supp_signs_types    " 255 "E_EYEQ_TSR_e_invalid_supp" ;
VAL_ 1840 VIS_TSR_SIGN_4_RelevantDecision 0 "RELEVANT_SIGN" 1 "HIGHWAY_EXIT_SIGN" 2 "LANE_ASSIGNMENT_SIGN" 3 "PARRALEL_ROAD_SIGN" 4 "SIGN_ON_TURN" 5 "FAR_IRRELEVANT_SIGN" 6 "INTERNAL_SIGN_CONTRADICTION" 7 "ERROR_SIGN_CODE" 8 "�CIPV_IN_FRONT" 9 "�CONTRADICT_ARROW_SIGN" 10 "OTHER_FILTER_REASON" ;
VAL_ 1840 VIS_TSR_SIGN_5_Type 0 "E_EYEQ_TSR_e_std_10    " 1 "E_EYEQ_TSR_e_std_20    " 2 "E_EYEQ_TSR_e_std_30    " 3 "E_EYEQ_TSR_e_std_40    " 4 "E_EYEQ_TSR_e_std_50    " 5 "E_EYEQ_TSR_e_std_60    " 6 "E_EYEQ_TSR_e_std_70    " 7 "E_EYEQ_TSR_e_std_80    " 8 "E_EYEQ_TSR_e_std_90    " 9 "E_EYEQ_TSR_e_std_100    " 10 "E_EYEQ_TSR_e_std_110    " 11 "E_EYEQ_TSR_e_std_120    " 12 "E_EYEQ_TSR_e_std_130    " 13 "E_EYEQ_TSR_e_std_140    " 23 "E_EYEQ_TSR_e_car_limit    " 24 "E_EYEQ_TSR_e_carUpMotorDownDiagonal    " 25 "E_EYEQ_TSR_e_minimum_SL    " 27 "E_EYEQ_TSR_e_leftOrStraight    " 28 "E_EYEQ_TSR_e_lgt_10    " 29 "E_EYEQ_TSR_e_lgt_20    " 30 "E_EYEQ_TSR_e_lgt_30    " 31 "E_EYEQ_TSR_e_lgt_40    " 32 "E_EYEQ_TSR_e_lgt_50    " 33 "E_EYEQ_TSR_e_lgt_60    " 34 "E_EYEQ_TSR_e_lgt_70    " 35 "E_EYEQ_TSR_e_lgt_80    " 36 "E_EYEQ_TSR_e_lgt_90    " 37 "E_EYEQ_TSR_e_lgt_100    " 38 "E_EYEQ_TSR_e_lgt_110    " 39 "E_EYEQ_TSR_e_lgt_120    " 40 "E_EYEQ_TSR_e_lgt_130    " 41 "E_EYEQ_TSR_e_lgt_140" ;
VAL_ 1840 VIS_TSR_SIGN_5_SupplementalType1 0 "E_EYEQ_TSR_e_none    " 1 "E_EYEQ_TSR_e_rain    " 2 "E_EYEQ_TSR_e_snow    " 3 "E_EYEQ_TSR_e_trailer    " 4 "E_EYEQ_TSR_e_time    " 5 "E_EYEQ_TSR_e_Arrow_left    " 6 "E_EYEQ_TSR_e_Arrow_right    " 7 "E_EYEQ_TSR_e_BendArrow_left    " 8 "E_EYEQ_TSR_e_BendArrow_right    " 9 "E_EYEQ_TSR_e_truck    " 10 "E_EYEQ_TSR_e_distance_arrow    " 11 "E_EYEQ_TSR_e_weight    " 12 "E_EYEQ_TSR_e_distance_in    " 13 "E_EYEQ_TSR_e_tractor    " 14 "E_EYEQ_TSR_e_snow_rain    " 15 "E_EYEQ_TSR_e_school    " 16 "E_EYEQ_TSR_e_rain_cloud    " 17 "E_EYEQ_TSR_e_fog" 18 "E_EYEQ_TSR_e_hazardous_materials    " 19 "E_EYEQ_TSR_e_night    " 20 "E_EYEQ_TSR_e_supp_sign_generic    " 21 "E_EYEQ_TSR_e_rappel    " 22 "E_EYEQ_TSR_e_zone    " 23 "E_EYEQ_TSR_e_ramp    " 24 "E_EYEQ_TSR_e_end    " 25 "E_EYEQ_TSR_e_exit    " 26 "E_EYEQ_TSR_e_advisory    " 27 "E_EYEQ_TSR_e_minimum    " 28 "E_EYEQ_TSR_e_reduced_ahead    " 29 "E_EYEQ_TSR_e_distance_stop    " 30 "E_EYEQ_TSR_e_par_verglas    " 31 "E_EYEQ_TSR_e_ahead    " 32 "E_EYEQ_TSR_e_area    " 33 "E_EYEQ_TSR_e_road_work_au    " 34 "E_EYEQ_TSR_e_arrow_bidirectional    " 35 "E_EYEQ_TSR_e_work_zone    " 36 "E_EYEQ_TSR_e_distance_in_for    " 37 "E_EYEQ_TSR_e_zone_end    " 38 "E_EYEQ_TSR_e_supp_end_school_zone    " 39 "E_EYEQ_TSR_e_supp_camera    " 40 "E_EYEQ_TSR_e_larmschutz    " 41 "E_EYEQ_TSR_e_car    " 42 "E_EYEQ_TSR_e_shared_zone    " 43 "E_EYEQ_TSR_e_supp_bump    " 44 "E_EYEQ_TSR_e_snow_rain_dis_arrow    " 45 "E_EYEQ_TSR_e_snow_truck    " 46 "E_EYEQ_TSR_e_motorcycle    " 47 "E_EYEQ_TSR_e_time_school    " 48 "E_EYEQ_TSR_e_truck_bus    " 49 "E_EYEQ_TSR_e_num_of_supp_signs_types    " 255 "E_EYEQ_TSR_e_invalid_supp" ;
VAL_ 1840 VIS_TSR_SIGN_5_SupplementalType2 0 "E_EYEQ_TSR_e_none    " 1 "E_EYEQ_TSR_e_rain    " 2 "E_EYEQ_TSR_e_snow    " 3 "E_EYEQ_TSR_e_trailer    " 4 "E_EYEQ_TSR_e_time    " 5 "E_EYEQ_TSR_e_Arrow_left    " 6 "E_EYEQ_TSR_e_Arrow_right    " 7 "E_EYEQ_TSR_e_BendArrow_left    " 8 "E_EYEQ_TSR_e_BendArrow_right    " 9 "E_EYEQ_TSR_e_truck    " 10 "E_EYEQ_TSR_e_distance_arrow    " 11 "E_EYEQ_TSR_e_weight    " 12 "E_EYEQ_TSR_e_distance_in    " 13 "E_EYEQ_TSR_e_tractor    " 14 "E_EYEQ_TSR_e_snow_rain    " 15 "E_EYEQ_TSR_e_school    " 16 "E_EYEQ_TSR_e_rain_cloud    " 17 "E_EYEQ_TSR_e_fog" 18 "E_EYEQ_TSR_e_hazardous_materials    " 19 "E_EYEQ_TSR_e_night    " 20 "E_EYEQ_TSR_e_supp_sign_generic    " 21 "E_EYEQ_TSR_e_rappel    " 22 "E_EYEQ_TSR_e_zone    " 23 "E_EYEQ_TSR_e_ramp    " 24 "E_EYEQ_TSR_e_end    " 25 "E_EYEQ_TSR_e_exit    " 26 "E_EYEQ_TSR_e_advisory    " 27 "E_EYEQ_TSR_e_minimum    " 28 "E_EYEQ_TSR_e_reduced_ahead    " 29 "E_EYEQ_TSR_e_distance_stop    " 30 "E_EYEQ_TSR_e_par_verglas    " 31 "E_EYEQ_TSR_e_ahead    " 32 "E_EYEQ_TSR_e_area    " 33 "E_EYEQ_TSR_e_road_work_au    " 34 "E_EYEQ_TSR_e_arrow_bidirectional    " 35 "E_EYEQ_TSR_e_work_zone    " 36 "E_EYEQ_TSR_e_distance_in_for    " 37 "E_EYEQ_TSR_e_zone_end    " 38 "E_EYEQ_TSR_e_supp_end_school_zone    " 39 "E_EYEQ_TSR_e_supp_camera    " 40 "E_EYEQ_TSR_e_larmschutz    " 41 "E_EYEQ_TSR_e_car    " 42 "E_EYEQ_TSR_e_shared_zone    " 43 "E_EYEQ_TSR_e_supp_bump    " 44 "E_EYEQ_TSR_e_snow_rain_dis_arrow    " 45 "E_EYEQ_TSR_e_snow_truck    " 46 "E_EYEQ_TSR_e_motorcycle    " 47 "E_EYEQ_TSR_e_time_school    " 48 "E_EYEQ_TSR_e_truck_bus    " 49 "E_EYEQ_TSR_e_num_of_supp_signs_types    " 255 "E_EYEQ_TSR_e_invalid_supp" ;
VAL_ 1840 VIS_TSR_SIGN_5_RelevantDecision 0 "RELEVANT_SIGN" 1 "HIGHWAY_EXIT_SIGN" 2 "LANE_ASSIGNMENT_SIGN" 3 "PARRALEL_ROAD_SIGN" 4 "SIGN_ON_TURN" 5 "FAR_IRRELEVANT_SIGN" 6 "INTERNAL_SIGN_CONTRADICTION" 7 "ERROR_SIGN_CODE" 8 "�CIPV_IN_FRONT" 9 "�CONTRADICT_ARROW_SIGN" 10 "OTHER_FILTER_REASON" ;
VAL_ 1840 VIS_TSR_SIGN_6_Type 0 "E_EYEQ_TSR_e_std_10    " 1 "E_EYEQ_TSR_e_std_20    " 2 "E_EYEQ_TSR_e_std_30    " 3 "E_EYEQ_TSR_e_std_40    " 4 "E_EYEQ_TSR_e_std_50    " 5 "E_EYEQ_TSR_e_std_60    " 6 "E_EYEQ_TSR_e_std_70    " 7 "E_EYEQ_TSR_e_std_80    " 8 "E_EYEQ_TSR_e_std_90    " 9 "E_EYEQ_TSR_e_std_100    " 10 "E_EYEQ_TSR_e_std_110    " 11 "E_EYEQ_TSR_e_std_120    " 12 "E_EYEQ_TSR_e_std_130    " 13 "E_EYEQ_TSR_e_std_140    " 23 "E_EYEQ_TSR_e_car_limit    " 24 "E_EYEQ_TSR_e_carUpMotorDownDiagonal    " 25 "E_EYEQ_TSR_e_minimum_SL    " 27 "E_EYEQ_TSR_e_leftOrStraight    " 28 "E_EYEQ_TSR_e_lgt_10    " 29 "E_EYEQ_TSR_e_lgt_20    " 30 "E_EYEQ_TSR_e_lgt_30    " 31 "E_EYEQ_TSR_e_lgt_40    " 32 "E_EYEQ_TSR_e_lgt_50    " 33 "E_EYEQ_TSR_e_lgt_60    " 34 "E_EYEQ_TSR_e_lgt_70    " 35 "E_EYEQ_TSR_e_lgt_80    " 36 "E_EYEQ_TSR_e_lgt_90    " 37 "E_EYEQ_TSR_e_lgt_100    " 38 "E_EYEQ_TSR_e_lgt_110    " 39 "E_EYEQ_TSR_e_lgt_120    " 40 "E_EYEQ_TSR_e_lgt_130    " 41 "E_EYEQ_TSR_e_lgt_140" ;
VAL_ 1840 VIS_TSR_SIGN_6_SupplementalType1 0 "E_EYEQ_TSR_e_none    " 1 "E_EYEQ_TSR_e_rain    " 2 "E_EYEQ_TSR_e_snow    " 3 "E_EYEQ_TSR_e_trailer    " 4 "E_EYEQ_TSR_e_time    " 5 "E_EYEQ_TSR_e_Arrow_left    " 6 "E_EYEQ_TSR_e_Arrow_right    " 7 "E_EYEQ_TSR_e_BendArrow_left    " 8 "E_EYEQ_TSR_e_BendArrow_right    " 9 "E_EYEQ_TSR_e_truck    " 10 "E_EYEQ_TSR_e_distance_arrow    " 11 "E_EYEQ_TSR_e_weight    " 12 "E_EYEQ_TSR_e_distance_in    " 13 "E_EYEQ_TSR_e_tractor    " 14 "E_EYEQ_TSR_e_snow_rain    " 15 "E_EYEQ_TSR_e_school    " 16 "E_EYEQ_TSR_e_rain_cloud    " 17 "E_EYEQ_TSR_e_fog" 18 "E_EYEQ_TSR_e_hazardous_materials    " 19 "E_EYEQ_TSR_e_night    " 20 "E_EYEQ_TSR_e_supp_sign_generic    " 21 "E_EYEQ_TSR_e_rappel    " 22 "E_EYEQ_TSR_e_zone    " 23 "E_EYEQ_TSR_e_ramp    " 24 "E_EYEQ_TSR_e_end    " 25 "E_EYEQ_TSR_e_exit    " 26 "E_EYEQ_TSR_e_advisory    " 27 "E_EYEQ_TSR_e_minimum    " 28 "E_EYEQ_TSR_e_reduced_ahead    " 29 "E_EYEQ_TSR_e_distance_stop    " 30 "E_EYEQ_TSR_e_par_verglas    " 31 "E_EYEQ_TSR_e_ahead    " 32 "E_EYEQ_TSR_e_area    " 33 "E_EYEQ_TSR_e_road_work_au    " 34 "E_EYEQ_TSR_e_arrow_bidirectional    " 35 "E_EYEQ_TSR_e_work_zone    " 36 "E_EYEQ_TSR_e_distance_in_for    " 37 "E_EYEQ_TSR_e_zone_end    " 38 "E_EYEQ_TSR_e_supp_end_school_zone    " 39 "E_EYEQ_TSR_e_supp_camera    " 40 "E_EYEQ_TSR_e_larmschutz    " 41 "E_EYEQ_TSR_e_car    " 42 "E_EYEQ_TSR_e_shared_zone    " 43 "E_EYEQ_TSR_e_supp_bump    " 44 "E_EYEQ_TSR_e_snow_rain_dis_arrow    " 45 "E_EYEQ_TSR_e_snow_truck    " 46 "E_EYEQ_TSR_e_motorcycle    " 47 "E_EYEQ_TSR_e_time_school    " 48 "E_EYEQ_TSR_e_truck_bus    " 49 "E_EYEQ_TSR_e_num_of_supp_signs_types    " 255 "E_EYEQ_TSR_e_invalid_supp" ;
VAL_ 1840 VIS_TSR_SIGN_6_SupplementalType2 0 "E_EYEQ_TSR_e_none    " 1 "E_EYEQ_TSR_e_rain    " 2 "E_EYEQ_TSR_e_snow    " 3 "E_EYEQ_TSR_e_trailer    " 4 "E_EYEQ_TSR_e_time    " 5 "E_EYEQ_TSR_e_Arrow_left    " 6 "E_EYEQ_TSR_e_Arrow_right    " 7 "E_EYEQ_TSR_e_BendArrow_left    " 8 "E_EYEQ_TSR_e_BendArrow_right    " 9 "E_EYEQ_TSR_e_truck    " 10 "E_EYEQ_TSR_e_distance_arrow    " 11 "E_EYEQ_TSR_e_weight    " 12 "E_EYEQ_TSR_e_distance_in    " 13 "E_EYEQ_TSR_e_tractor    " 14 "E_EYEQ_TSR_e_snow_rain    " 15 "E_EYEQ_TSR_e_school    " 16 "E_EYEQ_TSR_e_rain_cloud    " 17 "E_EYEQ_TSR_e_fog" 18 "E_EYEQ_TSR_e_hazardous_materials    " 19 "E_EYEQ_TSR_e_night    " 20 "E_EYEQ_TSR_e_supp_sign_generic    " 21 "E_EYEQ_TSR_e_rappel    " 22 "E_EYEQ_TSR_e_zone    " 23 "E_EYEQ_TSR_e_ramp    " 24 "E_EYEQ_TSR_e_end    " 25 "E_EYEQ_TSR_e_exit    " 26 "E_EYEQ_TSR_e_advisory    " 27 "E_EYEQ_TSR_e_minimum    " 28 "E_EYEQ_TSR_e_reduced_ahead    " 29 "E_EYEQ_TSR_e_distance_stop    " 30 "E_EYEQ_TSR_e_par_verglas    " 31 "E_EYEQ_TSR_e_ahead    " 32 "E_EYEQ_TSR_e_area    " 33 "E_EYEQ_TSR_e_road_work_au    " 34 "E_EYEQ_TSR_e_arrow_bidirectional    " 35 "E_EYEQ_TSR_e_work_zone    " 36 "E_EYEQ_TSR_e_distance_in_for    " 37 "E_EYEQ_TSR_e_zone_end    " 38 "E_EYEQ_TSR_e_supp_end_school_zone    " 39 "E_EYEQ_TSR_e_supp_camera    " 40 "E_EYEQ_TSR_e_larmschutz    " 41 "E_EYEQ_TSR_e_car    " 42 "E_EYEQ_TSR_e_shared_zone    " 43 "E_EYEQ_TSR_e_supp_bump    " 44 "E_EYEQ_TSR_e_snow_rain_dis_arrow    " 45 "E_EYEQ_TSR_e_snow_truck    " 46 "E_EYEQ_TSR_e_motorcycle    " 47 "E_EYEQ_TSR_e_time_school    " 48 "E_EYEQ_TSR_e_truck_bus    " 49 "E_EYEQ_TSR_e_num_of_supp_signs_types    " 255 "E_EYEQ_TSR_e_invalid_supp" ;
VAL_ 1840 VIS_TSR_SIGN_6_RelevantDecision 0 "RELEVANT_SIGN" 1 "HIGHWAY_EXIT_SIGN" 2 "LANE_ASSIGNMENT_SIGN" 3 "PARRALEL_ROAD_SIGN" 4 "SIGN_ON_TURN" 5 "FAR_IRRELEVANT_SIGN" 6 "INTERNAL_SIGN_CONTRADICTION" 7 "ERROR_SIGN_CODE" 8 "�CIPV_IN_FRONT" 9 "�CONTRADICT_ARROW_SIGN" 10 "OTHER_FILTER_REASON" ;
VAL_ 1843 VIS_TSR_roadMarking_0_StopL_0000 284 "Road Solid Stop Line" 285 "Road Dashed Stop Line" 286 "Road Double Solid Stop Line" 287 "Road Dashed Solid Stop Line" 288 "Road Solid Dashed Stop Line" 289 "Road Double Dashed Stop Line" 290 "Road Triangular Stop Line" ;
VAL_ 1843 VIS_TSR_roadMarking_0_StopL_0001 0 "Green_Blue" 1 "White" 2 "Yellow_Orange_Red" ;
VAL_ 1843 VIS_TSR_roadMarking_0_StopL_0002 0 "Unknown" 1 "In_Image" 2 "Predicted" ;
VAL_ 1843 VIS_TSR_roadMarking_1_StopL_0000 284 "Road Solid Stop Line" 285 "Road Dashed Stop Line" 286 "Road Double Solid Stop Line" 287 "Road Dashed Solid Stop Line" 288 "Road Solid Dashed Stop Line" 289 "Road Double Dashed Stop Line" 290 "Road Triangular Stop Line" ;
VAL_ 1843 VIS_TSR_roadMarking_1_StopL_0001 0 "Green_Blue" 1 "White" 2 "Yellow_Orange_Red" ;
VAL_ 1843 VIS_TSR_roadMarking_1_StopL_0002 0 "Unknown" 1 "In_Image" 2 "Predicted" ;
VAL_ 1843 VIS_TSR_roadMarking_2_StopL_0000 284 "Road Solid Stop Line" 285 "Road Dashed Stop Line" 286 "Road Double Solid Stop Line" 287 "Road Dashed Solid Stop Line" 288 "Road Solid Dashed Stop Line" 289 "Road Double Dashed Stop Line" 290 "Road Triangular Stop Line" ;
VAL_ 1843 VIS_TSR_roadMarking_2_StopL_0001 0 "Green_Blue" 1 "White" 2 "Yellow_Orange_Red" ;
VAL_ 1843 VIS_TSR_roadMarking_2_StopL_0002 0 "Unknown" 1 "In_Image" 2 "Predicted" ;
VAL_ 1843 VIS_TSR_roadMarking_3_StopL_0000 284 "Road Solid Stop Line" 285 "Road Dashed Stop Line" 286 "Road Double Solid Stop Line" 287 "Road Dashed Solid Stop Line" 288 "Road Solid Dashed Stop Line" 289 "Road Double Dashed Stop Line" 290 "Road Triangular Stop Line" ;
VAL_ 1843 VIS_TSR_roadMarking_3_StopL_0001 0 "Green_Blue" 1 "White" 2 "Yellow_Orange_Red" ;
VAL_ 1843 VIS_TSR_roadMarking_3_StopL_0002 0 "Unknown" 1 "In_Image" 2 "Predicted" ;
VAL_ 1843 VIS_TSR_roadMarking_4_StopL_0000 284 "Road Solid Stop Line" 285 "Road Dashed Stop Line" 286 "Road Double Solid Stop Line" 287 "Road Dashed Solid Stop Line" 288 "Road Solid Dashed Stop Line" 289 "Road Double Dashed Stop Line" 290 "Road Triangular Stop Line" ;
VAL_ 1843 VIS_TSR_roadMarking_4_StopL_0001 0 "Green_Blue" 1 "White" 2 "Yellow_Orange_Red" ;
VAL_ 1843 VIS_TSR_roadMarking_4_StopL_0002 0 "Unknown" 1 "In_Image" 2 "Predicted" ;
VAL_ 1844 VIS_TSR_roadMarking_5_StopL_0000 284 "Road Solid Stop Line" 285 "Road Dashed Stop Line" 286 "Road Double Solid Stop Line" 287 "Road Dashed Solid Stop Line" 288 "Road Solid Dashed Stop Line" 289 "Road Double Dashed Stop Line" 290 "Road Triangular Stop Line" ;
VAL_ 1844 VIS_TSR_roadMarking_5_StopL_0001 0 "Green_Blue" 1 "White" 2 "Yellow_Orange_Red" ;
VAL_ 1844 VIS_TSR_roadMarking_5_StopL_0002 0 "Unknown" 1 "In_Image" 2 "Predicted" ;
VAL_ 1844 VIS_TSR_roadMarking_6_StopL_0000 284 "Road Solid Stop Line" 285 "Road Dashed Stop Line" 286 "Road Double Solid Stop Line" 287 "Road Dashed Solid Stop Line" 288 "Road Solid Dashed Stop Line" 289 "Road Double Dashed Stop Line" 290 "Road Triangular Stop Line" ;
VAL_ 1844 VIS_TSR_roadMarking_6_StopL_0001 0 "Green_Blue" 1 "White" 2 "Yellow_Orange_Red" ;
VAL_ 1844 VIS_TSR_roadMarking_6_StopL_0002 0 "Unknown" 1 "In_Image" 2 "Predicted" ;
VAL_ 1844 VIS_TSR_roadMarking_7_StopL_0000 284 "Road Solid Stop Line" 285 "Road Dashed Stop Line" 286 "Road Double Solid Stop Line" 287 "Road Dashed Solid Stop Line" 288 "Road Solid Dashed Stop Line" 289 "Road Double Dashed Stop Line" 290 "Road Triangular Stop Line" ;
VAL_ 1844 VIS_TSR_roadMarking_7_StopL_0001 0 "Green_Blue" 1 "White" 2 "Yellow_Orange_Red" ;
VAL_ 1844 VIS_TSR_roadMarking_7_StopL_0002 0 "Unknown" 1 "In_Image" 2 "Predicted" ;
VAL_ 1844 VIS_TSR_roadMarking_8_StopL_0000 284 "Road Solid Stop Line" 285 "Road Dashed Stop Line" 286 "Road Double Solid Stop Line" 287 "Road Dashed Solid Stop Line" 288 "Road Solid Dashed Stop Line" 289 "Road Double Dashed Stop Line" 290 "Road Triangular Stop Line" ;
VAL_ 1844 VIS_TSR_roadMarking_8_StopL_0001 0 "Green_Blue" 1 "White" 2 "Yellow_Orange_Red" ;
VAL_ 1844 VIS_TSR_roadMarking_8_StopL_0002 0 "Unknown" 1 "In_Image" 2 "Predicted" ;
VAL_ 1844 VIS_TSR_roadMarking_9_StopL_0000 284 "Road Solid Stop Line" 285 "Road Dashed Stop Line" 286 "Road Double Solid Stop Line" 287 "Road Dashed Solid Stop Line" 288 "Road Solid Dashed Stop Line" 289 "Road Double Dashed Stop Line" 290 "Road Triangular Stop Line" ;
VAL_ 1844 VIS_TSR_roadMarking_9_StopL_0001 0 "Green_Blue" 1 "White" 2 "Yellow_Orange_Red" ;
VAL_ 1844 VIS_TSR_roadMarking_9_StopL_0002 0 "Unknown" 1 "In_Image" 2 "Predicted" ;
VAL_ 1845 VIS_TSR_roadMarking_0_Arrows_Typ 14 "Road Arrow Straight  " 15 "Road Arrow Straight Right  " 16 "Road Arrow Straight Left" 17 "Road Arrow Right  " 18 "Road Arrow Left" 19 "Road Arrow Oncoming " 276 "Road Arrow Straight Left Right" 277 "Road Arrow Left Right" ;
VAL_ 1845 VIS_TSR_roadMarking_1_Arrows_Typ 14 "Road Arrow Straight  " 15 "Road Arrow Straight Right  " 16 "Road Arrow Straight Left" 17 "Road Arrow Right  " 18 "Road Arrow Left" 19 "Road Arrow Oncoming " 276 "Road Arrow Straight Left Right" 277 "Road Arrow Left Right" ;
VAL_ 1845 VIS_TSR_roadMarking_2_Arrows_Typ 14 "Road Arrow Straight  " 15 "Road Arrow Straight Right  " 16 "Road Arrow Straight Left" 17 "Road Arrow Right  " 18 "Road Arrow Left" 19 "Road Arrow Oncoming " 276 "Road Arrow Straight Left Right" 277 "Road Arrow Left Right" ;
VAL_ 1845 VIS_TSR_roadMarking_3_Arrows_Typ 14 "Road Arrow Straight  " 15 "Road Arrow Straight Right  " 16 "Road Arrow Straight Left" 17 "Road Arrow Right  " 18 "Road Arrow Left" 19 "Road Arrow Oncoming " 276 "Road Arrow Straight Left Right" 277 "Road Arrow Left Right" ;
VAL_ 1845 VIS_TSR_roadMarking_4_Arrows_Typ 14 "Road Arrow Straight  " 15 "Road Arrow Straight Right  " 16 "Road Arrow Straight Left" 17 "Road Arrow Right  " 18 "Road Arrow Left" 19 "Road Arrow Oncoming " 276 "Road Arrow Straight Left Right" 277 "Road Arrow Left Right" ;
VAL_ 1845 VIS_TSR_roadMarking_5_Arrows_Typ 14 "Road Arrow Straight  " 15 "Road Arrow Straight Right  " 16 "Road Arrow Straight Left" 17 "Road Arrow Right  " 18 "Road Arrow Left" 19 "Road Arrow Oncoming " 276 "Road Arrow Straight Left Right" 277 "Road Arrow Left Right" ;
VAL_ 1845 VIS_TSR_roadMarking_6_Arrows_Typ 14 "Road Arrow Straight  " 15 "Road Arrow Straight Right  " 16 "Road Arrow Straight Left" 17 "Road Arrow Right  " 18 "Road Arrow Left" 19 "Road Arrow Oncoming " 276 "Road Arrow Straight Left Right" 277 "Road Arrow Left Right" ;
VAL_ 1845 VIS_TSR_roadMarking_7_Arrows_Typ 14 "Road Arrow Straight  " 15 "Road Arrow Straight Right  " 16 "Road Arrow Straight Left" 17 "Road Arrow Right  " 18 "Road Arrow Left" 19 "Road Arrow Oncoming " 276 "Road Arrow Straight Left Right" 277 "Road Arrow Left Right" ;
VAL_ 1845 VIS_TSR_roadMarking_8_Arrows_Typ 14 "Road Arrow Straight  " 15 "Road Arrow Straight Right  " 16 "Road Arrow Straight Left" 17 "Road Arrow Right  " 18 "Road Arrow Left" 19 "Road Arrow Oncoming " 276 "Road Arrow Straight Left Right" 277 "Road Arrow Left Right" ;
VAL_ 1845 VIS_TSR_roadMarking_9_Arrows_Typ 14 "Road Arrow Straight  " 15 "Road Arrow Straight Right  " 16 "Road Arrow Straight Left" 17 "Road Arrow Right  " 18 "Road Arrow Left" 19 "Road Arrow Oncoming " 276 "Road Arrow Straight Left Right" 277 "Road Arrow Left Right" ;
VAL_ 1846 VIS_TSR_roadMarking_0_Speed_0000 400 "Road Speed Limit 10" 401 "Road Speed Limit 100" 402 "Road Speed Limit 110" 403 "Road Speed Limit 120" 404 "Road Speed Limit 20" 405 "Road Speed Limit 30" 406 "Road Speed Limit 40" 407 "Road Speed Limit 50" 408 "Road Speed Limit 60" 409 "Road Speed Limit 70" 410 "Road Speed Limit 80" 411 "Road Speed Limit 90" ;
VAL_ 1846 VIS_TSR_roadMarking_1_Speed_0000 400 "Road Speed Limit 10" 401 "Road Speed Limit 100" 402 "Road Speed Limit 110" 403 "Road Speed Limit 120" 404 "Road Speed Limit 20" 405 "Road Speed Limit 30" 406 "Road Speed Limit 40" 407 "Road Speed Limit 50" 408 "Road Speed Limit 60" 409 "Road Speed Limit 70" 410 "Road Speed Limit 80" 411 "Road Speed Limit 90" ;
VAL_ 1846 VIS_TSR_roadMarking_2_Speed_0000 400 "Road Speed Limit 10" 401 "Road Speed Limit 100" 402 "Road Speed Limit 110" 403 "Road Speed Limit 120" 404 "Road Speed Limit 20" 405 "Road Speed Limit 30" 406 "Road Speed Limit 40" 407 "Road Speed Limit 50" 408 "Road Speed Limit 60" 409 "Road Speed Limit 70" 410 "Road Speed Limit 80" 411 "Road Speed Limit 90" ;
VAL_ 1846 VIS_TSR_roadMarking_3_Speed_0000 400 "Road Speed Limit 10" 401 "Road Speed Limit 100" 402 "Road Speed Limit 110" 403 "Road Speed Limit 120" 404 "Road Speed Limit 20" 405 "Road Speed Limit 30" 406 "Road Speed Limit 40" 407 "Road Speed Limit 50" 408 "Road Speed Limit 60" 409 "Road Speed Limit 70" 410 "Road Speed Limit 80" 411 "Road Speed Limit 90" ;
VAL_ 1846 VIS_TSR_roadMarking_4_Speed_0000 400 "Road Speed Limit 10" 401 "Road Speed Limit 100" 402 "Road Speed Limit 110" 403 "Road Speed Limit 120" 404 "Road Speed Limit 20" 405 "Road Speed Limit 30" 406 "Road Speed Limit 40" 407 "Road Speed Limit 50" 408 "Road Speed Limit 60" 409 "Road Speed Limit 70" 410 "Road Speed Limit 80" 411 "Road Speed Limit 90" ;
VAL_ 1846 VIS_TSR_roadMarking_5_Speed_0000 400 "Road Speed Limit 10" 401 "Road Speed Limit 100" 402 "Road Speed Limit 110" 403 "Road Speed Limit 120" 404 "Road Speed Limit 20" 405 "Road Speed Limit 30" 406 "Road Speed Limit 40" 407 "Road Speed Limit 50" 408 "Road Speed Limit 60" 409 "Road Speed Limit 70" 410 "Road Speed Limit 80" 411 "Road Speed Limit 90" ;
VAL_ 1846 VIS_TSR_roadMarking_6_Speed_0000 400 "Road Speed Limit 10" 401 "Road Speed Limit 100" 402 "Road Speed Limit 110" 403 "Road Speed Limit 120" 404 "Road Speed Limit 20" 405 "Road Speed Limit 30" 406 "Road Speed Limit 40" 407 "Road Speed Limit 50" 408 "Road Speed Limit 60" 409 "Road Speed Limit 70" 410 "Road Speed Limit 80" 411 "Road Speed Limit 90" ;
VAL_ 1846 VIS_TSR_roadMarking_7_Speed_0000 400 "Road Speed Limit 10" 401 "Road Speed Limit 100" 402 "Road Speed Limit 110" 403 "Road Speed Limit 120" 404 "Road Speed Limit 20" 405 "Road Speed Limit 30" 406 "Road Speed Limit 40" 407 "Road Speed Limit 50" 408 "Road Speed Limit 60" 409 "Road Speed Limit 70" 410 "Road Speed Limit 80" 411 "Road Speed Limit 90" ;
VAL_ 1846 VIS_TSR_roadMarking_8_Speed_0000 400 "Road Speed Limit 10" 401 "Road Speed Limit 100" 402 "Road Speed Limit 110" 403 "Road Speed Limit 120" 404 "Road Speed Limit 20" 405 "Road Speed Limit 30" 406 "Road Speed Limit 40" 407 "Road Speed Limit 50" 408 "Road Speed Limit 60" 409 "Road Speed Limit 70" 410 "Road Speed Limit 80" 411 "Road Speed Limit 90" ;
VAL_ 1846 VIS_TSR_roadMarking_9_Speed_0000 400 "Road Speed Limit 10" 401 "Road Speed Limit 100" 402 "Road Speed Limit 110" 403 "Road Speed Limit 120" 404 "Road Speed Limit 20" 405 "Road Speed Limit 30" 406 "Road Speed Limit 40" 407 "Road Speed Limit 50" 408 "Road Speed Limit 60" 409 "Road Speed Limit 70" 410 "Road Speed Limit 80" 411 "Road Speed Limit 90" ;
VAL_ 1847 VIS_TSR_roadMarking_0_Cross_0000 291 "Road Zebra Crossing" 292 "Road Solid Crossing" 293 "Road Dashed Crossing" ;
VAL_ 1847 VIS_TSR_roadMarking_1_Cross_0000 291 "Road Zebra Crossing" 292 "Road Solid Crossing" 293 "Road Dashed Crossing" ;
VAL_ 1847 VIS_TSR_roadMarking_2_Cross_0000 291 "Road Zebra Crossing" 292 "Road Solid Crossing" 293 "Road Dashed Crossing" ;
VAL_ 1847 VIS_TSR_roadMarking_3_Cross_0000 291 "Road Zebra Crossing" 292 "Road Solid Crossing" 293 "Road Dashed Crossing" ;
VAL_ 1847 VIS_TSR_roadMarking_4_Cross_0000 291 "Road Zebra Crossing" 292 "Road Solid Crossing" 293 "Road Dashed Crossing" ;
VAL_ 1847 VIS_TSR_roadMarking_5_Cross_0000 291 "Road Zebra Crossing" 292 "Road Solid Crossing" 293 "Road Dashed Crossing" ;
VAL_ 1847 VIS_TSR_roadMarking_6_Cross_0000 291 "Road Zebra Crossing" 292 "Road Solid Crossing" 293 "Road Dashed Crossing" ;
VAL_ 1847 VIS_TSR_roadMarking_7_Cross_0000 291 "Road Zebra Crossing" 292 "Road Solid Crossing" 293 "Road Dashed Crossing" ;
VAL_ 1847 VIS_TSR_roadMarking_8_Cross_0000 291 "Road Zebra Crossing" 292 "Road Solid Crossing" 293 "Road Dashed Crossing" ;
VAL_ 1847 VIS_TSR_roadMarking_9_Cross_0000 291 "Road Zebra Crossing" 292 "Road Solid Crossing" 293 "Road Dashed Crossing" ;
VAL_ 1848 VIS_TSR_Env_currentMarket 0 "WORLD" 1 "EUROPE" 2 "GULF" 3 "USA" 4 "CANADA" 5 "JAPAN" 6 "CHINA" 7 "SOUTH_AFRICA" 8 "KOREA" 9 "AUSTRALIA" 10 "UK" ;
VAL_ 1856 VIS_AHBC_OBJ_0_classification 0 "None" 1 "Headlamp" 2 "Tail-lamp" 3 "PairofHeadlamps" 4 "PairofTail-lamps" 5 "TruckCabinTopLights" 6 "WeakOncomingPairofHeadlampsORWeakOncomingTruckCabinTopLightsorWeakOncomingSingleHeadlamp(addingWeakOncomingSingleHeadlampfor3.18.1bundleandlaterreleases)." 7 "Clusteroflamps" 8 "SidelongLight" ;
VAL_ 1856 VIS_AHBC_OBJ_1_classification 0 "None" 1 "Headlamp" 2 "Tail-lamp" 3 "PairofHeadlamps" 4 "PairofTail-lamps" 5 "TruckCabinTopLights" 6 "WeakOncomingPairofHeadlampsORWeakOncomingTruckCabinTopLightsorWeakOncomingSingleHeadlamp(addingWeakOncomingSingleHeadlampfor3.18.1bundleandlaterreleases)." 7 "Clusteroflamps" 8 "SidelongLight" ;
VAL_ 1856 VIS_AHBC_OBJ_2_classification 0 "None" 1 "Headlamp" 2 "Tail-lamp" 3 "PairofHeadlamps" 4 "PairofTail-lamps" 5 "TruckCabinTopLights" 6 "WeakOncomingPairofHeadlampsORWeakOncomingTruckCabinTopLightsorWeakOncomingSingleHeadlamp(addingWeakOncomingSingleHeadlampfor3.18.1bundleandlaterreleases)." 7 "Clusteroflamps" 8 "SidelongLight" ;
VAL_ 1856 VIS_AHBC_OBJ_3_classification 0 "None" 1 "Headlamp" 2 "Tail-lamp" 3 "PairofHeadlamps" 4 "PairofTail-lamps" 5 "TruckCabinTopLights" 6 "WeakOncomingPairofHeadlampsORWeakOncomingTruckCabinTopLightsorWeakOncomingSingleHeadlamp(addingWeakOncomingSingleHeadlampfor3.18.1bundleandlaterreleases)." 7 "Clusteroflamps" 8 "SidelongLight" ;
VAL_ 1857 VIS_AHBC_OBJ_4_classification 0 "None" 1 "Headlamp" 2 "Tail-lamp" 3 "PairofHeadlamps" 4 "PairofTail-lamps" 5 "TruckCabinTopLights" 6 "WeakOncomingPairofHeadlampsORWeakOncomingTruckCabinTopLightsorWeakOncomingSingleHeadlamp(addingWeakOncomingSingleHeadlampfor3.18.1bundleandlaterreleases)." 7 "Clusteroflamps" 8 "SidelongLight" ;
VAL_ 1857 VIS_AHBC_OBJ_5_classification 0 "None" 1 "Headlamp" 2 "Tail-lamp" 3 "PairofHeadlamps" 4 "PairofTail-lamps" 5 "TruckCabinTopLights" 6 "WeakOncomingPairofHeadlampsORWeakOncomingTruckCabinTopLightsorWeakOncomingSingleHeadlamp(addingWeakOncomingSingleHeadlampfor3.18.1bundleandlaterreleases)." 7 "Clusteroflamps" 8 "SidelongLight" ;
VAL_ 1857 VIS_AHBC_OBJ_6_classification 0 "None" 1 "Headlamp" 2 "Tail-lamp" 3 "PairofHeadlamps" 4 "PairofTail-lamps" 5 "TruckCabinTopLights" 6 "WeakOncomingPairofHeadlampsORWeakOncomingTruckCabinTopLightsorWeakOncomingSingleHeadlamp(addingWeakOncomingSingleHeadlampfor3.18.1bundleandlaterreleases)." 7 "Clusteroflamps" 8 "SidelongLight" ;
VAL_ 1857 VIS_AHBC_OBJ_7_classification 0 "None" 1 "Headlamp" 2 "Tail-lamp" 3 "PairofHeadlamps" 4 "PairofTail-lamps" 5 "TruckCabinTopLights" 6 "WeakOncomingPairofHeadlampsORWeakOncomingTruckCabinTopLightsorWeakOncomingSingleHeadlamp(addingWeakOncomingSingleHeadlampfor3.18.1bundleandlaterreleases)." 7 "Clusteroflamps" 8 "SidelongLight" ;
VAL_ 1858 VIS_AHBC_OBJ_8_classification 0 "None" 1 "Headlamp" 2 "Tail-lamp" 3 "PairofHeadlamps" 4 "PairofTail-lamps" 5 "TruckCabinTopLights" 6 "WeakOncomingPairofHeadlampsORWeakOncomingTruckCabinTopLightsorWeakOncomingSingleHeadlamp(addingWeakOncomingSingleHeadlampfor3.18.1bundleandlaterreleases)." 7 "Clusteroflamps" 8 "SidelongLight" ;
VAL_ 1858 VIS_AHBC_OBJ_9_classification 0 "None" 1 "Headlamp" 2 "Tail-lamp" 3 "PairofHeadlamps" 4 "PairofTail-lamps" 5 "TruckCabinTopLights" 6 "WeakOncomingPairofHeadlampsORWeakOncomingTruckCabinTopLightsorWeakOncomingSingleHeadlamp(addingWeakOncomingSingleHeadlampfor3.18.1bundleandlaterreleases)." 7 "Clusteroflamps" 8 "SidelongLight" ;
VAL_ 1858 VIS_AHBC_OBJ_10_classification 0 "None" 1 "Headlamp" 2 "Tail-lamp" 3 "PairofHeadlamps" 4 "PairofTail-lamps" 5 "TruckCabinTopLights" 6 "WeakOncomingPairofHeadlampsORWeakOncomingTruckCabinTopLightsorWeakOncomingSingleHeadlamp(addingWeakOncomingSingleHeadlampfor3.18.1bundleandlaterreleases)." 7 "Clusteroflamps" 8 "SidelongLight" ;
VAL_ 1858 VIS_AHBC_OBJ_11_classification 0 "None" 1 "Headlamp" 2 "Tail-lamp" 3 "PairofHeadlamps" 4 "PairofTail-lamps" 5 "TruckCabinTopLights" 6 "WeakOncomingPairofHeadlampsORWeakOncomingTruckCabinTopLightsorWeakOncomingSingleHeadlamp(addingWeakOncomingSingleHeadlampfor3.18.1bundleandlaterreleases)." 7 "Clusteroflamps" 8 "SidelongLight" ;
VAL_ 1859 VIS_AHBC_OBJ_12_classification 0 "None" 1 "Headlamp" 2 "Tail-lamp" 3 "PairofHeadlamps" 4 "PairofTail-lamps" 5 "TruckCabinTopLights" 6 "WeakOncomingPairofHeadlampsORWeakOncomingTruckCabinTopLightsorWeakOncomingSingleHeadlamp(addingWeakOncomingSingleHeadlampfor3.18.1bundleandlaterreleases)." 7 "Clusteroflamps" 8 "SidelongLight" ;
VAL_ 1859 VIS_AHBC_OBJ_13_classification 0 "None" 1 "Headlamp" 2 "Tail-lamp" 3 "PairofHeadlamps" 4 "PairofTail-lamps" 5 "TruckCabinTopLights" 6 "WeakOncomingPairofHeadlampsORWeakOncomingTruckCabinTopLightsorWeakOncomingSingleHeadlamp(addingWeakOncomingSingleHeadlampfor3.18.1bundleandlaterreleases)." 7 "Clusteroflamps" 8 "SidelongLight" ;
VAL_ 1859 VIS_AHBC_OBJ_14_classification 0 "None" 1 "Headlamp" 2 "Tail-lamp" 3 "PairofHeadlamps" 4 "PairofTail-lamps" 5 "TruckCabinTopLights" 6 "WeakOncomingPairofHeadlampsORWeakOncomingTruckCabinTopLightsorWeakOncomingSingleHeadlamp(addingWeakOncomingSingleHeadlampfor3.18.1bundleandlaterreleases)." 7 "Clusteroflamps" 8 "SidelongLight" ;
VAL_ 1862 VIS_AHBC_clearFieldOfView 0 "Unknown" 1 "NoClearField-Of-View" 2 "ClearField-Of-View" ;
VAL_ 1862 VIS_AHBC_gridFrequency 0 "Undefined" 1 "50Hz" 2 "60Hz" ;
VAL_ 1862 VIS_AHBC_Available 0 "Off" 1 "Partial" 2 "Full" ;
VAL_ 1862 VIS_AHBC_beamRequest 0 "OFF(highbeamOFF)" 1 "ON(highbeamON)" ;
VAL_ 1862 VIS_AHBC_eventsDetected 1 "Noswitchreason(NotSupported)�" 2 "OncomingVehicle" 4 "PrecedingVehicle" 8 "SpeedLimit" 16 "AmbientLight" 32 "VillageDetection" 64 "FogDetection" 128 "HighwayMode" 256 "Delay(hysteresis)" 512 "Oncominglanenotdark" 1024 "ToomanyprecedingSpots(notimplemented)" 2048 "Curvestatus" 4096 "highSpeedStatus(notimplemented)" 8192 "OncomingVehicleDelay" 16384 "PrecedingVehicleDelay" 32768 "VillageDetectionDelayNote:�Somebitsmaybesetindependentofhigh/lowbeamdecision,e.g.oncomingvehicle,highwaymode." ;
VAL_ 1862 VIS_AHBC_Tunnel 0 "UNKNOWN" 1 "FALSE" 2 "TRUE" ;
VAL_ 1862 VIS_AHBC_fogDetected 0 "nofogdetected" 1 "fogdetected" ;
VAL_ 1862 VIS_AHBC_highwayDetected 0 "nohighwaydetected" 1 "highwaydetected" ;
VAL_ 1862 VIS_AHBC_villageDetected 0 "novillagedetected" 1 "villagedetected" ;
VAL_ 1862 VIS_AHBC_oncomingLaneNotDark 0 "oncominglanedark" 1 "oncominglanenotdark" ;
VAL_ 1862 VIS_AHBC_approachingJunction 0 "notapproachingjunction" 1 "approachingjunction" ;
VAL_ 1862 VIS_AHBC_lightNoisyScene 0 "nonoisyscene" 1 "noisyscene" ;
VAL_ 1862 VIS_AHBC_lightCone 0 "nolightcone" 1 "lightconedetected" ;
SIG_GROUP_ 1795 Common 1 : MCAL_InstanceId MCAL_ModuleId EQ_Diag_Application_Diagnostics_ EQ_Diag_Fatal_Error EQ_Diag_Minor_Error EQ_Boot_Test_results EQ_Mesp_current_msg_tag_cnt EQ_Mesp_current_step EQ_Mesp_return_status EQ_Mesp_target_mode EQ_DynamicCal_error EQ_DynamicCal_imageIndex EQ_DynamicCal_runMode EQ_DynamicCal_status EQ_StaticCal_error EQ_StaticCal_imageIndex EQ_StaticCal_runMode MCAL_ErrorId MCAL_ApiId AURIX_Core5_Cpu_Load AURIX_Core4_Cpu_Load AURIX_Core3_Cpu_Load AURIX_Core2_Cpu_Load AURIX_Core1_Cpu_Load AURIX_Core0_Cpu_Load;
